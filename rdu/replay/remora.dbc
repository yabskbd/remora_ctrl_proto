VERSION ""

NS_ :

BS_:

BU_: Turbocharger OnBoardDataLogger OffBoardDiagnosticTool2 OffBoardDiagnosticTool1 FileServer ParkingBrakeController SeatControl2 FanDriveController SteeringColumnUnit CommunicationUnitRadio CommunicationUnitSatellite CommunicationUnitCellular PropulsionBatteryCharger ChassisController2 ChassisController1 EngineValveControl AuxiliaryHeater2 AuxiliaryHeater1 ClutchUnit RampControl InformationSystem1 SuspensionSystemController2 OilSensor VehicleDynamicStability ExhaustEmissionController TransmissionDisplay2 TransmissionDisplay1 ClimateControl2 WaterPumpController RearAxleSteeringController LightingOperatorControl SeatController1 IgnitionController2 IgnitionController1 TirePressureController CabController2 CabController1 PneumaticSystemController SuspensionSystemController1 HydraulicPumpController EnduranceBrakingSystem RetarderExhaustEngine2 OnBoardDiagnosticUnit HeadwayController RetarderExhaustEngine1 CabDisplay1 ManagementComputer VirtualTerminal OffVehicleGateway PowerTakeOffFront HitchControl AuxiliaryValveControl BodyController TractorTrailerBridge1 StarterSystem ElectricalSystem VehicleSecurity VehicleNavigation AerodynamicControl ElectricalChargingSystem ClimateControl1 TripRecorder InstrumentCluster SuspensionDriveAxle2 SuspensionDriveAxle1 SuspensionSteerAxle SteeringController FuelSystem CruiseControl RetarderDriveline RetarderEngine BrakesDriveAxle2 BrakesDriveAxle1 BrakesSystemController BrakesSteerAxle AxleDrive2 AxleDrive1 AxleSteering PowerTakeOff ShiftConsoleSecondary ShiftConsolePrimary Transmission2 Transmission1 Engine2 Engine1

BO_ 3221225472 VECTOR__INDEPENDENT_SIG_MSG: 0 Vector__XXX
 SG_ Aftrtrtmnt2DslPrtcltFltrInt_0000 : 16|16@1+ (0.03125,-273) [-273|1734.96875] "deg C" Vector__XXX
 SG_ Aftrtrtmnt2DslPrtcltFltrOtltGsTm : 16|16@1+ (0.03125,-273) [-273|1734.96875] "deg C" Vector__XXX
 SG_ Aftrtrtmnt2DslPrtcltFltrExhstGsT : 40|5@1+ (1,0) [0|31] "" Vector__XXX
 SG_ Aftrtrtmnt2ExhstGsTmp3PrlmnryFMI : 32|5@1+ (1,0) [0|31] "" Vector__XXX
 SG_ Aftertreatment2ExhaustGasTemp3 : 0|16@1+ (0.03125,-273) [-273|1734.96875] "deg C" Vector__XXX
 SG_ Aftrtrtmnt2DslPrtcltFltrIntrmdtG : 58|5@1+ (1,0) [0|31] "" Vector__XXX
 SG_ Aftrtrtmnt2DslPrtcltFltrInt_0001 : 16|16@1+ (0.03125,-273) [-273|1734.96875] "deg C" Vector__XXX
 SG_ Aftrtrtmnt2DslPrtcltFltrDltPrssP : 53|5@1+ (1,0) [0|31] "" Vector__XXX
 SG_ Aftrtrtmnt2DslPrtcltFltrDffPrss : 32|16@1+ (0.1,0) [0|6425.5] "kPa" Vector__XXX
 SG_ Aftrtrtmnt2ExhstGsTmp2PrlmnryFMI : 48|5@1+ (1,0) [0|31] "" Vector__XXX
 SG_ Aftertreatment2ExhaustGasTemp2 : 0|16@1+ (0.03125,-273) [-273|1734.96875] "deg C" Vector__XXX
 SG_ FifthWheelSliderLockIndicator : 16|2@1+ (1,0) [0|3] "" Vector__XXX
 SG_ FifthWheelSliderPos : 8|8@1+ (10,0) [0|2500] "mm" Vector__XXX
 SG_ FfthWhlLckCoupleStatusIndicator : 6|2@1+ (1,0) [0|3] "" Vector__XXX
 SG_ FfthWhlLckRadyToCoupleIndicator : 4|2@1+ (1,0) [0|3] "" Vector__XXX
 SG_ FifthWheelErrorStatus : 0|4@1+ (1,0) [0|15] "" Vector__XXX
 SG_ EngCentrifugalOilFilterSpeed : 24|16@1+ (4,0) [0|257020] "rpm" Vector__XXX
 SG_ EngCoolantPumpDiffPress : 16|8@1+ (1.64,-7) [-7|403] "kPa" Vector__XXX
 SG_ EngChargeAirCooler2IntakePress : 8|8@1+ (2,0) [0|500] "kPa" Vector__XXX
 SG_ EngChargeAirCooler1IntakePress : 0|8@1+ (2,0) [0|500] "kPa" Vector__XXX
 SG_ EngIntercoolerCoolantLevel : 40|8@1+ (0.4,0) [0|100] "%" Vector__XXX
 SG_ EngChargeAirCoolerOutletPress : 56|8@1+ (2,0) [0|500] "kPa" Vector__XXX
 SG_ EngAftercoolerCoolantLevel : 48|8@1+ (0.4,0) [0|100] "%" Vector__XXX
 SG_ WrlessCommunicationNetworkType1 : 32|8@1+ (1,0) [0|255] "" Vector__XXX
 SG_ NetworkSignalStrength1 : 24|8@1+ (0.4,0) [0|100] "%" Vector__XXX
 SG_ NetworkAntennaStatus1 : 16|8@1+ (1,0) [0|255] "" Vector__XXX
 SG_ NetworkServiceStatus1 : 8|8@1+ (1,0) [0|255] "" Vector__XXX
 SG_ NetworkTransceiverStatus1 : 0|8@1+ (1,0) [0|255] "" Vector__XXX
 SG_ WrlessCommunicationNetworkType2 : 32|8@1+ (1,0) [0|255] "" Vector__XXX
 SG_ NetworkSignalStrength2 : 24|8@1+ (0.4,0) [0|100] "%" Vector__XXX
 SG_ NetworkAntennaStatus2 : 16|8@1+ (1,0) [0|255] "" Vector__XXX
 SG_ NetworkServiceStatus2 : 8|8@1+ (1,0) [0|255] "" Vector__XXX
 SG_ NetworkTransceiverStatus2 : 0|8@1+ (1,0) [0|255] "" Vector__XXX
 SG_ VoltageRegulatorEnabled : 10|2@1+ (1,0) [0|3] "" Vector__XXX
 SG_ VoltageRegulatorSoftStartState : 8|2@1+ (1,0) [0|3] "" Vector__XXX
 SG_ VltgRgltrUndrfrqncyCmpnstnEnbld : 6|2@1+ (1,0) [0|3] "" Vector__XXX
 SG_ VltgRgltrVAr_PwrFctrOprtingMode : 3|3@1+ (1,0) [0|7] "" Vector__XXX
 SG_ VltgRglatorLoadCompensationMode : 0|3@1+ (1,0) [0|7] "" Vector__XXX
 SG_ GnrtrOtputVoltageBiasPercentage : 32|16@1+ (0.1,-100) [-100|100] "%" Vector__XXX
 SG_ GeneratorExcitationFieldCurrent : 16|16@1+ (0.05,0) [0|3217.5] "A" Vector__XXX
 SG_ GeneratorExcitationFieldVoltage : 0|16@1+ (0.05,-1605.625) [-1605.625|1606.375] "V" Vector__XXX
 SG_ EnableStatusOfDoor10 : 58|2@1+ (1,0) [0|3] "" Vector__XXX
 SG_ OpenStatusOfDoor10 : 56|2@1+ (1,0) [0|3] "" Vector__XXX
 SG_ LockStatusOfDoor10 : 54|2@1+ (1,0) [0|3] "" Vector__XXX
 SG_ EnableStatusOfDoor9 : 52|2@1+ (1,0) [0|3] "" Vector__XXX
 SG_ OpenStatusOfDoor9 : 50|2@1+ (1,0) [0|3] "" Vector__XXX
 SG_ LockStatusOfDoor9 : 48|2@1+ (1,0) [0|3] "" Vector__XXX
 SG_ EnableStatusOfDoor8 : 46|2@1+ (1,0) [0|3] "" Vector__XXX
 SG_ OpenStatusOfDoor8 : 44|2@1+ (1,0) [0|3] "" Vector__XXX
 SG_ LockStatusOfDoor8 : 42|2@1+ (1,0) [0|3] "" Vector__XXX
 SG_ EnableStatusOfDoor7 : 40|2@1+ (1,0) [0|3] "" Vector__XXX
 SG_ OpenStatusOfDoor7 : 38|2@1+ (1,0) [0|3] "" Vector__XXX
 SG_ LockStatusOfDoor7 : 36|2@1+ (1,0) [0|3] "" Vector__XXX
 SG_ EnableStatusOfDoor6 : 34|2@1+ (1,0) [0|3] "" Vector__XXX
 SG_ OpenStatusOfDoor6 : 32|2@1+ (1,0) [0|3] "" Vector__XXX
 SG_ LockStatusOfDoor6 : 30|2@1+ (1,0) [0|3] "" Vector__XXX
 SG_ EnableStatusOfDoor5 : 28|2@1+ (1,0) [0|3] "" Vector__XXX
 SG_ OpenStatusOfDoor5 : 26|2@1+ (1,0) [0|3] "" Vector__XXX
 SG_ LockStatusOfDoor5 : 24|2@1+ (1,0) [0|3] "" Vector__XXX
 SG_ EnableStatusOfDoor4 : 22|2@1+ (1,0) [0|3] "" Vector__XXX
 SG_ OpenStatusOfDoor4 : 20|2@1+ (1,0) [0|3] "" Vector__XXX
 SG_ LockStatusOfDoor4 : 18|2@1+ (1,0) [0|3] "" Vector__XXX
 SG_ EnableStatusOfDoor3 : 16|2@1+ (1,0) [0|3] "" Vector__XXX
 SG_ OpenStatusOfDoor3 : 14|2@1+ (1,0) [0|3] "" Vector__XXX
 SG_ LockStatusOfDoor3 : 12|2@1+ (1,0) [0|3] "" Vector__XXX
 SG_ EnableStatusOfDoor2 : 10|2@1+ (1,0) [0|3] "" Vector__XXX
 SG_ OpenStatusOfDoor2 : 8|2@1+ (1,0) [0|3] "" Vector__XXX
 SG_ LockStatusOfDoor2 : 6|2@1+ (1,0) [0|3] "" Vector__XXX
 SG_ EnableStatusOfDoor1 : 4|2@1+ (1,0) [0|3] "" Vector__XXX
 SG_ OpenStatusOfDoor1 : 2|2@1+ (1,0) [0|3] "" Vector__XXX
 SG_ LockStatusOfDoor1 : 0|2@1+ (1,0) [0|3] "" Vector__XXX
 SG_ EnggmntSttusTransInputShaftPTO1 : 38|2@1+ (1,0) [0|3] "" Vector__XXX
 SG_ EnggmntSttusTransInputShaftPTO2 : 36|2@1+ (1,0) [0|3] "" Vector__XXX
 SG_ EnggmntSttusTransOutputShaftPTO : 34|2@1+ (1,0) [0|3] "" Vector__XXX
 SG_ EnggmntSttsTrnsfrCsOtptShaftPTO : 32|2@1+ (1,0) [0|3] "" Vector__XXX
 SG_ EnggmntCnsntTransInputShaftPTO1 : 22|2@1+ (1,0) [0|3] "" Vector__XXX
 SG_ EnggmntCnsntTransInputShaftPTO2 : 20|2@1+ (1,0) [0|3] "" Vector__XXX
 SG_ EnggmntCnsntTransOutputShaftPTO : 18|2@1+ (1,0) [0|3] "" Vector__XXX
 SG_ EnggmntCnsntTrnsfrCsOtptShftPTO : 16|2@1+ (1,0) [0|3] "" Vector__XXX
 SG_ EnableSwitchTransInputShaftPTO1 : 6|2@1+ (1,0) [0|3] "" Vector__XXX
 SG_ EnableSwitchTransInputShaftPTO2 : 4|2@1+ (1,0) [0|3] "" Vector__XXX
 SG_ EnableSwitchTransOutputShaftPTO : 2|2@1+ (1,0) [0|3] "" Vector__XXX
 SG_ EnblSwtchTrnsfrCsOutputShaftPTO : 0|2@1+ (1,0) [0|3] "" Vector__XXX
 SG_ EnggmntSttsPTOEngAccssoryDrive2 : 44|2@1+ (1,0) [0|3] "" Vector__XXX
 SG_ EnggmntSttsPTOEngAccssoryDrive1 : 42|2@1+ (1,0) [0|3] "" Vector__XXX
 SG_ EnggmntCnsntPTOEngAccssryDrive2 : 28|2@1+ (1,0) [0|3] "" Vector__XXX
 SG_ EnggmntCnsntPTOEngAccssryDrive1 : 26|2@1+ (1,0) [0|3] "" Vector__XXX
 SG_ EngagementStatusPTOEngFlywheel : 40|2@1+ (1,0) [0|3] "" Vector__XXX
 SG_ EngagementConsentPTOEngFlywheel : 24|2@1+ (1,0) [0|3] "" Vector__XXX
 SG_ EnblSwitchPTOEngAccessoryDrive2 : 12|2@1+ (1,0) [0|3] "" Vector__XXX
 SG_ EnblSwitchPTOEngAccessoryDrive1 : 10|2@1+ (1,0) [0|3] "" Vector__XXX
 SG_ EnableSwitchPTOEngFlywheel : 8|2@1+ (1,0) [0|3] "" Vector__XXX
 SG_ AtLeastOnePTOEngaged : 48|2@1+ (1,0) [0|3] "" Vector__XXX
 SG_ EngVrableGeometryTurboActuator1 : 16|8@1+ (0.4,0) [0|100] "%" Vector__XXX
 SG_ EngTrbCmprssrBypssActtr1TmpStts : 61|3@1+ (1,0) [0|7] "" Vector__XXX
 SG_ EngTrbCmprssrBypssActtr1PrlmnryF : 56|5@1+ (1,0) [0|31] "" Vector__XXX
 SG_ EngTrbCmprssrBypassActuator2Cmd : 32|16@1+ (0.0025,0) [0|160.6375] "%" Vector__XXX
 SG_ EngTrbCmprssrBypassActuator1Pos : 24|8@1+ (0.4,0) [0|100] "%" Vector__XXX
 SG_ EngTrbCmprssrBypassActuator1Cmd : 0|16@1+ (0.0025,0) [0|160.6375] "%" Vector__XXX
 SG_ EngDsrdTrbCmprssrBypssActtr1Pos : 48|8@1+ (0.4,0) [0|100] "%" Vector__XXX
 SG_ EngFuelValve2OutletAbsPress : 48|16@1+ (0.1,0) [0|6425.5] "kPa" Vector__XXX
 SG_ EngFuelTemp2 : 32|8@1+ (1,-40) [-40|210] "deg C" Vector__XXX
 SG_ EngGas2MassFlowRate : 16|16@1+ (0.05,0) [0|3212.75] "kg/h" Vector__XXX
 SG_ EngFuelValve2IntakeAbsPress : 0|16@1+ (0.1,0) [0|6425.5] "kPa" Vector__XXX
 SG_ Aftrtrtmnt1FlInjctor1HeaterCtrl : 56|8@1+ (0.4,0) [0|100] "%" Vector__XXX
 SG_ Aftertreatment1FuelPress1Ctrl : 32|16@1+ (0.0025,0) [0|160.6375] "%" Vector__XXX
 SG_ Aftrtratment1FuelEnableActuator : 54|2@1+ (1,0) [0|3] "" Vector__XXX
 SG_ Aftrtratment1RegenerationStatus : 52|2@1+ (1,0) [0|3] "" Vector__XXX
 SG_ Aftertreatment1Ignt : 50|2@1+ (1,0) [0|3] "" Vector__XXX
 SG_ Aftrtreatment1FuelDrainActuator : 48|2@1+ (1,0) [0|3] "" Vector__XXX
 SG_ Aftertreatment1FuelRate : 16|16@1+ (0.05,0) [0|3212.75] "L/h" Vector__XXX
 SG_ Aftertreatment1FuelPress1 : 0|16@1+ (0.1,0) [0|6425.5] "kPa" Vector__XXX
 SG_ Aftrtrtmnt2FlInjctor1HeaterCtrl : 56|8@1+ (0.4,0) [0|100] "%" Vector__XXX
 SG_ Aftertreatment2FuelPress1Ctrl : 32|16@1+ (0.0025,0) [0|160.6375] "%" Vector__XXX
 SG_ Aftertreatment2FuelPress1 : 0|16@1+ (0.1,0) [0|6425.5] "kPa" Vector__XXX
 SG_ Aftrtratment2FuelEnableActuator : 54|2@1+ (1,0) [0|3] "" Vector__XXX
 SG_ Aftrtratment2RegenerationStatus : 52|2@1+ (1,0) [0|3] "" Vector__XXX
 SG_ Aftertreatment2Ignt : 50|2@1+ (1,0) [0|3] "" Vector__XXX
 SG_ Aftrtreatment2FuelDrainActuator : 48|2@1+ (1,0) [0|3] "" Vector__XXX
 SG_ Aftertreatment2FuelRate : 16|16@1+ (0.05,0) [0|3212.75] "L/h" Vector__XXX
 SG_ Aftrtreatment1AirEnableActuator : 62|2@1+ (1,0) [0|3] "" Vector__XXX
 SG_ Aftertreatment1PurgeAirActuator : 60|2@1+ (1,0) [0|3] "" Vector__XXX
 SG_ Aftrtrtmnt1AtmzationAirActuator : 58|2@1+ (1,0) [0|3] "" Vector__XXX
 SG_ Aftertreatment1AirSystemRelay : 56|2@1+ (1,0) [0|3] "" Vector__XXX
 SG_ Aftrtrtment1AirPressActuatorPos : 48|8@1+ (0.4,0) [0|100] "%" Vector__XXX
 SG_ Aftertreatment1AirPressCtrl : 32|16@1+ (0.0025,0) [0|160.6375] "%" Vector__XXX
 SG_ Aftertreatment1PurgeAirPress : 16|16@1+ (0.1,0) [0|6425.5] "kPa" Vector__XXX
 SG_ Aftertreatment1SupplyAirPress : 0|16@1+ (0.1,0) [0|6425.5] "kPa" Vector__XXX
 SG_ Aftrtreatment2AirEnableActuator : 62|2@1+ (1,0) [0|3] "" Vector__XXX
 SG_ Aftertreatment2PurgeAirActuator : 60|2@1+ (1,0) [0|3] "" Vector__XXX
 SG_ Aftrtrtmnt2AtmzationAirActuator : 58|2@1+ (1,0) [0|3] "" Vector__XXX
 SG_ Aftertreatment2AirSystemRelay : 56|2@1+ (1,0) [0|3] "" Vector__XXX
 SG_ Aftrtrtment2AirPressActuatorPos : 48|8@1+ (0.4,0) [0|100] "%" Vector__XXX
 SG_ Aftertreatment2AirPressCtrl : 32|16@1+ (0.0025,0) [0|160.6375] "%" Vector__XXX
 SG_ Aftertreatment2PurgeAirPress : 16|16@1+ (0.1,0) [0|6425.5] "kPa" Vector__XXX
 SG_ Aftertreatment2SupplyAirPress : 0|16@1+ (0.1,0) [0|6425.5] "kPa" Vector__XXX
 SG_ SensorSupplyVoltage4 : 48|16@1+ (0.05,0) [0|3212.75] "V" Vector__XXX
 SG_ SensorSupplyVoltage3 : 32|16@1+ (0.05,0) [0|3212.75] "V" Vector__XXX
 SG_ SensorSupplyVoltage2 : 16|16@1+ (0.05,0) [0|3212.75] "V" Vector__XXX
 SG_ SensorSupplyVoltage1 : 0|16@1+ (0.05,0) [0|3212.75] "V" Vector__XXX
 SG_ SensorSupplyVoltage6 : 16|16@1+ (0.05,0) [0|3212.75] "V" Vector__XXX
 SG_ SensorSupplyVoltage5 : 0|16@1+ (0.05,0) [0|3212.75] "V" Vector__XXX
 SG_ SensorSupplyVoltage8 : 48|16@1+ (0.05,0) [0|3212.75] "V" Vector__XXX
 SG_ SensorSupplyVoltage7 : 32|16@1+ (0.05,0) [0|3212.75] "V" Vector__XXX
 SG_ Aftrtrtmnt1SCRCtlystRgntTmp2Prlm : 24|5@1+ (1,0) [0|31] "" Vector__XXX
 SG_ Aftrtrtmnt1SCRCtlystRgntPrprtsPr : 32|5@1+ (1,0) [0|31] "" Vector__XXX
 SG_ Aftrtrtmnt1SCRCtlystRgntCndctvty : 16|8@1+ (5,0) [0|1250] "microSiemens/mm" Vector__XXX
 SG_ Aftrtrtmnt1SCRCtlystRgntCncntrtn : 8|8@1+ (0.25,0) [0|62.5] "%" Vector__XXX
 SG_ Aftrtrtmnt1SCRCtlystReagentType : 40|4@1+ (1,0) [0|15] "" Vector__XXX
 SG_ Aftrtrtmnt1SCRCtlystRagentTemp2 : 0|8@1+ (1,-40) [-40|210] "deg C" Vector__XXX
 SG_ Aftrtrtmnt2TtlNmbrOfActvRgnrtnMn : 224|32@1+ (1,0) [0|4294967295] "counts" Vector__XXX
 SG_ Aftrtrtmnt2TtlNmbrOfActvRgnrtnIn : 192|32@1+ (1,0) [0|4294967295] "counts" Vector__XXX
 SG_ Aftrtrtmnt2AvrgTmBtwnActvRgnrtns : 256|32@1+ (1,0) [0|4211081215] "s" Vector__XXX
 SG_ Aftrtrtmnt2TtlNmbrOfPssvRgnrtns : 160|32@1+ (1,0) [0|4294967295] "counts" Vector__XXX
 SG_ Aftrtrtmnt2TtlPssvRgnrationTime : 128|32@1+ (1,0) [0|4211081215] "s" Vector__XXX
 SG_ Aftrtrtmnt2TtlNmbrOfActvRgnrtns : 96|32@1+ (1,0) [0|4294967295] "counts" Vector__XXX
 SG_ Aftrtreatment2TotalDisabledTime : 64|32@1+ (1,0) [0|4211081215] "s" Vector__XXX
 SG_ Aftrtrtmnt2TtalRegenerationTime : 32|32@1+ (1,0) [0|4211081215] "s" Vector__XXX
 SG_ Aftertreatment2TotalFuelUsed : 0|32@1+ (0.5,0) [0|2105540607.5] "L" Vector__XXX
 SG_ Aftrtrtmnt1TtlNmbrOfActvRgnrtnMn : 224|32@1+ (1,0) [0|4294967295] "counts" Vector__XXX
 SG_ Aftrtrtmnt1TtlNmbrOfActvRgnrtnIn : 192|32@1+ (1,0) [0|4294967295] "counts" Vector__XXX
 SG_ Aftrtrtmnt1AvrgTmBtwnActvRgnrtns : 256|32@1+ (1,0) [0|4211081215] "s" Vector__XXX
 SG_ Aftrtrtmnt1TtlNmbrOfPssvRgnrtns : 160|32@1+ (1,0) [0|4294967295] "counts" Vector__XXX
 SG_ Aftrtrtmnt1TtlPssvRgnrationTime : 128|32@1+ (1,0) [0|4211081215] "s" Vector__XXX
 SG_ Aftrtrtmnt1TtlNmbrOfActvRgnrtns : 96|32@1+ (1,0) [0|4294967295] "counts" Vector__XXX
 SG_ Aftrtreatment1TotalDisabledTime : 64|32@1+ (1,0) [0|4211081215] "s" Vector__XXX
 SG_ Aftrtrtmnt1TtalRegenerationTime : 32|32@1+ (1,0) [0|4211081215] "s" Vector__XXX
 SG_ Aftertreatment1TotalFuelUsed : 0|32@1+ (0.5,0) [0|2105540607.5] "L" Vector__XXX
 SG_ TrnsTrqueConverterOilOutletTemp : 8|16@1+ (0.03125,-273) [-273|1734.96875] "deg C" Vector__XXX
 SG_ TransOverheatIndicator : 4|2@1+ (1,0) [0|3] "" Vector__XXX
 SG_ TransOilLifeRemaining : 24|8@1+ (0.4,0) [0|100] "%" Vector__XXX
 SG_ TransOilLevelSwitch : 2|2@1+ (1,0) [0|3] "" Vector__XXX
 SG_ TransOilFilterRestrictionSwitch : 0|2@1+ (1,0) [0|3] "" Vector__XXX
 SG_ EngExhstGsRcrculation1Valve2Pos : 16|16@1+ (0.0025,0) [0|160.6375] "%" Vector__XXX
 SG_ EngExhstGsRcirculation1ValvePos : 0|16@1+ (0.0025,0) [0|160.6375] "%" Vector__XXX
 SG_ EngCrnkcsBrthrOilSeparatorSpeed : 32|16@1+ (1,0) [0|64255] "rpm" Vector__XXX
 SG_ CmdedEngIntakeManifoldPress : 48|16@1+ (0.125,0) [0|8031.875] "kPa" Vector__XXX
 SG_ EngDerateRq : 56|8@1+ (0.4,0) [0|100] "%" Vector__XXX
 SG_ EngEmergencyShutdownIndication : 44|2@1+ (1,0) [0|3] "" Vector__XXX
 SG_ EngCtrlledShutdownRq : 42|2@1+ (1,0) [0|3] "" Vector__XXX
 SG_ EngCoolantCirculatingPumpCtrl : 40|2@1+ (1,0) [0|3] "" Vector__XXX
 SG_ EngBlock_CoolantPreheaterCtrl : 38|2@1+ (1,0) [0|3] "" Vector__XXX
 SG_ EngElctrclSystmPwrCnsrvtionCtrl : 36|2@1+ (1,0) [0|3] "" Vector__XXX
 SG_ EngOilPreheaterCtrl : 34|2@1+ (1,0) [0|3] "" Vector__XXX
 SG_ EngOilPrimingPumpCtrl : 32|2@1+ (1,0) [0|3] "" Vector__XXX
 SG_ EngFuelShutoffValveLeakTestCtrl : 30|2@1+ (1,0) [0|3] "" Vector__XXX
 SG_ EngFuelShutoff2Ctrl : 28|2@1+ (1,0) [0|3] "" Vector__XXX
 SG_ EngFuelShutoff1Ctrl : 26|2@1+ (1,0) [0|3] "" Vector__XXX
 SG_ EngFuelShutoffVentCtrl : 24|2@1+ (1,0) [0|3] "" Vector__XXX
 SG_ TmeRemainingInEngOperatingState : 8|16@1+ (1,0) [0|64255] "s" Vector__XXX
 SG_ FuelPumpPrimerCtrl : 4|2@1+ (1,0) [0|3] "" Vector__XXX
 SG_ EngOperatingState : 0|4@1+ (1,0) [0|15] "" Vector__XXX
 SG_ AETCSpeedValue : 8|16@1- (1,0) [0|8031.875] "rpm" Vector__XXX
 SG_ AETCTorqueValue : 24|16@1+ (1,0) [0|64255] "Nm" Vector__XXX
 SG_ NumberOfAETCDataPoints : 4|4@1+ (1,0) [0|15] "" Vector__XXX
 SG_ AETCDataCollectionStandard : 0|4@1+ (1,0) [0|15] "" Vector__XXX
 SG_ DslPrticulateFilterOutletPress1 : 16|16@1+ (0.1,0) [0|6425.5] "kPa" Vector__XXX
 SG_ DslPrticulateFilterIntakePress1 : 0|16@1+ (0.1,0) [0|6425.5] "kPa" Vector__XXX
 SG_ DslPrticulateFilterOutletPress2 : 16|16@1+ (0.1,0) [0|6425.5] "kPa" Vector__XXX
 SG_ DslPrticulateFilterIntakePress2 : 0|16@1+ (0.1,0) [0|6425.5] "kPa" Vector__XXX
 SG_ J2012DTCOccurrenceCount : 49|7@1+ (1,0) [0|127] "" Vector__XXX
 SG_ J2012DTCStatus : 48|1@1+ (1,0) [0|1] "" Vector__XXX
 SG_ NumberOfJ2012DTCs : 0|8@1+ (1,0) [0|250] "" Vector__XXX
 SG_ VehicleRoll : 0|16@1+ (0.0078125,-200) [-200|301.99] "deg" Vector__XXX
 SG_ EngIntkVlvActtonOilPressForCyl4 : 48|16@1+ (0.1,0) [0|6425.5] "kPa" Vector__XXX
 SG_ EngIntkVlvActtonOilPressForCyl3 : 32|16@1+ (0.1,0) [0|6425.5] "kPa" Vector__XXX
 SG_ EngIntkVlvActtonOilPressForCyl2 : 16|16@1+ (0.1,0) [0|6425.5] "kPa" Vector__XXX
 SG_ EngIntkVlvActtonOilPressForCyl1 : 0|16@1+ (0.1,0) [0|6425.5] "kPa" Vector__XXX
 SG_ EngIntkVlvActtonOilPressForCyl8 : 48|16@1+ (0.1,0) [0|6425.5] "kPa" Vector__XXX
 SG_ EngIntkVlvActtonOilPressForCyl7 : 32|16@1+ (0.1,0) [0|6425.5] "kPa" Vector__XXX
 SG_ EngIntkVlvActtonOilPressForCyl6 : 16|16@1+ (0.1,0) [0|6425.5] "kPa" Vector__XXX
 SG_ EngIntkVlvActtonOilPressForCyl5 : 0|16@1+ (0.1,0) [0|6425.5] "kPa" Vector__XXX
 SG_ EngIntkVlvActtnOilPressForCyl12 : 48|16@1+ (0.1,0) [0|6425.5] "kPa" Vector__XXX
 SG_ EngIntkVlvActtnOilPressForCyl11 : 32|16@1+ (0.1,0) [0|6425.5] "kPa" Vector__XXX
 SG_ EngIntkVlvActtnOilPressForCyl10 : 16|16@1+ (0.1,0) [0|6425.5] "kPa" Vector__XXX
 SG_ EngIntkVlvActtonOilPressForCyl9 : 0|16@1+ (0.1,0) [0|6425.5] "kPa" Vector__XXX
 SG_ EngIntkVlvActtnOilPressForCyl16 : 48|16@1+ (0.1,0) [0|6425.5] "kPa" Vector__XXX
 SG_ EngIntkVlvActtnOilPressForCyl15 : 32|16@1+ (0.1,0) [0|6425.5] "kPa" Vector__XXX
 SG_ EngIntkVlvActtnOilPressForCyl14 : 16|16@1+ (0.1,0) [0|6425.5] "kPa" Vector__XXX
 SG_ EngIntkVlvActtnOilPressForCyl13 : 0|16@1+ (0.1,0) [0|6425.5] "kPa" Vector__XXX
 SG_ EngIntkVlvActtnOilPressForCyl20 : 48|16@1+ (0.1,0) [0|6425.5] "kPa" Vector__XXX
 SG_ EngIntkVlvActtnOilPressForCyl19 : 32|16@1+ (0.1,0) [0|6425.5] "kPa" Vector__XXX
 SG_ EngIntkVlvActtnOilPressForCyl18 : 16|16@1+ (0.1,0) [0|6425.5] "kPa" Vector__XXX
 SG_ EngIntkVlvActtnOilPressForCyl17 : 0|16@1+ (0.1,0) [0|6425.5] "kPa" Vector__XXX
 SG_ TransferCaseStatus : 0|3@1+ (1,0) [0|7] "" Vector__XXX
 SG_ EGR1CoolerBypassActuatorPostion : 0|8@1+ (0.4,0) [0|100] "%" Vector__XXX
 SG_ MaxCrankAttemptsPerStartAttempt : 0|8@1+ (1,0) [0|250] "" Vector__XXX
 SG_ RightHeadlampLightDistribution : 12|4@1+ (1,0) [0|15] "" Vector__XXX
 SG_ LeftHeadlampLightDistribution : 8|4@1+ (1,0) [0|15] "" Vector__XXX
 SG_ RghtHeadlampDynamicBendingLight : 3|3@1+ (1,0) [0|7] "" Vector__XXX
 SG_ LeftHeadlampDynamicBendingLight : 0|3@1+ (1,0) [0|7] "" Vector__XXX
 SG_ EngFuelLeakage2 : 2|2@1+ (1,0) [0|3] "" Vector__XXX
 SG_ EngFuelLeakage1 : 0|2@1+ (1,0) [0|3] "" Vector__XXX
 SG_ EngTorqueLimit6AxleInput : 248|16@1+ (2,0) [0|128510] "Nm" Vector__XXX
 SG_ EngTorqueLimit5Switch : 232|16@1+ (1,0) [0|64255] "Nm" Vector__XXX
 SG_ EngTorqueLimit4Trans : 216|16@1+ (1,0) [0|64255] "Nm" Vector__XXX
 SG_ EngTorqueLimit3Trans : 200|16@1+ (1,0) [0|64255] "Nm" Vector__XXX
 SG_ TransGearRatio3 : 184|16@1+ (0.01,0) [0|642.55] "" Vector__XXX
 SG_ EngTorqueLimit2Trans : 168|16@1+ (1,0) [0|64255] "Nm" Vector__XXX
 SG_ TransGearRatio2 : 152|16@1+ (0.01,0) [0|642.55] "" Vector__XXX
 SG_ EngTorqueLimit1Trans : 136|16@1+ (1,0) [0|64255] "Nm" Vector__XXX
 SG_ TransGearRatio1 : 120|16@1+ (0.01,0) [0|642.55] "" Vector__XXX
 SG_ EngTorqueLimitFeature : 114|3@1+ (1,0) [0|7] "" Vector__XXX
 SG_ TorqueLimitingFeatureStatus : 112|2@1+ (1,0) [0|3] "" Vector__XXX
 SG_ CalibRecordDurationTime : 80|32@1+ (0.05,0) [0|210554060.75] "hr" Vector__XXX
 SG_ CalibRecordStartYear : 72|8@1+ (1,1985) [1985|2235] "years" Vector__XXX
 SG_ CalibRecordStartDay : 64|8@1+ (0.25,0) [0|62.5] "days" Vector__XXX
 SG_ CalibRecordStartMonth : 56|8@1+ (1,0) [0|250] "months" Vector__XXX
 SG_ EngPeakTorque2 : 40|16@1+ (1,0) [0|64255] "Nm" Vector__XXX
 SG_ EngPeakTorque1 : 24|16@1+ (1,0) [0|64255] "Nm" Vector__XXX
 SG_ EngPower : 8|16@1+ (0.5,0) [0|32127.5] "kW" Vector__XXX
 SG_ NumberOfEngTorqueHistoryRecords : 0|8@1+ (1,0) [0|250] "records" Vector__XXX
 SG_ EngExtlShutdownAirSupplyPress : 0|16@1+ (0.5,0) [0|32127.5] "kPa" Vector__XXX
 SG_ TimeSinceLastService : 8|16@1+ (1,-32127) [-32127|32128] "hr" Vector__XXX
 SG_ ECUPowerOutputSupplyVoltage3 : 48|16@1+ (0.05,0) [0|3212.75] "V" Vector__XXX
 SG_ ECUPowerOutputSupplyVoltage2 : 32|16@1+ (0.05,0) [0|3212.75] "V" Vector__XXX
 SG_ ECUPowerOutputSupplyVoltage1 : 16|16@1+ (0.05,0) [0|3212.75] "V" Vector__XXX
 SG_ BatteryPotential_PowerInput2 : 0|16@1+ (0.05,0) [0|3212.75] "V" Vector__XXX
 SG_ RelativeHumidity : 48|8@1+ (0.4,0) [0|100] "%" Vector__XXX
 SG_ AuxLevel : 32|16@1+ (0.1,0) [0|6425.5] "mm" Vector__XXX
 SG_ AuxPress2 : 24|8@1+ (16,0) [0|4000] "kPa" Vector__XXX
 SG_ AuxPress1 : 16|8@1+ (16,0) [0|4000] "kPa" Vector__XXX
 SG_ AuxTemp2 : 8|8@1+ (1,-40) [-40|210] "deg C" Vector__XXX
 SG_ AuxTemp1 : 0|8@1+ (1,-40) [-40|210] "deg C" Vector__XXX
 SG_ EngFuelValve1OutletAbsPress : 48|16@1+ (0.1,0) [0|6425.5] "kPa" Vector__XXX
 SG_ EngAirToFuelDiffPress : 32|16@1+ (0.1,0) [0|6425.5] "kPa" Vector__XXX
 SG_ EngFuelValveDiffPress : 16|16@1+ (0.1,0) [0|6425.5] "kPa" Vector__XXX
 SG_ EngFuelValve1IntakeAbsPress : 0|16@1+ (0.1,0) [0|6425.5] "kPa" Vector__XXX
 SG_ EngCyl20IgntTransSecondOutput : 24|8@1+ (1,-125) [-125|125] "%" Vector__XXX
 SG_ EngCyl19IgntTransSecondOutput : 16|8@1+ (1,-125) [-125|125] "%" Vector__XXX
 SG_ EngCyl18IgntTransSecondOutput : 8|8@1+ (1,-125) [-125|125] "%" Vector__XXX
 SG_ EngCyl17IgntTransSecondOutput : 0|8@1+ (1,-125) [-125|125] "%" Vector__XXX
 SG_ EngCyl16IgntTransSecondOutput : 56|8@1+ (1,-125) [-125|125] "%" Vector__XXX
 SG_ EngCyl15IgntTransSecondOutput : 48|8@1+ (1,-125) [-125|125] "%" Vector__XXX
 SG_ EngCyl14IgntTransSecondOutput : 40|8@1+ (1,-125) [-125|125] "%" Vector__XXX
 SG_ EngCyl13IgntTransSecondOutput : 32|8@1+ (1,-125) [-125|125] "%" Vector__XXX
 SG_ EngCyl12IgntTransSecondOutput : 24|8@1+ (1,-125) [-125|125] "%" Vector__XXX
 SG_ EngCyl11IgntTransSecondOutput : 16|8@1+ (1,-125) [-125|125] "%" Vector__XXX
 SG_ EngCyl10IgntTransSecondOutput : 8|8@1+ (1,-125) [-125|125] "%" Vector__XXX
 SG_ EngCyl9IgntTransSecondOutput : 0|8@1+ (1,-125) [-125|125] "%" Vector__XXX
 SG_ EngCyl8IgntTransSecondOutput : 56|8@1+ (1,-125) [-125|125] "%" Vector__XXX
 SG_ EngCyl7IgntTransSecondOutput : 48|8@1+ (1,-125) [-125|125] "%" Vector__XXX
 SG_ EngCyl6IgntTransSecondOutput : 40|8@1+ (1,-125) [-125|125] "%" Vector__XXX
 SG_ EngCyl5IgntTransSecondOutput : 32|8@1+ (1,-125) [-125|125] "%" Vector__XXX
 SG_ EngCyl4IgntTransSecondOutput : 24|8@1+ (1,-125) [-125|125] "%" Vector__XXX
 SG_ EngCyl3IgntTransSecondOutput : 16|8@1+ (1,-125) [-125|125] "%" Vector__XXX
 SG_ EngCyl2IgntTransSecondOutput : 8|8@1+ (1,-125) [-125|125] "%" Vector__XXX
 SG_ EngCyl1IgntTransSecondOutput : 0|8@1+ (1,-125) [-125|125] "%" Vector__XXX
 SG_ EngActualIgntTiming : 48|16@1+ (0.0078125,-200) [-200|301.99] "deg" Vector__XXX
 SG_ EngDesiredIgntTiming3 : 32|16@1+ (0.0078125,-200) [-200|301.99] "deg" Vector__XXX
 SG_ EngDesiredIgntTiming2 : 16|16@1+ (0.0078125,-200) [-200|301.99] "deg" Vector__XXX
 SG_ EngDesiredIgntTiming1 : 0|16@1+ (0.0078125,-200) [-200|301.99] "deg" Vector__XXX
 SG_ EngCyl20IgntTiming : 48|16@1+ (0.0078125,-200) [-200|301.99] "deg" Vector__XXX
 SG_ EngCyl19IgntTiming : 32|16@1+ (0.0078125,-200) [-200|301.99] "deg" Vector__XXX
 SG_ EngCyl18IgntTiming : 16|16@1+ (0.0078125,-200) [-200|301.99] "deg" Vector__XXX
 SG_ EngCyl17IgntTiming : 0|16@1+ (0.0078125,-200) [-200|301.99] "deg" Vector__XXX
 SG_ EngCyl16IgntTiming : 48|16@1+ (0.0078125,-200) [-200|301.99] "deg" Vector__XXX
 SG_ EngCyl15IgntTiming : 32|16@1+ (0.0078125,-200) [-200|301.99] "deg" Vector__XXX
 SG_ EngCyl14IgntTiming : 16|16@1+ (0.0078125,-200) [-200|301.99] "deg" Vector__XXX
 SG_ EngCyl13IgntTiming : 0|16@1+ (0.0078125,-200) [-200|301.99] "deg" Vector__XXX
 SG_ EngCyl12IgntTiming : 48|16@1+ (0.0078125,-200) [-200|301.99] "deg" Vector__XXX
 SG_ EngCyl11IgntTiming : 32|16@1+ (0.0078125,-200) [-200|301.99] "deg" Vector__XXX
 SG_ EngCyl10IgntTiming : 16|16@1+ (0.0078125,-200) [-200|301.99] "deg" Vector__XXX
 SG_ EngCyl9IgntTiming : 0|16@1+ (0.0078125,-200) [-200|301.99] "deg" Vector__XXX
 SG_ EngCyl8IgntTiming : 48|16@1+ (0.0078125,-200) [-200|301.99] "deg" Vector__XXX
 SG_ EngCyl7IgntTiming : 32|16@1+ (0.0078125,-200) [-200|301.99] "deg" Vector__XXX
 SG_ EngCyl6IgntTiming : 16|16@1+ (0.0078125,-200) [-200|301.99] "deg" Vector__XXX
 SG_ EngCyl5IgntTiming : 0|16@1+ (0.0078125,-200) [-200|301.99] "deg" Vector__XXX
 SG_ EngCyl4IgntTiming : 48|16@1+ (0.0078125,-200) [-200|301.99] "deg" Vector__XXX
 SG_ EngCyl3IgntTiming : 32|16@1+ (0.0078125,-200) [-200|301.99] "deg" Vector__XXX
 SG_ EngCyl2IgntTiming : 16|16@1+ (0.0078125,-200) [-200|301.99] "deg" Vector__XXX
 SG_ EngCyl1IgntTiming : 0|16@1+ (0.0078125,-200) [-200|301.99] "deg" Vector__XXX
 SG_ EngFuelFlowRate2 : 16|16@1+ (0.1,0) [0|6425.5] "m³/h" Vector__XXX
 SG_ EngFuelFlowRate1 : 0|16@1+ (0.1,0) [0|6425.5] "m³/h" Vector__XXX
 SG_ EngRqedFuelValve2Pos : 56|8@1+ (0.4,0) [0|100] "%" Vector__XXX
 SG_ EngRqedFuelValve1Pos : 48|8@1+ (0.4,0) [0|100] "%" Vector__XXX
 SG_ EngFuelValve2Pos : 40|8@1+ (0.4,0) [0|100] "%" Vector__XXX
 SG_ EngFuelValve1Pos : 32|8@1+ (0.4,0) [0|100] "%" Vector__XXX
 SG_ EngAverageCombustionTime : 16|16@1+ (0.01,0) [0|642.55] "ms" Vector__XXX
 SG_ EngDesiredCombustionTime : 0|16@1+ (0.01,0) [0|642.55] "ms" Vector__XXX
 SG_ EngCyl20CombustionTime : 48|16@1+ (0.01,0) [0|642.55] "ms" Vector__XXX
 SG_ EngCyl19CombustionTime : 32|16@1+ (0.01,0) [0|642.55] "ms" Vector__XXX
 SG_ EngCyl18CombustionTime : 16|16@1+ (0.01,0) [0|642.55] "ms" Vector__XXX
 SG_ EngCyl17CombustionTime : 0|16@1+ (0.01,0) [0|642.55] "ms" Vector__XXX
 SG_ EngCyl16CombustionTime : 48|16@1+ (0.01,0) [0|642.55] "ms" Vector__XXX
 SG_ EngCyl15CombustionTime : 32|16@1+ (0.01,0) [0|642.55] "ms" Vector__XXX
 SG_ EngCyl14CombustionTime : 16|16@1+ (0.01,0) [0|642.55] "ms" Vector__XXX
 SG_ EngCyl13CombustionTime : 0|16@1+ (0.01,0) [0|642.55] "ms" Vector__XXX
 SG_ EngCyl12CombustionTime : 48|16@1+ (0.01,0) [0|642.55] "ms" Vector__XXX
 SG_ EngCyl11CombustionTime : 32|16@1+ (0.01,0) [0|642.55] "ms" Vector__XXX
 SG_ EngCyl10CombustionTime : 16|16@1+ (0.01,0) [0|642.55] "ms" Vector__XXX
 SG_ EngCyl9CombustionTime : 0|16@1+ (0.01,0) [0|642.55] "ms" Vector__XXX
 SG_ EngCyl8CombustionTime : 48|16@1+ (0.01,0) [0|642.55] "ms" Vector__XXX
 SG_ EngCyl7CombustionTime : 32|16@1+ (0.01,0) [0|642.55] "ms" Vector__XXX
 SG_ EngCyl6CombustionTime : 16|16@1+ (0.01,0) [0|642.55] "ms" Vector__XXX
 SG_ EngCyl5CombustionTime : 0|16@1+ (0.01,0) [0|642.55] "ms" Vector__XXX
 SG_ EngCyl4CombustionTime : 48|16@1+ (0.01,0) [0|642.55] "ms" Vector__XXX
 SG_ EngCyl3CombustionTime : 32|16@1+ (0.01,0) [0|642.55] "ms" Vector__XXX
 SG_ EngCyl2CombustionTime : 16|16@1+ (0.01,0) [0|642.55] "ms" Vector__XXX
 SG_ EngCyl1CombustionTime : 0|16@1+ (0.01,0) [0|642.55] "ms" Vector__XXX
 SG_ SteerChannelTirePress : 32|16@1+ (0.5,0) [0|32127.5] "kPa" Vector__XXX
 SG_ DriveChannelTirePress : 16|16@1+ (0.5,0) [0|32127.5] "kPa" Vector__XXX
 SG_ TrailerTagPushChannelTirePress : 0|16@1+ (0.5,0) [0|32127.5] "kPa" Vector__XXX
 SG_ SteerChannelTirePressTarget : 32|16@1+ (0.5,0) [0|32127.5] "kPa" Vector__XXX
 SG_ DriveChannelTirePressTarget : 16|16@1+ (0.5,0) [0|32127.5] "kPa" Vector__XXX
 SG_ TrlrTgPshChannelTirePressTarget : 0|16@1+ (0.5,0) [0|32127.5] "kPa" Vector__XXX
 SG_ PCUSupplySolenoidStatus : 36|2@1+ (1,0) [0|3] "" Vector__XXX
 SG_ PCUCtrlSolenoidStatus : 34|2@1+ (1,0) [0|3] "" Vector__XXX
 SG_ PCUDeflateSolenoidStatus : 32|2@1+ (1,0) [0|3] "" Vector__XXX
 SG_ TirePressSupplySwitchStatus : 28|2@1+ (1,0) [0|3] "" Vector__XXX
 SG_ PCUSteerSolenoidStatus : 26|2@1+ (1,0) [0|3] "" Vector__XXX
 SG_ PCUDriveSolenoidStatus : 24|2@1+ (1,0) [0|3] "" Vector__XXX
 SG_ DriveChannelMode : 20|4@1+ (1,0) [0|15] "" Vector__XXX
 SG_ Trailer_TagChannelMode : 16|4@1+ (1,0) [0|15] "" Vector__XXX
 SG_ SteerChannelMode : 8|4@1+ (1,0) [0|15] "" Vector__XXX
 SG_ TirePressCheckInterval : 0|8@1+ (1,0) [0|250] "mins" Vector__XXX
 SG_ PCUTrailerTagPushSolenoidStatus : 38|2@1+ (1,0) [0|3] "" Vector__XXX
 SG_ AuxAbsPressReading : 32|16@1+ (0.5,0) [0|32127.5] "kPa" Vector__XXX
 SG_ AuxGagePressReading1 : 16|16@1+ (0.5,0) [0|32127.5] "kPa" Vector__XXX
 SG_ AuxVacuumPressReading : 0|16@1+ (0.5,0) [0|32127.5] "kPa" Vector__XXX
 SG_ DisplayDeadbands : 20|4@1+ (1,0) [0|15] "" Vector__XXX
 SG_ LEDPatternCtrl : 16|4@1+ (1,0) [0|15] "" Vector__XXX
 SG_ LEDDisplayDeadbandCtrl : 12|4@1+ (1,0) [0|15] "" Vector__XXX
 SG_ LEDDisplayModeCtrl : 8|4@1+ (1,0) [0|15] "" Vector__XXX
 SG_ LEDDisplayData1 : 0|8@1+ (1,0) [0|255] "" Vector__XXX
 SG_ LaserStrikeDataLatency : 24|16@1+ (51.2,0) [0|3.289856] "s" Vector__XXX
 SG_ LaserReceiverType : 16|8@1+ (1,0) [0|250] "" Vector__XXX
 SG_ LaserStrikeVerticalDeviation : 0|16@1+ (0.1,-3200) [-3200|3225.5] "mm" Vector__XXX
 SG_ AbsLaserStrikePos : 40|16@1+ (0.1,0) [0|6425.5] "mm" Vector__XXX
 SG_ BldHeightSetPointHighResolution : 16|32@1+ (100,-209.7152) [-209.7152|211.3929215] "m" Vector__XXX
 SG_ ModifyLevelingSystemSetPoint : 0|16@1+ (0.1,-3200) [-3200|3225.5] "mm" Vector__XXX
 SG_ MastPos : 0|16@1+ (0.1,-3200) [-3200|3225.5] "mm" Vector__XXX
 SG_ BladeCtrlMode : 16|8@1+ (1,0) [0|255] "" Vector__XXX
 SG_ BladeDurationAndDirection : 0|16@1+ (0.1,-3276.8) [-3276.8|3148.7] "sec" Vector__XXX
 SG_ LandLevelingSystemEnableStatus : 32|2@1+ (1,0) [0|3] "" Vector__XXX
 SG_ BladeCtrlModeRight : 28|4@1+ (1,0) [0|15] "" Vector__XXX
 SG_ BladeCtrlModeLeft : 24|4@1+ (1,0) [0|15] "" Vector__XXX
 SG_ LaserTracerInformation : 48|8@1+ (1,0) [0|255] "" Vector__XXX
 SG_ LEDDisplayData2 : 40|8@1+ (1,0) [0|255] "" Vector__XXX
 SG_ LaserTracerHorizontalDeviation : 32|8@1+ (1,0) [0|250] "%" Vector__XXX
 SG_ LaserTracerVerticalDistance : 16|16@1+ (0.1,0) [0|6425.5] "mm" Vector__XXX
 SG_ LaserTracerTargetDeviation : 0|16@1+ (0.1,-3200) [-3200|3225.5] "mm" Vector__XXX
 SG_ PoweredVehicleWeight : 0|16@1+ (10,0) [0|642550] "kg" Vector__XXX
 SG_ GrossCombinationVehicleWeight : 16|16@1+ (10,0) [0|642550] "kg" Vector__XXX
 SG_ ForwardCollisionWarning : 54|2@1+ (1,0) [0|3] "" Vector__XXX
 SG_ ACCDistanceAlertSignal : 52|2@1+ (1,0) [0|3] "" Vector__XXX
 SG_ ACCSystemShutoffWarning : 50|2@1+ (1,0) [0|3] "" Vector__XXX
 SG_ ACCTargetDetected : 48|2@1+ (1,0) [0|3] "" Vector__XXX
 SG_ RoadCurvature : 32|16@1+ (0.0078125,-250) [-250|251.992] "1/km" Vector__XXX
 SG_ AdptveCruiseCtrlSetDistanceMode : 27|3@1+ (1,0) [0|7] "" Vector__XXX
 SG_ AdaptiveCruiseCtrlMode : 24|3@1+ (1,0) [0|7] "" Vector__XXX
 SG_ AdaptiveCruiseCtrlSetSpeed : 16|8@1+ (1,0) [0|250] "km/h" Vector__XXX
 SG_ DistanceToForwardVehicle : 8|8@1+ (1,0) [0|250] "m" Vector__XXX
 SG_ SpeedOfForwardVehicle : 0|8@1+ (1,0) [0|250] "km/h" Vector__XXX
 SG_ RearAxleRightWheelSpeed : 48|16@1+ (0.00390625,0) [0|250.996] "km/h" Vector__XXX
 SG_ RearAxleLeftWheelSpeed : 32|16@1+ (0.00390625,0) [0|250.996] "km/h" Vector__XXX
 SG_ FrontAxleRightWheelSpeed : 16|16@1+ (0.00390625,0) [0|250.996] "km/h" Vector__XXX
 SG_ FrontAxleLeftWheelSpeed : 0|16@1+ (0.00390625,0) [0|250.996] "km/h" Vector__XXX
 SG_ CabHeatingZone : 38|2@1+ (1,0) [0|3] "" Vector__XXX
 SG_ EngHeatingZone : 36|2@1+ (1,0) [0|3] "" Vector__XXX
 SG_ CabVentilation : 34|2@1+ (1,0) [0|3] "" Vector__XXX
 SG_ AuxHeaterMode : 24|4@1+ (1,0) [0|15] "" Vector__XXX
 SG_ AuxHeaterOutputPowerPercent : 16|8@1+ (0.4,0) [0|100] "%" Vector__XXX
 SG_ AuxHeaterInputAirTemp : 8|8@1+ (1,-40) [-40|210] "deg C" Vector__XXX
 SG_ AuxHeaterOutputCoolantTemp : 0|8@1+ (1,-40) [-40|210] "deg C" Vector__XXX
 SG_ AuxHeaterWaterPumpStatus : 32|2@1+ (1,0) [0|3] "" Vector__XXX
 SG_ VehicleOverspeed : 14|2@1+ (1,0) [0|3] "" Vector__XXX
 SG_ VehicleMotion : 6|2@1+ (1,0) [0|3] "" Vector__XXX
 SG_ TachographVehicleSpeed : 48|16@1+ (0.00390625,0) [0|250.996] "km/h" Vector__XXX
 SG_ TachographOutputShaftSpeed : 32|16@1+ (0.125,0) [0|8031.875] "rpm" Vector__XXX
 SG_ DirectionIndicator : 30|2@1+ (1,0) [0|3] "" Vector__XXX
 SG_ TachographPerformance : 28|2@1+ (1,0) [0|3] "" Vector__XXX
 SG_ HandlingInformation : 26|2@1+ (1,0) [0|3] "" Vector__XXX
 SG_ SystemEvent : 24|2@1+ (1,0) [0|3] "" Vector__XXX
 SG_ DriverCardDriver2 : 20|2@1+ (1,0) [0|3] "" Vector__XXX
 SG_ Driver2TimeRelatedStates : 16|4@1+ (1,0) [0|15] "" Vector__XXX
 SG_ DriverCardDriver1 : 12|2@1+ (1,0) [0|3] "" Vector__XXX
 SG_ Driver1TimeRelatedStates : 8|4@1+ (1,0) [0|15] "" Vector__XXX
 SG_ Driver2WorkingState : 3|3@1+ (1,0) [0|7] "" Vector__XXX
 SG_ Driver1WorkingState : 0|3@1+ (1,0) [0|7] "" Vector__XXX
 SG_ Driver2 : 8|8@1+ (1,0) [0|255] "" Vector__XXX
 SG_ Driver1 : 0|8@1+ (1,0) [0|255] "" Vector__XXX
 SG_ FuelPumpPrimerStatus : 51|2@1+ (1,0) [0|3] "" Vector__XXX
 SG_ EngFuelSupplyPumpIntakePress : 8|8@1+ (2,0) [0|500] "kPa" Vector__XXX
 SG_ EngFuelFilterDiffPress : 16|8@1+ (2,0) [0|500] "kPa" Vector__XXX
 SG_ EngOilLevelRemoteReservoir : 0|8@1+ (0.4,0) [0|100] "%" Vector__XXX
 SG_ EngWasteOilReservoirLevel : 24|8@1+ (0.4,0) [0|100] "%" Vector__XXX
 SG_ EngVentilationStatus : 48|3@1+ (1,0) [0|7] "" Vector__XXX
 SG_ EngOilPrimingState : 42|2@1+ (1,0) [0|3] "" Vector__XXX
 SG_ EngOilPrimingPumpSwitch : 40|2@1+ (1,0) [0|3] "" Vector__XXX
 SG_ EngOilPreHeatedState : 44|2@1+ (1,0) [0|3] "" Vector__XXX
 SG_ EngOilFilterOutletPress : 32|8@1+ (4,0) [0|1000] "kPa" Vector__XXX
 SG_ EngCoolantPreheatedState : 46|2@1+ (1,0) [0|3] "" Vector__XXX
 SG_ EngChargeAirCooler1OutletTemp : 48|16@1+ (0.03125,-273) [-273|1734.96875] "deg C" Vector__XXX
 SG_ EngIntkVlvActationSystemOilTemp : 32|16@1+ (0.03125,-273) [-273|1734.96875] "deg C" Vector__XXX
 SG_ EngIntakeManifold1AirTemp : 0|16@1+ (0.03125,-273) [-273|1734.96875] "deg C" Vector__XXX
 SG_ EngCoolantTempHiRes : 16|16@1+ (0.03125,-273) [-273|1734.96875] "deg C" Vector__XXX
 SG_ WinchOilPressSwitch : 10|2@1+ (1,0) [0|3] "" Vector__XXX
 SG_ HydOilLevel : 16|8@1+ (0.4,0) [0|100] "%" Vector__XXX
 SG_ HydOilFilterRestrictionSwitch : 8|2@1+ (1,0) [0|3] "" Vector__XXX
 SG_ HydTemp : 0|8@1+ (1,-40) [-40|210] "deg C" Vector__XXX
 SG_ AuxHeaterMaxOutputPower : 0|16@1+ (2,0) [0|128510] "W" Vector__XXX
 SG_ BatteryMainSwitchHoldState : 0|2@1+ (1,0) [0|3] "" Vector__XXX
 SG_ AmbientAirTemperature : 0|16@1+ (0.03125,-273) [-273|1735] "°C" Vector__XXX
 SG_ TrailerLeftSideMarkerLight : 20|2@1+ (1,0) [0|3] "" Vector__XXX
 SG_ TrailerLeftReversingLight : 16|2@1+ (1,0) [0|3] "" Vector__XXX
 SG_ TrailerLeftRearWidIndLight : 24|2@1+ (1,0) [0|3] "" Vector__XXX
 SG_ TrailerLeftRearRegPltLight : 32|2@1+ (1,0) [0|3] "" Vector__XXX
 SG_ TrailerLeftRearLight : 8|2@1+ (1,0) [0|3] "" Vector__XXX
 SG_ TrailerLeftRearFogLight : 12|2@1+ (1,0) [0|3] "" Vector__XXX
 SG_ TrailerLeftDirIndLight : 4|2@1+ (1,0) [0|3] "" Vector__XXX
 SG_ TrailerLeftCrnMarkerLight : 28|2@1+ (1,0) [0|3] "" Vector__XXX
 SG_ TrailerInteriorLight : 40|2@1+ (1,0) [0|3] "" Vector__XXX
 SG_ TrailerWorkLamp : 42|2@1+ (1,0) [0|3] "" Vector__XXX
 SG_ TrailerRotatingIdentLight : 38|2@1+ (1,0) [0|3] "" Vector__XXX
 SG_ TrailerRightStopLight : 2|2@1+ (1,0) [0|3] "" Vector__XXX
 SG_ TrailerRightSideMrkLight : 22|2@1+ (1,0) [0|3] "" Vector__XXX
 SG_ TrailerRightReversingLight : 18|2@1+ (1,0) [0|3] "" Vector__XXX
 SG_ TrailRightRearWidIndLight : 26|2@1+ (1,0) [0|3] "" Vector__XXX
 SG_ TrailerRightRearRegPltLight : 34|2@1+ (1,0) [0|3] "" Vector__XXX
 SG_ TrailerRightRearLight : 10|2@1+ (1,0) [0|3] "" Vector__XXX
 SG_ TrailerRightRearFogLight : 14|2@1+ (1,0) [0|3] "" Vector__XXX
 SG_ TrailerRightDirIndLight : 6|2@1+ (1,0) [0|3] "" Vector__XXX
 SG_ TrailerRightCrnMarkerLight : 30|2@1+ (1,0) [0|3] "" Vector__XXX
 SG_ TrailerRearWarningLight : 36|2@1+ (1,0) [0|3] "" Vector__XXX
 SG_ TrailerLeftStopLight : 0|2@1+ (1,0) [0|3] "" Vector__XXX
 SG_ ReferenceEngineTorque : 40|16@1+ (1,0) [0|64255] "Nm" Vector__XXX
 SG_ FuelLevelWarning : 37|2@1+ (1,0) [0|1] "" Vector__XXX
 SG_ EngineOilPressureWarning : 35|2@1+ (1,0) [0|1] "" Vector__XXX
 SG_ EngineCoolantTempWarning : 32|3@1+ (1,0) [0|2] "" Vector__XXX
 SG_ EngineOilPressure : 24|8@1+ (4,0) [0|1000] "kPa" Vector__XXX
 SG_ EngineCoolantTemperature : 16|8@1+ (1,-40) [-40|210] "°C" Vector__XXX
 SG_ EngineOilTemperature : 0|16@1+ (0.03125,-273) [-273|1735] "°C" Vector__XXX
 SG_ SecEngineMtdPTOSwitch : 30|2@1+ (1,0) [0|1] "" Vector__XXX
 SG_ SecClutchDpdtPTOSwitch : 24|2@1+ (1,0) [0|1] "" Vector__XXX
 SG_ FirstClutchDpdtPTOSwitch : 22|2@1+ (1,0) [0|1] "" Vector__XXX
 SG_ OperatingPanelActive : 18|2@1+ (1,0) [0|1] "" Vector__XXX
 SG_ RefusePackerStepSwitch : 16|2@1+ (1,0) [0|1] "" Vector__XXX
 SG_ EngineStopSwitch : 12|2@1+ (1,0) [0|1] "" Vector__XXX
 SG_ EngineStartSwitch : 10|2@1+ (1,0) [0|3] "" Vector__XXX
 SG_ StarterLockoutSwitch : 8|2@1+ (1,0) [0|1] "" Vector__XXX
 SG_ RqstedPercentClutchSlip : 0|8@1+ (0.4,0) [0|100] "%" Vector__XXX
 SG_ FirstEngineMtdPTOSwitch : 28|2@1+ (1,0) [0|1] "" Vector__XXX
 SG_ ClutchIndpdtPTOSwitch : 26|2@1+ (1,0) [0|1] "" Vector__XXX
 SG_ ClutchIndptdPTOFeedback : 20|2@1+ (1,0) [0|1] "" Vector__XXX
 SG_ AccelPedalPosition : 56|8@1+ (0.4,0) [0|100] "%" Vector__XXX
 SG_ AccelPedalLowIdleSwitch : 50|2@1+ (1,0) [0|1] "" Vector__XXX
 SG_ StarterActive : 48|2@1+ (1,0) [0|1] "" Vector__XXX
 SG_ TorqueConvOilTemp : 32|16@1+ (0.03125,-273) [-273|1735] "°C" Vector__XXX
 SG_ TorqueConvtOilTempWarning : 28|3@1+ (1,0) [0|2] "" Vector__XXX
 SG_ PTOControlAllowed : 26|2@1+ (1,0) [0|1] "" Vector__XXX
 SG_ SecEngineMtdPTOFeedback : 24|2@1+ (1,0) [0|1] "" Vector__XXX
 SG_ FirstEngineMtdPTOFeedback : 22|2@1+ (1,0) [0|1] "" Vector__XXX
 SG_ SecClutchDptdPTOFeedback : 18|2@1+ (1,0) [0|1] "" Vector__XXX
 SG_ FirstClutchDpdtPTOFeedback : 16|2@1+ (1,0) [0|1] "" Vector__XXX
 SG_ CurrentGear : 8|8@1+ (1,-125) [-125|125] "" Vector__XXX
 SG_ ReqEngineSpeedUpperLim : 16|16@1+ (0.125,0) [0|8031.875] "rpm" Vector__XXX
 SG_ ReqEngineSpeedLowerLim : 32|16@1+ (0.125,0) [0|8031.875] "rpm" Vector__XXX
 SG_ ReqEngineTorqueLimit : 48|8@1+ (1,-125) [-125|125] "%" Vector__XXX
 SG_ ReqEngineSpeedLimit : 56|8@1+ (1,0) [0|250] "km/hr" Vector__XXX
 SG_ ReqEngineSpeed : 0|16@1+ (0.125,0) [0|8031.875] "rpm" Vector__XXX
 SG_ EngineTorqueMode : 0|4@1+ (1,0) [0|15] "" Vector__XXX
 SG_ VehicleSpeed : 48|16@1+ (0.00390625,0) [0|250.996] "km/hr" Vector__XXX
 SG_ PercentLoadAtCurrentSpeed : 40|8@1+ (1,0) [0|125] "%" Vector__XXX
 SG_ EngineSpeed : 24|16@1+ (0.125,0) [0|8031.88] "rpm" Vector__XXX
 SG_ ActualEngine_PercTorque : 16|8@1+ (1,-125) [-125|125] "%" Vector__XXX
 SG_ DriversDemandEngine_PercTorque : 8|8@1+ (1,-125) [-125|125] "%" Vector__XXX
 SG_ EngineRunning : 6|2@1+ (1,0) [0|1] "" Vector__XXX
 SG_ EngineControlAllowed : 4|2@1+ (1,0) [0|1] "" Vector__XXX
 SG_ TyrePressThresholdDetect : 40|3@1+ (1,0) [0|7] "" Vector__XXX
 SG_ TyreModulePowerSupply : 43|2@1+ (1,0) [0|1] "" Vector__XXX
 SG_ TyreTemperature : 8|16@1+ (0.03125,-273) [-273|1735] "°C" Vector__XXX
 SG_ AirLeakageDetection : 24|16@1+ (0.1,0) [0|6425.5] "Pa/s" Vector__XXX
 SG_ TyreWheelIdentification2 : 4|4@1+ (1,0) [0|15] "" Vector__XXX
 SG_ TyreWheelIdentification1 : 0|4@1+ (1,0) [0|15] "" Vector__XXX
 SG_ MaxVehicleSpeedLimit : 32|8@1+ (1,0) [0|250] "km/h" Vector__XXX
 SG_ EngineSpeedUpperLimit : 0|16@1+ (0.125,0) [0|8031.875] "rpm" Vector__XXX
 SG_ EngineSpeedLowerLimit : 16|16@1+ (0.125,0) [0|8191.875] "rpm" Vector__XXX
 SG_ RelVehBodyLevelRearAxle : 16|16@1+ (1,0) [0|64255] "mm" Vector__XXX
 SG_ RelVehBodyLevelFrontAxle : 0|16@1+ (1,-32000) [-32000|32255] "mm" Vector__XXX
 SG_ LnDprtureIndicationEnableStatus : 6|2@1+ (1,0) [0|3] "" Vector__XXX
 SG_ LaneTrackingStatusLeftSide : 4|2@1+ (1,0) [0|3] "" Vector__XXX
 SG_ LaneTrackingStatusRightSide : 2|2@1+ (1,0) [0|3] "" Vector__XXX
 SG_ SpeedDependantLevelCtrlStatus : 54|2@1+ (1,0) [0|3] "" Vector__XXX
 SG_ MemoryLevel : 60|4@1+ (1,0) [0|15] "" Vector__XXX
 SG_ AllwLvelCtrlDuringBrakingStatus : 52|2@1+ (1,0) [0|3] "" Vector__XXX
 SG_ SspensionCtrlRefusalInformation : 56|4@1+ (1,0) [0|15] "" Vector__XXX
 SG_ SuspensionRemoteCtrl2 : 50|2@1+ (1,0) [0|3] "" Vector__XXX
 SG_ SuspensionRemoteCtrl1 : 48|2@1+ (1,0) [0|3] "" Vector__XXX
 SG_ RearAxleInBumperRange : 42|2@1+ (1,0) [0|3] "" Vector__XXX
 SG_ FrontAxleInBumperRange : 40|2@1+ (1,0) [0|3] "" Vector__XXX
 SG_ DoorRelease : 36|2@1+ (1,0) [0|3] "" Vector__XXX
 SG_ VehicleMotionInhibit : 34|2@1+ (1,0) [0|3] "" Vector__XXX
 SG_ SecurityDevice : 32|2@1+ (1,0) [0|3] "" Vector__XXX
 SG_ LevelCtrlMode : 28|4@1+ (1,0) [0|15] "" Vector__XXX
 SG_ KneelingInformation : 24|4@1+ (1,0) [0|15] "" Vector__XXX
 SG_ LiftingCtrlModeRearAxle : 22|2@1+ (1,0) [0|3] "" Vector__XXX
 SG_ LiftingCtrlModeFrontAxle : 20|2@1+ (1,0) [0|3] "" Vector__XXX
 SG_ LoweringCtrlModeRearAxle : 18|2@1+ (1,0) [0|3] "" Vector__XXX
 SG_ LoweringCtrlModeFrontAxle : 16|2@1+ (1,0) [0|3] "" Vector__XXX
 SG_ AboveNominalLevelRearAxle : 14|2@1+ (1,0) [0|3] "" Vector__XXX
 SG_ AboveNominalLevelFrontAxle : 12|2@1+ (1,0) [0|3] "" Vector__XXX
 SG_ BelowNominalLevelRearAxle : 10|2@1+ (1,0) [0|3] "" Vector__XXX
 SG_ BelowNominalLevelFrontAxle : 8|2@1+ (1,0) [0|3] "" Vector__XXX
 SG_ NominalLevelRearAxle : 4|4@1+ (1,0) [0|15] "" Vector__XXX
 SG_ NominalLevelFrontAxle : 0|4@1+ (1,0) [0|15] "" Vector__XXX
 SG_ RelativeLevelRearAxleRight : 48|16@1+ (0.1,-3200) [-3200|3225.5] "mm" Vector__XXX
 SG_ RelativeLevelRearAxleLeft : 32|16@1+ (0.1,-3200) [-3200|3225.5] "mm" Vector__XXX
 SG_ RelativeLevelFrontAxleRight : 16|16@1+ (0.1,-3200) [-3200|3225.5] "mm" Vector__XXX
 SG_ RelativeLevelFrontAxleLeft : 0|16@1+ (0.1,-3200) [-3200|3225.5] "mm" Vector__XXX
 SG_ BellowPressRearAxleRight : 48|16@1+ (0.1,0) [0|6425.5] "kPa" Vector__XXX
 SG_ BellowPressRearAxleLeft : 32|16@1+ (0.1,0) [0|6425.5] "kPa" Vector__XXX
 SG_ BellowPressFrontAxleRight : 16|16@1+ (0.1,0) [0|6425.5] "kPa" Vector__XXX
 SG_ BellowPressFrontAxleLeft : 0|16@1+ (0.1,0) [0|6425.5] "kPa" Vector__XXX
 SG_ ElctrncShckAbsrbrCtrlMdLft_TgAxl : 28|2@1+ (1,0) [0|3] "" Vector__XXX
 SG_ ElctrncShckAbsrbrCtrlMdRearAxle : 26|2@1+ (1,0) [0|3] "" Vector__XXX
 SG_ ElctrncShckAbsrbrCtrlMdFrntAxle : 24|2@1+ (1,0) [0|3] "" Vector__XXX
 SG_ DamperStiffnessLift_TagAxle : 16|8@1+ (0.4,0) [0|100] "%" Vector__XXX
 SG_ DamperStiffnessRearAxle : 8|8@1+ (0.4,0) [0|100] "%" Vector__XXX
 SG_ DamperStiffnessFrontAxle : 0|8@1+ (0.4,0) [0|100] "%" Vector__XXX
 SG_ Aftrtrtmnt1SCRCtlystRgntTnk1HtrP : 56|5@1+ (1,0) [0|31] "" Vector__XXX
 SG_ Aftrtrtmnt1SCRCtalystTankHeater : 48|8@1+ (0.4,0) [0|100] "%" Vector__XXX
 SG_ AftrtrtmntSCROprtrIndcmntSvrity : 45|3@1+ (1,0) [0|7] "" Vector__XXX
 SG_ Aftrtrtmnt1SCRCtlystRgntTnk1TmpP : 40|5@1+ (1,0) [0|31] "" Vector__XXX
 SG_ Aftrtrtmnt1DEFTnkLwLvlIndicator : 37|3@1+ (1,0) [0|7] "" Vector__XXX
 SG_ Aftrtrtmnt1SCRCtlystTnkLvlPrlmnr : 32|5@1+ (1,0) [0|31] "" Vector__XXX
 SG_ Aftrtrtmnt1SCRCtalystTankLevel2 : 16|16@1+ (0.1,0) [0|6425.5] "mm" Vector__XXX
 SG_ Aftrtrtment1SCRCatalystTankTemp : 8|8@1+ (1,-40) [-40|210] "deg C" Vector__XXX
 SG_ Aftrtrtmnt1SCRCatalystTankLevel : 0|8@1+ (0.4,0) [0|100] "%" Vector__XXX
 SG_ SpecificHeatRatio : 0|16@1+ (0.001,0) [0|64.255] "" Vector__XXX
 SG_ EngLwLmtThrshldFrMxTrqFrmEngine : 16|8@1+ (1,-125) [-125|125] "%" Vector__XXX
 SG_ EngLwLmtThrshldFrMxRPMFrmEngine : 0|8@1+ (32,0) [0|8000] "rpm" Vector__XXX
 SG_ EngHghLmtThrshldFrMnCntnsTrqFrmE : 24|8@1+ (1,-125) [-125|125] "%" Vector__XXX
 SG_ EngHghLmtThrshldFrMnCntnsEngnRPM : 8|8@1+ (32,0) [0|8000] "rpm" Vector__XXX
 SG_ EngMinContinuousTorque : 56|8@1+ (1,-125) [-125|125] "%" Vector__XXX
 SG_ EngMaxContinuousTorque : 48|8@1+ (1,-125) [-125|125] "%" Vector__XXX
 SG_ EngMinContinuousRPM : 40|8@1+ (32,0) [0|8000] "rpm" Vector__XXX
 SG_ EngMaxContinuousRPM : 32|8@1+ (32,0) [0|8000] "rpm" Vector__XXX
 SG_ MaxContinuousRetarderTorque : 48|8@1+ (1,-125) [-125|125] "%" Vector__XXX
 SG_ MinContinuousRetarderSpeed : 40|8@1+ (32,0) [0|8000] "rpm" Vector__XXX
 SG_ MaxContinuousRetarderSpeed : 32|8@1+ (32,0) [0|8000] "rpm" Vector__XXX
 SG_ MinContinuousRetarderTorque : 56|8@1+ (1,-125) [-125|125] "%" Vector__XXX
 SG_ LwLmtThrshldFrMxTrqFromRetarder : 16|8@1+ (1,-125) [-125|125] "%" Vector__XXX
 SG_ LwLmtThrshldFrMxRPMFromRetarder : 0|8@1+ (32,0) [0|8000] "rpm" Vector__XXX
 SG_ HghLmtThrshldFrMnCntnsTrqFrmRtrd : 24|8@1+ (1,-125) [-125|125] "%" Vector__XXX
 SG_ HghLmtThrshldFrMnCntnsRPMFrmRtrd : 8|8@1+ (32,0) [0|8000] "rpm" Vector__XXX
 SG_ NetBatteryCurrentHiRes : 16|16@1+ (0.05,-1600) [-1600|1612.75] "A" Vector__XXX
 SG_ AltCurrentHiRes : 0|16@1+ (0.05,-1600) [-1600|1676.75] "A" Vector__XXX
 SG_ ACCUsageDemand : 0|2@1+ (1,0) [0|3] "" Vector__XXX
 SG_ RqedACCDistanceMode : 5|3@1+ (1,0) [0|7] "" Vector__XXX
 SG_ Battery2Temp : 8|8@1+ (1,-40) [-40|210] "deg C" Vector__XXX
 SG_ Battery1Temp : 0|8@1+ (1,-40) [-40|210] "deg C" Vector__XXX
 SG_ YCBrakeCtrlActive : 14|2@1+ (1,0) [0|3] "" Vector__XXX
 SG_ YCEngCtrlActive : 12|2@1+ (1,0) [0|3] "" Vector__XXX
 SG_ ROPBrakeCtrlActive : 10|2@1+ (1,0) [0|3] "" Vector__XXX
 SG_ ROPEngCtrlActive : 8|2@1+ (1,0) [0|3] "" Vector__XXX
 SG_ VDCBrakeLightRq : 4|2@1+ (1,0) [0|3] "" Vector__XXX
 SG_ VDCFullyOperational : 2|2@1+ (1,0) [0|3] "" Vector__XXX
 SG_ VDCInformationSignal : 0|2@1+ (1,0) [0|3] "" Vector__XXX
 SG_ Status2OfDoors : 6|2@1+ (1,0) [0|3] "" Vector__XXX
 SG_ Ramp_WheelChairLiftPos : 4|2@1+ (1,0) [0|3] "" Vector__XXX
 SG_ PosOfDoors : 0|4@1+ (1,0) [0|15] "" Vector__XXX
 SG_ EngTotalAverageFuelEconomy : 16|16@1+ (0.001953125,0) [0|125.5] "km/L" Vector__XXX
 SG_ EngTotalAverageFuelRate : 0|16@1+ (0.05,0) [0|3212.75] "L/h" Vector__XXX
 SG_ OprtrsBlckOutIntensitySelection : 56|8@1+ (0.4,0) [0|100] "%" Vector__XXX
 SG_ BlackOutWorkLampSelect : 30|2@1+ (1,0) [0|3] "" Vector__XXX
 SG_ NightVisionIlluminatorSelect : 24|2@1+ (1,0) [0|3] "" Vector__XXX
 SG_ BlackOutBrake_StopLampSelect : 22|2@1+ (1,0) [0|3] "" Vector__XXX
 SG_ ConvoyDrivingLampSelect : 6|2@1+ (1,0) [0|3] "" Vector__XXX
 SG_ ConvoyLampSelect : 4|2@1+ (1,0) [0|3] "" Vector__XXX
 SG_ FrontBlackOutMarkerLampSelect : 2|2@1+ (1,0) [0|3] "" Vector__XXX
 SG_ RearBlackOutMarkerSelect : 0|2@1+ (1,0) [0|3] "" Vector__XXX
 SG_ TransTorqueLimit : 0|16@1+ (1,0) [0|64255] "Nm" Vector__XXX
 SG_ TrnsRvrseGearShiftInhibitStatus : 40|2@1+ (1,0) [0|3] "" Vector__XXX
 SG_ TrnsCrrntRangeDisplayBlankState : 0|2@1+ (1,0) [0|3] "" Vector__XXX
 SG_ TransWarningIndicator : 42|2@1+ (1,0) [0|3] "" Vector__XXX
 SG_ TransMode8Indicator : 38|2@1+ (1,0) [0|3] "" Vector__XXX
 SG_ TransMode7Indicator : 36|2@1+ (1,0) [0|3] "" Vector__XXX
 SG_ TransMode6Indicator : 34|2@1+ (1,0) [0|3] "" Vector__XXX
 SG_ TransMode5Indicator : 32|2@1+ (1,0) [0|3] "" Vector__XXX
 SG_ TransRqedGearFeedback : 24|8@1+ (1,-125) [-125|125] "" Vector__XXX
 SG_ TransMode1Indicator : 22|2@1+ (1,0) [0|3] "" Vector__XXX
 SG_ TransMode2Indicator : 20|2@1+ (1,0) [0|3] "" Vector__XXX
 SG_ TransMode3Indicator : 18|2@1+ (1,0) [0|3] "" Vector__XXX
 SG_ TransMode4Indicator : 16|2@1+ (1,0) [0|3] "" Vector__XXX
 SG_ TransShiftInhibitIndicator : 14|2@1+ (1,0) [0|3] "" Vector__XXX
 SG_ TransEngCrankEnable : 12|2@1+ (1,0) [0|3] "" Vector__XXX
 SG_ ActiveShiftConsoleIndicator : 10|2@1+ (1,0) [0|3] "" Vector__XXX
 SG_ TransReadyForBrakeRelease : 8|2@1+ (1,0) [0|3] "" Vector__XXX
 SG_ TransRqedRangeDisplayFlashState : 6|2@1+ (1,0) [0|3] "" Vector__XXX
 SG_ TransRqedRangeDisplayBlankState : 4|2@1+ (1,0) [0|3] "" Vector__XXX
 SG_ TransServiceIndicator : 2|2@1+ (1,0) [0|3] "" Vector__XXX
 SG_ ImplementRearWorkLightCmd : 62|2@1+ (1,0) [0|3] "" Vector__XXX
 SG_ ImplmentLeftForwardWorkLightCmd : 60|2@1+ (1,0) [0|3] "" Vector__XXX
 SG_ ImplmntRightForwardWorkLightCmd : 58|2@1+ (1,0) [0|3] "" Vector__XXX
 SG_ LightingDataRqCmd : 56|2@1+ (1,0) [0|3] "" Vector__XXX
 SG_ ImplementLeftFacingWorkLightCmd : 54|2@1+ (1,0) [0|3] "" Vector__XXX
 SG_ ImplmentRightFacingWorkLightCmd : 52|2@1+ (1,0) [0|3] "" Vector__XXX
 SG_ ImplementOEMOption1LightCmd : 50|2@1+ (1,0) [0|3] "" Vector__XXX
 SG_ ImplementOEMOption2LightCmd : 48|2@1+ (1,0) [0|3] "" Vector__XXX
 SG_ TrctrFrntHghMuntedWorkLightsCmd : 46|2@1+ (1,0) [0|3] "" Vector__XXX
 SG_ TrctrFrntLwMountedWorkLightsCmd : 44|2@1+ (1,0) [0|3] "" Vector__XXX
 SG_ TrctrSdHighMountedWorkLightsCmd : 42|2@1+ (1,0) [0|3] "" Vector__XXX
 SG_ TrctrSdeLowMountedWorkLightsCmd : 40|2@1+ (1,0) [0|3] "" Vector__XXX
 SG_ TrctrRrHighMountedWorkLightsCmd : 38|2@1+ (1,0) [0|3] "" Vector__XXX
 SG_ TrctrRarLowMountedWorkLightsCmd : 36|2@1+ (1,0) [0|3] "" Vector__XXX
 SG_ TrctrUndrsdMountedWorkLightsCmd : 34|2@1+ (1,0) [0|3] "" Vector__XXX
 SG_ RearFogLightCmd : 32|2@1+ (1,0) [0|3] "" Vector__XXX
 SG_ TractorMarkerLightCmd : 30|2@1+ (1,0) [0|3] "" Vector__XXX
 SG_ ImplementMarkerLightCmd : 28|2@1+ (1,0) [0|3] "" Vector__XXX
 SG_ TractorClearanceLightCmd : 26|2@1+ (1,0) [0|3] "" Vector__XXX
 SG_ ImplementClearanceLightCmd : 24|2@1+ (1,0) [0|3] "" Vector__XXX
 SG_ LeftStopLightCmd : 22|2@1+ (1,0) [0|3] "" Vector__XXX
 SG_ RightStopLightCmd : 20|2@1+ (1,0) [0|3] "" Vector__XXX
 SG_ CenterStopLightCmd : 18|2@1+ (1,0) [0|3] "" Vector__XXX
 SG_ BackUpLightAndAlarmHornCmd : 16|2@1+ (1,0) [0|3] "" Vector__XXX
 SG_ LeftTurnSignalLightsCmd : 14|2@1+ (1,0) [0|3] "" Vector__XXX
 SG_ RightTurnSignalLightsCmd : 12|2@1+ (1,0) [0|3] "" Vector__XXX
 SG_ RotatingBeaconLightCmd : 10|2@1+ (1,0) [0|3] "" Vector__XXX
 SG_ TractorFrontFogLightsCmd : 8|2@1+ (1,0) [0|3] "" Vector__XXX
 SG_ HighBeamHeadLightCmd : 6|2@1+ (1,0) [0|3] "" Vector__XXX
 SG_ LowBeamHeadLightCmd : 4|2@1+ (1,0) [0|3] "" Vector__XXX
 SG_ AltBeamHeadLightCmd : 2|2@1+ (1,0) [0|3] "" Vector__XXX
 SG_ RunningLightCmd : 0|2@1+ (1,0) [0|3] "" Vector__XXX
 SG_ ImplementRearWorkLight : 62|2@1+ (1,0) [0|3] "" Vector__XXX
 SG_ ImplementLeftForwardWorkLight : 60|2@1+ (1,0) [0|3] "" Vector__XXX
 SG_ ImplementRightForwardWorkLight : 58|2@1+ (1,0) [0|3] "" Vector__XXX
 SG_ ImplementLeftFacingWorkLight : 54|2@1+ (1,0) [0|3] "" Vector__XXX
 SG_ ImplementRightFacingWorkLight : 52|2@1+ (1,0) [0|3] "" Vector__XXX
 SG_ ImplementOEMOption1Light : 50|2@1+ (1,0) [0|3] "" Vector__XXX
 SG_ ImplementOEMOption2Light : 48|2@1+ (1,0) [0|3] "" Vector__XXX
 SG_ TrctrFrontHighMountedWorkLights : 46|2@1+ (1,0) [0|3] "" Vector__XXX
 SG_ TrctorFrontLowMountedWorkLights : 44|2@1+ (1,0) [0|3] "" Vector__XXX
 SG_ TrctorSideHighMountedWorkLights : 42|2@1+ (1,0) [0|3] "" Vector__XXX
 SG_ TractorSideLowMountedWorkLights : 40|2@1+ (1,0) [0|3] "" Vector__XXX
 SG_ TrctorRearHighMountedWorkLights : 38|2@1+ (1,0) [0|3] "" Vector__XXX
 SG_ TractorRearLowMountedWorkLights : 36|2@1+ (1,0) [0|3] "" Vector__XXX
 SG_ TrctrUndersideMountedWorkLights : 34|2@1+ (1,0) [0|3] "" Vector__XXX
 SG_ RearFogLights : 32|2@1+ (1,0) [0|3] "" Vector__XXX
 SG_ TractorMarkerLight : 30|2@1+ (1,0) [0|3] "" Vector__XXX
 SG_ ImplementMarkerLight : 28|2@1+ (1,0) [0|3] "" Vector__XXX
 SG_ TractorClearanceLight : 26|2@1+ (1,0) [0|3] "" Vector__XXX
 SG_ ImplementClearanceLight : 24|2@1+ (1,0) [0|3] "" Vector__XXX
 SG_ LeftStopLight : 22|2@1+ (1,0) [0|3] "" Vector__XXX
 SG_ RightStopLight : 20|2@1+ (1,0) [0|3] "" Vector__XXX
 SG_ CenterStopLight : 18|2@1+ (1,0) [0|3] "" Vector__XXX
 SG_ BackUpLightAndAlarmHorn : 16|2@1+ (1,0) [0|3] "" Vector__XXX
 SG_ LeftTurnSignalLights : 14|2@1+ (1,0) [0|3] "" Vector__XXX
 SG_ RightTurnSignalLights : 12|2@1+ (1,0) [0|3] "" Vector__XXX
 SG_ RotatingBeaconLight : 10|2@1+ (1,0) [0|3] "" Vector__XXX
 SG_ TractorFrontFogLights : 8|2@1+ (1,0) [0|3] "" Vector__XXX
 SG_ HighBeamHeadLightData : 6|2@1+ (1,0) [0|3] "" Vector__XXX
 SG_ LowBeamHeadLightData : 4|2@1+ (1,0) [0|3] "" Vector__XXX
 SG_ AltBeamHeadLightData : 2|2@1+ (1,0) [0|3] "" Vector__XXX
 SG_ RunningLight : 0|2@1+ (1,0) [0|3] "" Vector__XXX
 SG_ NumberOfMembers : 0|8@1+ (1,0) [0|0] "" Vector__XXX
 SG_ EngExhaustGasTempRightManifold : 0|16@1+ (0.03125,-273) [-273|1734.96875] "deg C" Vector__XXX
 SG_ EngExhaustGasTempLeftManifold : 16|16@1+ (0.03125,-273) [-273|1734.96875] "deg C" Vector__XXX
 SG_ GeneratorAverageACRMSCurrent : 48|16@1+ (1,0) [0|64255] "A" Vector__XXX
 SG_ GeneratorAverageACFrequency : 32|16@1+ (1,0) [0|501.9921875] "Hz" Vector__XXX
 SG_ GnrtrAvrgLneNeutralACRMSVoltage : 16|16@1+ (1,0) [0|64255] "V" Vector__XXX
 SG_ GnrtrAvrageLineLineACRMSVoltage : 0|16@1+ (1,0) [0|64255] "V" Vector__XXX
 SG_ GeneratorTotalApparentPower : 32|32@1+ (1,-2000000000) [-2000000000|2211081215] "VA" Vector__XXX
 SG_ GeneratorTotalRealPower : 0|32@1+ (1,-2000000000) [-2000000000|2211081215] "W" Vector__XXX
 SG_ GnrtorOverallPowerFactorLagging : 48|2@1+ (1,0) [0|3] "" Vector__XXX
 SG_ GeneratorOverallPowerFactor : 32|16@1+ (1,-1) [-1|2.92181] "" Vector__XXX
 SG_ GeneratorTotalReactivePower : 0|32@1+ (1,-2000000000) [-2000000000|2211081215] "VAr" Vector__XXX
 SG_ GeneratorPhaseAACRMSCurrent : 48|16@1+ (1,0) [0|64255] "A" Vector__XXX
 SG_ GeneratorPhaseAACFrequency : 32|16@1+ (1,0) [0|501.9921875] "Hz" Vector__XXX
 SG_ GnrtrPhsALneNeutralACRMSVoltage : 16|16@1+ (1,0) [0|64255] "V" Vector__XXX
 SG_ GnrtrPhseABLineLineACRMSVoltage : 0|16@1+ (1,0) [0|64255] "V" Vector__XXX
 SG_ GeneratorPhaseAApparentPower : 32|32@1+ (1,-2000000000) [-2000000000|2211081215] "VA" Vector__XXX
 SG_ GeneratorPhaseARealPower : 0|32@1+ (1,-2000000000) [-2000000000|2211081215] "W" Vector__XXX
 SG_ GnratorPhaseAPowerFactorLagging : 48|2@1+ (1,0) [0|3] "" Vector__XXX
 SG_ GeneratorPhaseAPowerFactor : 32|16@1+ (1,-1) [-1|2.92181] "" Vector__XXX
 SG_ GeneratorPhaseAReactivePower : 0|32@1+ (1,-2000000000) [-2000000000|2211081215] "VAr" Vector__XXX
 SG_ GeneratorPhaseBACRMSCurrent : 48|16@1+ (1,0) [0|64255] "A" Vector__XXX
 SG_ GeneratorPhaseBACFrequency : 32|16@1+ (1,0) [0|501.9921875] "Hz" Vector__XXX
 SG_ GnrtrPhsBLneNeutralACRMSVoltage : 16|16@1+ (1,0) [0|64255] "V" Vector__XXX
 SG_ GnrtrPhseBCLineLineACRMSVoltage : 0|16@1+ (1,0) [0|64255] "V" Vector__XXX
 SG_ GeneratorPhaseBApparentPower : 32|32@1+ (1,-2000000000) [-2000000000|2211081215] "VA" Vector__XXX
 SG_ GeneratorPhaseBRealPower : 0|32@1+ (1,-2000000000) [-2000000000|2211081215] "W" Vector__XXX
 SG_ GnratorPhaseBPowerFactorLagging : 48|2@1+ (1,0) [0|3] "" Vector__XXX
 SG_ GeneratorPhaseBPowerFactor : 32|16@1+ (1,-1) [-1|2.92181] "" Vector__XXX
 SG_ GeneratorPhaseBReactivePower : 0|32@1+ (1,-2000000000) [-2000000000|2211081215] "VAr" Vector__XXX
 SG_ GeneratorPhaseCACRMSCurrent : 48|16@1+ (1,0) [0|64255] "A" Vector__XXX
 SG_ GeneratorPhaseCACFrequency : 32|16@1+ (1,0) [0|501.9921875] "Hz" Vector__XXX
 SG_ GnrtrPhsCLneNeutralACRMSVoltage : 16|16@1+ (1,0) [0|64255] "V" Vector__XXX
 SG_ GnrtrPhseCALineLineACRMSVoltage : 0|16@1+ (1,0) [0|64255] "V" Vector__XXX
 SG_ GeneratorPhaseCApparentPower : 32|32@1+ (1,-2000000000) [-2000000000|2211081215] "VA" Vector__XXX
 SG_ GeneratorPhaseCRealPower : 0|32@1+ (1,-2000000000) [-2000000000|2211081215] "W" Vector__XXX
 SG_ GnratorPhaseCPowerFactorLagging : 48|2@1+ (1,0) [0|3] "" Vector__XXX
 SG_ GeneratorPhaseCPowerFactor : 32|16@1+ (1,-1) [-1|2.92181] "" Vector__XXX
 SG_ GeneratorPhaseCReactivePower : 0|32@1+ (1,-2000000000) [-2000000000|2211081215] "VAr" Vector__XXX
 SG_ GeneratorTotalKWHoursImport : 32|32@1+ (1,0) [0|4211081215] "kWh" Vector__XXX
 SG_ GeneratorTotalKWHoursExport : 0|32@1+ (1,0) [0|4211081215] "kWh" Vector__XXX
 SG_ UtilityAverageACRMSCurrent : 48|16@1+ (1,0) [0|64255] "A" Vector__XXX
 SG_ UtilityAverageACFrequency : 32|16@1+ (1,0) [0|501.9921875] "Hz" Vector__XXX
 SG_ UtltyAvrgLneNeutralACRMSVoltage : 16|16@1+ (1,0) [0|64255] "V" Vector__XXX
 SG_ UtltyAvrageLineLineACRMSVoltage : 0|16@1+ (1,0) [0|64255] "V" Vector__XXX
 SG_ UtilityTotalApparentPower : 32|32@1+ (1,-2000000000) [-2000000000|2211081215] "VA" Vector__XXX
 SG_ UtilityTotalRealPower : 0|32@1+ (1,-2000000000) [-2000000000|2211081215] "W" Vector__XXX
 SG_ UtlityOverallPowerFactorLagging : 48|2@1+ (1,0) [0|3] "" Vector__XXX
 SG_ UtilityOverallPowerFactor : 32|16@1+ (1,-1) [-1|2.92181] "" Vector__XXX
 SG_ UtilityTotalReactivePower : 0|32@1+ (1,-2000000000) [-2000000000|2211081215] "VAr" Vector__XXX
 SG_ UtilityPhaseAACRMSCurrent : 48|16@1+ (1,0) [0|64255] "A" Vector__XXX
 SG_ UtilityPhaseAACFrequency : 32|16@1+ (1,0) [0|501.9921875] "Hz" Vector__XXX
 SG_ UtltyPhsALneNeutralACRMSVoltage : 16|16@1+ (1,0) [0|64255] "V" Vector__XXX
 SG_ UtltyPhseABLineLineACRMSVoltage : 0|16@1+ (1,0) [0|64255] "V" Vector__XXX
 SG_ UtilityPhaseAApparentPower : 32|32@1+ (1,-2000000000) [-2000000000|2211081215] "VA" Vector__XXX
 SG_ UtilityPhaseARealPower : 0|32@1+ (1,-2000000000) [-2000000000|2211081215] "W" Vector__XXX
 SG_ UtilityPhaseAPowerFactorLagging : 48|2@1+ (1,0) [0|3] "" Vector__XXX
 SG_ UtilityPhaseAPowerFactor : 32|16@1+ (1,-1) [-1|2.92181] "" Vector__XXX
 SG_ UtilityPhaseAReactivePower : 0|32@1+ (1,-2000000000) [-2000000000|2211081215] "VAr" Vector__XXX
 SG_ UtilityPhaseBACRMSCurrent : 48|16@1+ (1,0) [0|64255] "A" Vector__XXX
 SG_ UtilityPhaseBACFrequency : 32|16@1+ (1,0) [0|501.9921875] "Hz" Vector__XXX
 SG_ UtltyPhsBLneNeutralACRMSVoltage : 16|16@1+ (1,0) [0|64255] "V" Vector__XXX
 SG_ UtltyPhseBCLineLineACRMSVoltage : 0|16@1+ (1,0) [0|64255] "V" Vector__XXX
 SG_ UtilityPhaseBApparentPower : 32|32@1+ (1,-2000000000) [-2000000000|2211081215] "VA" Vector__XXX
 SG_ UtilityPhaseBRealPower : 0|32@1+ (1,-2000000000) [-2000000000|2211081215] "W" Vector__XXX
 SG_ UtilityPhaseBPowerFactorLagging : 48|2@1+ (1,0) [0|3] "" Vector__XXX
 SG_ UtilityPhaseBPowerFactor : 32|16@1+ (1,-1) [-1|2.92181] "" Vector__XXX
 SG_ UtilityPhaseBReactivePower : 0|32@1+ (1,-2000000000) [-2000000000|2211081215] "VAr" Vector__XXX
 SG_ UtilityPhaseCACRMSCurrent : 48|16@1+ (1,0) [0|64255] "A" Vector__XXX
 SG_ UtilityPhaseCACFrequency : 32|16@1+ (1,0) [0|501.9921875] "Hz" Vector__XXX
 SG_ UtltyPhsCLneNeutralACRMSVoltage : 16|16@1+ (1,0) [0|64255] "V" Vector__XXX
 SG_ UtltyPhseCALineLineACRMSVoltage : 0|16@1+ (1,0) [0|64255] "V" Vector__XXX
 SG_ UtilityPhaseCApparentPower : 32|32@1+ (1,-2000000000) [-2000000000|2211081215] "VA" Vector__XXX
 SG_ UtilityPhaseCRealPower : 0|32@1+ (1,-2000000000) [-2000000000|2211081215] "W" Vector__XXX
 SG_ UtilityPhaseCPowerFactorLagging : 48|2@1+ (1,0) [0|3] "" Vector__XXX
 SG_ UtilityPhaseCPowerFactor : 32|16@1+ (1,-1) [-1|2.92181] "" Vector__XXX
 SG_ UtilityPhaseCReactivePower : 0|32@1+ (1,-2000000000) [-2000000000|2211081215] "VAr" Vector__XXX
 SG_ UtilityTotalKWHoursImport : 32|32@1+ (1,0) [0|4211081215] "kWh" Vector__XXX
 SG_ UtilityTotalKWHoursExport : 0|32@1+ (1,0) [0|4211081215] "kWh" Vector__XXX
 SG_ Bus1AverageACFrequency : 32|16@1+ (1,0) [0|501.9921875] "Hz" Vector__XXX
 SG_ Bs1AvrgeLineNeutralACRMSVoltage : 16|16@1+ (1,0) [0|64255] "V" Vector__XXX
 SG_ Bus1AverageLineLineACRMSVoltage : 0|16@1+ (1,0) [0|64255] "V" Vector__XXX
 SG_ Bus1PhaseAACFrequency : 32|16@1+ (1,0) [0|501.9921875] "Hz" Vector__XXX
 SG_ Bs1PhseALineNeutralACRMSVoltage : 16|16@1+ (1,0) [0|64255] "V" Vector__XXX
 SG_ Bus1PhaseABLineLineACRMSVoltage : 0|16@1+ (1,0) [0|64255] "V" Vector__XXX
 SG_ Bus1PhaseBACFrequency : 32|16@1+ (1,0) [0|501.9921875] "Hz" Vector__XXX
 SG_ Bs1PhseBLineNeutralACRMSVoltage : 16|16@1+ (1,0) [0|64255] "V" Vector__XXX
 SG_ Bus1PhaseBCLineLineACRMSVoltage : 0|16@1+ (1,0) [0|64255] "V" Vector__XXX
 SG_ Bus1PhaseCACFrequency : 32|16@1+ (1,0) [0|501.9921875] "Hz" Vector__XXX
 SG_ Bs1PhseCLineNeutralACRMSVoltage : 16|16@1+ (1,0) [0|64255] "V" Vector__XXX
 SG_ Bus1PhaseCALineLineACRMSVoltage : 0|16@1+ (1,0) [0|64255] "V" Vector__XXX
 SG_ Bus1_GeneratorACPhaseDifference : 16|16@1+ (1,-200) [-200|301.99] "deg" Vector__XXX
 SG_ Bus1_GeneratorInSync : 8|2@1+ (1,0) [0|3] "" Vector__XXX
 SG_ Bus1_GeneratorVoltageMatch : 6|2@1+ (1,0) [0|3] "" Vector__XXX
 SG_ Bus1_GeneratorFrequencyMatch : 4|2@1+ (1,0) [0|3] "" Vector__XXX
 SG_ Bus1_GeneratorPhaseMatch : 2|2@1+ (1,0) [0|3] "" Vector__XXX
 SG_ Bus1_GeneratorDeadBus : 0|2@1+ (1,0) [0|3] "" Vector__XXX
 SG_ Bus1_UtilityACPhaseDifference : 16|16@1+ (1,-200) [-200|301.99] "deg" Vector__XXX
 SG_ Bus1_UtilityInSync : 8|2@1+ (1,0) [0|3] "" Vector__XXX
 SG_ Bus1_UtilityVoltageMatch : 6|2@1+ (1,0) [0|3] "" Vector__XXX
 SG_ Bus1_UtilityFrequencyMatch : 4|2@1+ (1,0) [0|3] "" Vector__XXX
 SG_ Bus1_UtilityPhaseMatch : 2|2@1+ (1,0) [0|3] "" Vector__XXX
 SG_ Bus1_UtilityDeadBus : 0|2@1+ (1,0) [0|3] "" Vector__XXX
 SG_ HydBrakeFluidLevelSwitch : 26|2@1+ (1,0) [0|3] "" Vector__XXX
 SG_ HydBrakeSystemAudibleWarningCmd : 24|2@1+ (1,0) [0|3] "" Vector__XXX
 SG_ HydBrkePressSupplyStateCircuit2 : 22|2@1+ (1,0) [0|3] "" Vector__XXX
 SG_ HydBrkePressSupplyStateCircuit1 : 20|2@1+ (1,0) [0|3] "" Vector__XXX
 SG_ HydBrkPressWarningStateCircuit2 : 18|2@1+ (1,0) [0|3] "" Vector__XXX
 SG_ HydBrkPressWarningStateCircuit1 : 16|2@1+ (1,0) [0|3] "" Vector__XXX
 SG_ HydBrakePressCircuit2 : 8|8@1+ (100,0) [0|25] "MPa" Vector__XXX
 SG_ HydBrakePressCircuit1 : 0|8@1+ (100,0) [0|25] "MPa" Vector__XXX
 SG_ AppliedVehicleSpeedLimit : 56|8@1+ (1,0) [0|250] "km/h" Vector__XXX
 SG_ MaxVehicleSpeedLimit7 : 48|8@1+ (1,0) [0|250] "km/h" Vector__XXX
 SG_ MaxVehicleSpeedLimit6 : 40|8@1+ (1,0) [0|250] "km/h" Vector__XXX
 SG_ MaxVehicleSpeedLimit5 : 32|8@1+ (1,0) [0|250] "km/h" Vector__XXX
 SG_ MaxVehicleSpeedLimit4 : 24|8@1+ (1,0) [0|250] "km/h" Vector__XXX
 SG_ MaxVehicleSpeedLimit3 : 16|8@1+ (1,0) [0|250] "km/h" Vector__XXX
 SG_ MaxVehicleSpeedLimit2 : 8|8@1+ (1,0) [0|250] "km/h" Vector__XXX
 SG_ MaxVehicleSpeedLimit1 : 0|8@1+ (1,0) [0|250] "km/h" Vector__XXX
 SG_ PayloadPercentage : 0|8@1+ (1,0) [0|250] "%" Vector__XXX
 SG_ TravelVelocityCtrlPos : 0|8@1+ (1,-125) [-125|125] "%" Vector__XXX
 SG_ AirSuspensionSupplyPressRq : 40|8@1+ (8,0) [0|2000] "kPa" Vector__XXX
 SG_ AuxEquipmentSupplyPressRq : 32|8@1+ (8,0) [0|2000] "kPa" Vector__XXX
 SG_ ServiceBrakeAirPressRqCircuit2 : 24|8@1+ (8,0) [0|2000] "kPa" Vector__XXX
 SG_ ServiceBrakeAirPressRqCircuit1 : 16|8@1+ (8,0) [0|2000] "kPa" Vector__XXX
 SG_ ParkingAnd_OrTrailerAirPressRq : 8|8@1+ (8,0) [0|2000] "kPa" Vector__XXX
 SG_ PneumaticSupplyPressRq : 0|8@1+ (8,0) [0|2000] "kPa" Vector__XXX
 SG_ CbA_CRfrgrntCmprssorOutletPress : 0|8@1+ (16,0) [0|4000] "kPa" Vector__XXX
 SG_ SpecificHumidity : 16|16@1+ (0.01,0) [0|642.55] "g/kg" Vector__XXX
 SG_ SolarSensorMax : 8|8@1+ (0.4,0) [0|100] "mW/cm²" Vector__XXX
 SG_ SolarIntensityPercent : 0|8@1+ (0.4,0) [0|100] "%" Vector__XXX
 SG_ FrontWheelDriveActuatorStatus : 0|2@1+ (1,0) [0|3] "" Vector__XXX
 SG_ SlowVesselModeStatus : 6|2@1+ (1,0) [0|3] "" Vector__XXX
 SG_ TrollingModeStatus : 4|2@1+ (1,0) [0|3] "" Vector__XXX
 SG_ EngThrttlSynchrnztionModeStatus : 0|4@1+ (1,0) [0|15] "" Vector__XXX
 SG_ Jystck3GripXAxisDetentPosStatus : 54|2@1+ (1,0) [0|3] "" Vector__XXX
 SG_ Jystck3GripYAxisDetentPosStatus : 52|2@1+ (1,0) [0|3] "" Vector__XXX
 SG_ Jystck3ThetaAxisDetentPosStatus : 50|2@1+ (1,0) [0|3] "" Vector__XXX
 SG_ Joystick3ThetaAxisPos : 38|10@1+ (0.1,0) [0|102] "%" Vector__XXX
 SG_ Jystck3ThtAxsClckwsPstvPsStatus : 36|2@1+ (1,0) [0|3] "" Vector__XXX
 SG_ Jystck3ThtaAxisNeutralPosStatus : 32|2@1+ (1,0) [0|3] "" Vector__XXX
 SG_ Joystick3GripYAxisPos : 22|10@1+ (0.1,0) [0|102] "%" Vector__XXX
 SG_ Jystck3GrpYAxsLvrFrwrdPstvPsStts : 20|2@1+ (1,0) [0|3] "" Vector__XXX
 SG_ Jystck3GrpYAxsLvrBckNgtvPsSttus : 18|2@1+ (1,0) [0|3] "" Vector__XXX
 SG_ Jystck3GrpYAxisNeutralPosStatus : 16|2@1+ (1,0) [0|3] "" Vector__XXX
 SG_ Joystick3GripXAxisPos : 6|10@1+ (0.1,0) [0|102] "%" Vector__XXX
 SG_ Jystck3GrpXAxsLvrRghtPstvPsStts : 4|2@1+ (1,0) [0|3] "" Vector__XXX
 SG_ Jystck3GrpXAxsLvrLftNgtvPsSttus : 2|2@1+ (1,0) [0|3] "" Vector__XXX
 SG_ Jystck3GrpXAxisNeutralPosStatus : 0|2@1+ (1,0) [0|3] "" Vector__XXX
 SG_ Jystck3ThtAxsCntrClckwsNgtvPsStt : 34|2@1+ (1,0) [0|3] "" Vector__XXX
 SG_ Joystick3XAxisDetentPosStatus : 38|2@1+ (1,0) [0|3] "" Vector__XXX
 SG_ Joystick3Button9PressedStatus : 62|2@1+ (1,0) [0|3] "" Vector__XXX
 SG_ Joystick3Button10PressedStatus : 60|2@1+ (1,0) [0|3] "" Vector__XXX
 SG_ Joystick3Button11PressedStatus : 58|2@1+ (1,0) [0|3] "" Vector__XXX
 SG_ Joystick3Button12PressedStatus : 56|2@1+ (1,0) [0|3] "" Vector__XXX
 SG_ Joystick3YAxisDetentPosStatus : 36|2@1+ (1,0) [0|3] "" Vector__XXX
 SG_ Joystick3YAxisPos : 22|10@1+ (0.1,0) [0|102] "%" Vector__XXX
 SG_ Jystck3YAxsLvrFrwrdPstvPsStatus : 20|2@1+ (1,0) [0|3] "" Vector__XXX
 SG_ Jystck3YAxsLvrBckNgtvePosStatus : 18|2@1+ (1,0) [0|3] "" Vector__XXX
 SG_ Joystick3YAxisNeutralPosStatus : 16|2@1+ (1,0) [0|3] "" Vector__XXX
 SG_ Joystick3XAxisPos : 6|10@1+ (0.1,0) [0|102] "%" Vector__XXX
 SG_ Jystck3XAxsLvrRghtPstvPosStatus : 4|2@1+ (1,0) [0|3] "" Vector__XXX
 SG_ Jystck3XAxsLvrLftNgtvePosStatus : 2|2@1+ (1,0) [0|3] "" Vector__XXX
 SG_ Joystick3XAxisNeutralPosStatus : 0|2@1+ (1,0) [0|3] "" Vector__XXX
 SG_ Joystick3Button5PressedStatus : 54|2@1+ (1,0) [0|3] "" Vector__XXX
 SG_ Joystick3Button6PressedStatus : 52|2@1+ (1,0) [0|3] "" Vector__XXX
 SG_ Joystick3Button7PressedStatus : 50|2@1+ (1,0) [0|3] "" Vector__XXX
 SG_ Joystick3Button8PressedStatus : 48|2@1+ (1,0) [0|3] "" Vector__XXX
 SG_ Joystick3Button1PressedStatus : 46|2@1+ (1,0) [0|3] "" Vector__XXX
 SG_ Joystick3Button2PressedStatus : 44|2@1+ (1,0) [0|3] "" Vector__XXX
 SG_ Joystick3Button3PressedStatus : 42|2@1+ (1,0) [0|3] "" Vector__XXX
 SG_ Joystick3Button4PressedStatus : 40|2@1+ (1,0) [0|3] "" Vector__XXX
 SG_ Jystck2GripXAxisDetentPosStatus : 54|2@1+ (1,0) [0|3] "" Vector__XXX
 SG_ Jystck2GripYAxisDetentPosStatus : 52|2@1+ (1,0) [0|3] "" Vector__XXX
 SG_ Jystck2ThetaAxisDetentPosStatus : 50|2@1+ (1,0) [0|3] "" Vector__XXX
 SG_ Joystick2ThetaAxisPos : 38|10@1+ (0.1,0) [0|102] "%" Vector__XXX
 SG_ Jystck2ThtAxsClckwsPstvPsStatus : 36|2@1+ (1,0) [0|3] "" Vector__XXX
 SG_ Jystck2ThtaAxisNeutralPosStatus : 32|2@1+ (1,0) [0|3] "" Vector__XXX
 SG_ Joystick2GripYAxisPos : 22|10@1+ (0.1,0) [0|102] "%" Vector__XXX
 SG_ Jystck2GrpYAxsLvrFrwrdPstvPsStts : 20|2@1+ (1,0) [0|3] "" Vector__XXX
 SG_ Jystck2GrpYAxsLvrBckNgtvPsSttus : 18|2@1+ (1,0) [0|3] "" Vector__XXX
 SG_ Jystck2GrpYAxisNeutralPosStatus : 16|2@1+ (1,0) [0|3] "" Vector__XXX
 SG_ Joystick2GripXAxisPos : 6|10@1+ (0.1,0) [0|102] "%" Vector__XXX
 SG_ Jystck2GrpXAxsLvrRghtPstvPsStts : 4|2@1+ (1,0) [0|3] "" Vector__XXX
 SG_ Jystck2GrpXAxsLvrLftNgtvPsSttus : 2|2@1+ (1,0) [0|3] "" Vector__XXX
 SG_ Jystck2GrpXAxisNeutralPosStatus : 0|2@1+ (1,0) [0|3] "" Vector__XXX
 SG_ Jystck2ThtAxsCntrClckwsNgtvPsStt : 34|2@1+ (1,0) [0|3] "" Vector__XXX
 SG_ Joystick2XAxisDetentPosStatus : 38|2@1+ (1,0) [0|3] "" Vector__XXX
 SG_ Joystick2YAxisDetentPosStatus : 36|2@1+ (1,0) [0|3] "" Vector__XXX
 SG_ Joystick2YAxisPos : 22|10@1+ (0.1,0) [0|102] "%" Vector__XXX
 SG_ Jystck2YAxsLvrFrwrdPstvPsStatus : 20|2@1+ (1,0) [0|3] "" Vector__XXX
 SG_ Jystck2YAxsLvrBckNgtvePosStatus : 18|2@1+ (1,0) [0|3] "" Vector__XXX
 SG_ Joystick2YAxisNeutralPosStatus : 16|2@1+ (1,0) [0|3] "" Vector__XXX
 SG_ Joystick2XAxisPos : 6|10@1+ (0.1,0) [0|102] "%" Vector__XXX
 SG_ Jystck2XAxsLvrRghtPstvPosStatus : 4|2@1+ (1,0) [0|3] "" Vector__XXX
 SG_ Jystck2XAxsLvrLftNgtvePosStatus : 2|2@1+ (1,0) [0|3] "" Vector__XXX
 SG_ Joystick2XAxisNeutralPosStatus : 0|2@1+ (1,0) [0|3] "" Vector__XXX
 SG_ Joystick2Button9PressedStatus : 62|2@1+ (1,0) [0|3] "" Vector__XXX
 SG_ Joystick2Button10PressedStatus : 60|2@1+ (1,0) [0|3] "" Vector__XXX
 SG_ Joystick2Button11PressedStatus : 58|2@1+ (1,0) [0|3] "" Vector__XXX
 SG_ Joystick2Button12PressedStatus : 56|2@1+ (1,0) [0|3] "" Vector__XXX
 SG_ Joystick2Button5PressedStatus : 54|2@1+ (1,0) [0|3] "" Vector__XXX
 SG_ Joystick2Button6PressedStatus : 52|2@1+ (1,0) [0|3] "" Vector__XXX
 SG_ Joystick2Button7PressedStatus : 50|2@1+ (1,0) [0|3] "" Vector__XXX
 SG_ Joystick2Button8PressedStatus : 48|2@1+ (1,0) [0|3] "" Vector__XXX
 SG_ Joystick2Button1PressedStatus : 46|2@1+ (1,0) [0|3] "" Vector__XXX
 SG_ Joystick2Button2PressedStatus : 44|2@1+ (1,0) [0|3] "" Vector__XXX
 SG_ Joystick2Button3PressedStatus : 42|2@1+ (1,0) [0|3] "" Vector__XXX
 SG_ Joystick2Button4PressedStatus : 40|2@1+ (1,0) [0|3] "" Vector__XXX
 SG_ Jystck1GripXAxisDetentPosStatus : 54|2@1+ (1,0) [0|3] "" Vector__XXX
 SG_ Jystck1GripYAxisDetentPosStatus : 52|2@1+ (1,0) [0|3] "" Vector__XXX
 SG_ Jystck1ThetaAxisDetentPosStatus : 50|2@1+ (1,0) [0|3] "" Vector__XXX
 SG_ Joystick1ThetaAxisPos : 38|10@1+ (0.1,0) [0|102] "%" Vector__XXX
 SG_ Jystck1ThtAxsClckwsPstvPsStatus : 36|2@1+ (1,0) [0|3] "" Vector__XXX
 SG_ Jystck1ThtaAxisNeutralPosStatus : 32|2@1+ (1,0) [0|3] "" Vector__XXX
 SG_ Joystick1GripYAxisPos : 22|10@1+ (0.1,0) [0|102] "%" Vector__XXX
 SG_ Jystck1GrpYAxsLvrFrwrdPstvPsStts : 20|2@1+ (1,0) [0|3] "" Vector__XXX
 SG_ Jystck1GrpYAxsLvrBckNgtvPsSttus : 18|2@1+ (1,0) [0|3] "" Vector__XXX
 SG_ Jystck1GrpYAxisNeutralPosStatus : 16|2@1+ (1,0) [0|3] "" Vector__XXX
 SG_ Joystick1GripXAxisPos : 6|10@1+ (0.1,0) [0|102] "%" Vector__XXX
 SG_ Jystck1GrpXAxsLvrRghtPstvPsStts : 4|2@1+ (1,0) [0|3] "" Vector__XXX
 SG_ Jystck1GrpXAxsLvrLftNgtvPsSttus : 2|2@1+ (1,0) [0|3] "" Vector__XXX
 SG_ Jystck1GrpXAxisNeutralPosStatus : 0|2@1+ (1,0) [0|3] "" Vector__XXX
 SG_ Jystck1ThtAxsCntrClckwsNgtvPsStt : 34|2@1+ (1,0) [0|3] "" Vector__XXX
 SG_ Joystick1XAxisDetentPosStatus : 38|2@1+ (1,0) [0|3] "" Vector__XXX
 SG_ Joystick1YAxisDetentPosStatus : 36|2@1+ (1,0) [0|3] "" Vector__XXX
 SG_ Joystick1YAxisPos : 22|10@1+ (0.1,0) [0|102] "%" Vector__XXX
 SG_ Jystck1YAxsLvrFrwrdPstvPsStatus : 20|2@1+ (1,0) [0|3] "" Vector__XXX
 SG_ Jystck1YAxsLvrBckNgtvePosStatus : 18|2@1+ (1,0) [0|3] "" Vector__XXX
 SG_ Joystick1YAxisNeutralPosStatus : 16|2@1+ (1,0) [0|3] "" Vector__XXX
 SG_ Joystick1XAxisPos : 6|10@1+ (0.1,0) [0|102] "%" Vector__XXX
 SG_ Joystick1Button9PressedStatus : 62|2@1+ (1,0) [0|3] "" Vector__XXX
 SG_ Joystick1Button10PressedStatus : 60|2@1+ (1,0) [0|3] "" Vector__XXX
 SG_ Joystick1Button11PressedStatus : 58|2@1+ (1,0) [0|3] "" Vector__XXX
 SG_ Joystick1Button12PressedStatus : 56|2@1+ (1,0) [0|3] "" Vector__XXX
 SG_ Joystick1Button5PressedStatus : 54|2@1+ (1,0) [0|3] "" Vector__XXX
 SG_ Joystick1Button6PressedStatus : 52|2@1+ (1,0) [0|3] "" Vector__XXX
 SG_ Joystick1Button7PressedStatus : 50|2@1+ (1,0) [0|3] "" Vector__XXX
 SG_ Joystick1Button8PressedStatus : 48|2@1+ (1,0) [0|3] "" Vector__XXX
 SG_ Joystick1Button1PressedStatus : 46|2@1+ (1,0) [0|3] "" Vector__XXX
 SG_ Joystick1Button2PressedStatus : 44|2@1+ (1,0) [0|3] "" Vector__XXX
 SG_ Joystick1Button3PressedStatus : 42|2@1+ (1,0) [0|3] "" Vector__XXX
 SG_ Joystick1Button4PressedStatus : 40|2@1+ (1,0) [0|3] "" Vector__XXX
 SG_ Jystck1XAxsLvrRghtPstvPosStatus : 4|2@1+ (1,0) [0|3] "" Vector__XXX
 SG_ Jystck1XAxsLvrLftNgtvePosStatus : 2|2@1+ (1,0) [0|3] "" Vector__XXX
 SG_ Joystick1XAxisNeutralPosStatus : 0|2@1+ (1,0) [0|3] "" Vector__XXX
 SG_ EngVrableGeometryTurbo1CtrlMode : 52|2@1+ (1,0) [0|3] "" Vector__XXX
 SG_ EngTrb1ClcltedTurbineIntakeTemp : 0|16@1+ (0.03125,-273) [-273|1734.96875] "deg C" Vector__XXX
 SG_ EngExhstGsRcrculation1ValveCtrl : 32|16@1+ (0.0025,0) [0|160.6375] "%" Vector__XXX
 SG_ EngVrblGometryTurbo1ActuatorPos : 56|8@1+ (0.4,0) [0|100] "%" Vector__XXX
 SG_ EngVrblGmtryTrbArCtrlShtffValve : 48|2@1+ (1,0) [0|3] "" Vector__XXX
 SG_ EngTrb1ClcltedTurbineOutletTemp : 16|16@1+ (0.03125,-273) [-273|1734.96875] "deg C" Vector__XXX
 SG_ TransOilLevelRq : 16|2@1+ (1,0) [0|3] "" Vector__XXX
 SG_ FifthWheelReleaseCtrl : 8|2@1+ (1,0) [0|3] "" Vector__XXX
 SG_ FfthWhlRlaseCtrlSecurityLockout : 10|2@1+ (1,0) [0|3] "" Vector__XXX
 SG_ TransferCaseSelectorSwitch : 0|3@1+ (1,0) [0|7] "" Vector__XXX
 SG_ EngTurbo4CompressorOutletTemp : 48|16@1+ (0.03125,-273) [-273|1734.96875] "deg C" Vector__XXX
 SG_ EngTurbo3CompressorOutletTemp : 32|16@1+ (0.03125,-273) [-273|1734.96875] "deg C" Vector__XXX
 SG_ EngTurbo2CompressorOutletTemp : 16|16@1+ (0.03125,-273) [-273|1734.96875] "deg C" Vector__XXX
 SG_ EngTurbo1CompressorOutletTemp : 0|16@1+ (0.03125,-273) [-273|1734.96875] "deg C" Vector__XXX
 SG_ DataMemoryUsage : 16|8@1+ (0.4,0) [0|100] "%" Vector__XXX
 SG_ KeepAliveBatteryConsumption : 0|16@1+ (1,0) [0|64255] "mAhr" Vector__XXX
 SG_ FMSstandardSWversionSupported : 8|32@1+ (1,0) [0|255] "per" Vector__XXX
 SG_ FMSstandardRqsSupported : 2|2@1+ (1,0) [0|3] "" Vector__XXX
 SG_ FMSstandardDiagnosticsSupported : 0|2@1+ (1,0) [0|3] "" Vector__XXX
 SG_ EngAirFilter4DiffPress : 16|8@1+ (0.05,0) [0|12.5] "kPa" Vector__XXX
 SG_ EngAirFilter3DiffPress : 8|8@1+ (0.05,0) [0|12.5] "kPa" Vector__XXX
 SG_ EngAirFilter2DiffPress : 0|8@1+ (0.05,0) [0|12.5] "kPa" Vector__XXX
 SG_ EngIntakeManifold1AbsPress : 32|8@1+ (0.1,0) [0|25.5] "kPa" Vector__XXX
 SG_ EngIntakeManifold2AbsPress : 56|8@1+ (2,0) [0|500] "kPa" Vector__XXX
 SG_ EngineCoolantTemperature : 80|8@1+ (1,-40) [-40|210] "°C" Vector__XXX
 SG_ RoadCurvature : 32|16@1+ (0.0078125,-250) [-250|251.992] "1/km" Vector__XXX
 SG_ MaxVehicleSpeedLimit : 0|8@1+ (1,0) [0|250] "km/h" Vector__XXX
 SG_ EngFuelFilterDiffPress : 16|8@1+ (2,0) [0|500] "kPa" Vector__XXX

CM_ SG_ 3221225472 Aftrtrtmnt2DslPrtcltFltrInt_0000 "Temperature of engine combustion byproducts entering the diesel particulate filter in exhaust bank 2.";
CM_ SG_ 3221225472 Aftrtrtmnt2DslPrtcltFltrOtltGsTm "Temperature of engine combustion byproducts leaving the diesel particulate filter exhaust in exhaust bank 2.";
CM_ SG_ 3221225472 Aftrtrtmnt2DslPrtcltFltrExhstGsT "Used to identify the applicable J1939-73 FMI detected in the diesel particulate filter outlet gas temperature sensor by the";
CM_ SG_ 3221225472 Aftrtrtmnt2ExhstGsTmp3PrlmnryFMI "Used to identify the applicable J1939-73 FMI detected in the exhaust gas temperature 3 sensor by the manufacturer's";
CM_ SG_ 3221225472 Aftertreatment2ExhaustGasTemp3 "The reading from the exhaust gas temperature sensor located farthest downstream in the aftertreatment system in";
CM_ SG_ 3221225472 Aftrtrtmnt2DslPrtcltFltrIntrmdtG "Used to identify the applicable J1939-73 FMI detected in the diesel particulate filter intermediate gas temperature sensor";
CM_ SG_ 3221225472 Aftrtrtmnt2DslPrtcltFltrInt_0001 "Temperature of engine combustion byproducts at a mid-point in the diesel particulate filter in exhaust bank 2.";
CM_ SG_ 3221225472 Aftrtrtmnt2DslPrtcltFltrDltPrssP "Used to identify the applicable J1939-73 FMI detected in the diesel particulate filter differential pressure sensor by the";
CM_ SG_ 3221225472 Aftrtrtmnt2DslPrtcltFltrDffPrss "Exhaust differential pressure measured between the intake and exhaust of a diesel particulate filter in exhaust bank 2.";
CM_ SG_ 3221225472 Aftrtrtmnt2ExhstGsTmp2PrlmnryFMI "Used to identify the applicable J1939-73 FMI detected in the exhaust gas temperature 2 sensor by the manufacturer's";
CM_ SG_ 3221225472 Aftertreatment2ExhaustGasTemp2 "The reading from the exhaust gas temperature sensor located midstream of the other two temperature sensors in the";
CM_ SG_ 3221225472 FifthWheelSliderLockIndicator "Indicates to vehicle operator that the fifth wheel slider is in position and locked.";
CM_ SG_ 3221225472 FifthWheelSliderPos "Slider position measurement.";
CM_ SG_ 3221225472 FfthWhlLckCoupleStatusIndicator "Indicates results of coupling operation to the vehicle operator.";
CM_ SG_ 3221225472 FfthWhlLckRadyToCoupleIndicator "Indicates to the vehicle operator that the fifth wheel lock is open and ready to couple.";
CM_ SG_ 3221225472 FifthWheelErrorStatus "Fifth wheel error state which conveys information when coupling status is incomplete or bad.";
CM_ SG_ 3221225472 EngCentrifugalOilFilterSpeed "The speed of a rotating (centrifugal) engine oil filter.";
CM_ SG_ 3221225472 EngCoolantPumpDiffPress "The differential pressure measured across the input and output of the engine coolant pump.";
CM_ SG_ 3221225472 EngChargeAirCooler2IntakePress "Pressure of air at intake to 2nd charge air cooler, from multiple first stage turbochargers being cooled and feeding multiple";
CM_ SG_ 3221225472 EngChargeAirCooler1IntakePress "Pressure of air at intake to 1st or only charge air cooler, from multiple first stage turbochargers being cooled and feeding";
CM_ SG_ 3221225472 EngIntercoolerCoolantLevel "Ratio of volume of liquid found in an engine intercooler cooling system to total engine intercooler cooling system volume.";
CM_ SG_ 3221225472 EngChargeAirCoolerOutletPress "Measures pressure of air at outlet from charge air cooler";
CM_ SG_ 3221225472 EngAftercoolerCoolantLevel "Ratio of aftercooler coolant system volume of liquid to total cooling system volume.";
CM_ SG_ 3221225472 WrlessCommunicationNetworkType1 "Type of Wireless Communication Network";
CM_ SG_ 3221225472 NetworkSignalStrength1 "Indicates the signal strength for the wireless communications network type.";
CM_ SG_ 3221225472 NetworkAntennaStatus1 "Indicates the status of the antenna for the wireless communications network type";
CM_ SG_ 3221225472 NetworkServiceStatus1 "Indicates the status of the Service for the wireless communications network type";
CM_ SG_ 3221225472 NetworkTransceiverStatus1 "Indicates the status of the transceiver for the wireless communications network type";
CM_ SG_ 3221225472 WrlessCommunicationNetworkType2 "Type of Wireless Communication Network";
CM_ SG_ 3221225472 NetworkSignalStrength2 "Indicates the signal strength for the wireless communications network type.";
CM_ SG_ 3221225472 NetworkAntennaStatus2 "Indicates the status of the antenna for the wireless communications network type";
CM_ SG_ 3221225472 NetworkServiceStatus2 "Indicates the status of the Service for the wireless communications network type";
CM_ SG_ 3221225472 NetworkTransceiverStatus2 "Indicates the status of the transceiver for the wireless communications network type";
CM_ SG_ 3221225472 VoltageRegulatorEnabled "State signal indicating the Voltage regulator enabled.";
CM_ SG_ 3221225472 VoltageRegulatorSoftStartState "State signal indicating the mode of the Voltage regulator soft start function.";
CM_ SG_ 3221225472 VltgRgltrUndrfrqncyCmpnstnEnbld "State signal indicating the operating mode for underfrequency compensation.";
CM_ SG_ 3221225472 VltgRglatorLoadCompensationMode "State signal indicating the voltage regulator load compensation mode.";
CM_ SG_ 3221225472 GeneratorExcitationFieldCurrent "Measured signal that represents the generator excitation field current.";
CM_ SG_ 3221225472 GeneratorExcitationFieldVoltage "Measured signal that represents the generator excitation field voltage.";
CM_ SG_ 3221225472 EnableStatusOfDoor10 "Enable status of bus door 10.";
CM_ SG_ 3221225472 OpenStatusOfDoor10 "Open status of bus door 10";
CM_ SG_ 3221225472 LockStatusOfDoor10 "Lock status of bus door 10";
CM_ SG_ 3221225472 EnableStatusOfDoor9 "Enable status of bus door 9.";
CM_ SG_ 3221225472 OpenStatusOfDoor9 "Open status of bus door 9";
CM_ SG_ 3221225472 LockStatusOfDoor9 "Lock status of bus door 9";
CM_ SG_ 3221225472 EnableStatusOfDoor8 "Enable status of bus door 8.";
CM_ SG_ 3221225472 OpenStatusOfDoor8 "Open status of bus door 8";
CM_ SG_ 3221225472 LockStatusOfDoor8 "Lock status of bus door 8";
CM_ SG_ 3221225472 EnableStatusOfDoor7 "Enable status of bus door 7.";
CM_ SG_ 3221225472 OpenStatusOfDoor7 "Open status of bus door 7";
CM_ SG_ 3221225472 LockStatusOfDoor7 "Lock status of bus door 7";
CM_ SG_ 3221225472 EnableStatusOfDoor6 "Enable status of bus door 6.";
CM_ SG_ 3221225472 OpenStatusOfDoor6 "Open status of bus door 6";
CM_ SG_ 3221225472 LockStatusOfDoor6 "Lock status of bus door 6";
CM_ SG_ 3221225472 EnableStatusOfDoor5 "Enable status of bus door 5.";
CM_ SG_ 3221225472 OpenStatusOfDoor5 "Open status of bus door 5";
CM_ SG_ 3221225472 LockStatusOfDoor5 "Lock status of bus door 5";
CM_ SG_ 3221225472 EnableStatusOfDoor4 "Enable status of bus door 4.";
CM_ SG_ 3221225472 OpenStatusOfDoor4 "Open status of bus door 4";
CM_ SG_ 3221225472 LockStatusOfDoor4 "Lock status of bus door 4";
CM_ SG_ 3221225472 EnableStatusOfDoor3 "Enable status of bus door 3.";
CM_ SG_ 3221225472 OpenStatusOfDoor3 "Open status of bus door 3";
CM_ SG_ 3221225472 LockStatusOfDoor3 "Lock status of bus door 3";
CM_ SG_ 3221225472 EnableStatusOfDoor2 "Enable status of bus door 2.";
CM_ SG_ 3221225472 OpenStatusOfDoor2 "Open status of bus door 2";
CM_ SG_ 3221225472 LockStatusOfDoor2 "Lock status of bus door 2";
CM_ SG_ 3221225472 EnableStatusOfDoor1 "Enable status of bus door 1.";
CM_ SG_ 3221225472 OpenStatusOfDoor1 "Open status of bus door 1";
CM_ SG_ 3221225472 LockStatusOfDoor1 "Lock status of bus door 1";
CM_ SG_ 3221225472 EnggmntSttusTransInputShaftPTO1 "Reports if this specific PTO drive is engaged.";
CM_ SG_ 3221225472 EnggmntSttusTransInputShaftPTO2 "Reports if this specific PTO drive is engaged.";
CM_ SG_ 3221225472 EnggmntSttusTransOutputShaftPTO "Reports if this specific PTO drive is engaged.";
CM_ SG_ 3221225472 EnggmntSttsTrnsfrCsOtptShaftPTO "Reports if this specific PTO drive is engaged.";
CM_ SG_ 3221225472 EnggmntCnsntTransInputShaftPTO1 "Status of the transmission controller's consent to engage the first or sole PTO drive mounted on the transmission case.";
CM_ SG_ 3221225472 EnggmntCnsntTransInputShaftPTO2 "Status of the transmission controller's consent to engage the second PTO drive mounted on the transmission case.";
CM_ SG_ 3221225472 EnggmntCnsntTransOutputShaftPTO "Status of the transmission controller's consent to engage the PTO drive connected to the transmission output shaft.";
CM_ SG_ 3221225472 EnggmntCnsntTrnsfrCsOtptShftPTO "Status of the transmission controller's consent to engage the PTO drive connected to the transfer case output shaft.";
CM_ SG_ 3221225472 EnableSwitchTransInputShaftPTO1 "Status of the operator's switch or other input which indicates the desire for engaging the first PTO drive mounted on the";
CM_ SG_ 3221225472 EnableSwitchTransInputShaftPTO2 "Status of the operator's switch or other input which indicates the desire for engaging the second PTO drive mounted on";
CM_ SG_ 3221225472 EnableSwitchTransOutputShaftPTO "Status of the operator's switch or other input which indicates the desire for engaging the PTO drive mounted on the";
CM_ SG_ 3221225472 EnblSwtchTrnsfrCsOutputShaftPTO "Status of the operator's switch or other input which indicates the desire for engaging the PTO drive mounted on the output";
CM_ SG_ 3221225472 EnggmntSttsPTOEngAccssoryDrive2 "Engagement status of the PTO engine accessory drive 2";
CM_ SG_ 3221225472 EnggmntSttsPTOEngAccssoryDrive1 "Engagement status of the PTO engine accessory drive 1";
CM_ SG_ 3221225472 EnggmntCnsntPTOEngAccssryDrive2 "Engagement Consent status for the PTO engine accessory drive 2";
CM_ SG_ 3221225472 EnggmntCnsntPTOEngAccssryDrive1 "Engagement consent status for the PTO engine accessory drive 1";
CM_ SG_ 3221225472 EngagementStatusPTOEngFlywheel "Engagement status of the PTO Engine Flywheel";
CM_ SG_ 3221225472 EngagementConsentPTOEngFlywheel "Engagement Consent status for the PTO Engine Flywheel";
CM_ SG_ 3221225472 EnblSwitchPTOEngAccessoryDrive2 "Status of the PTO engine accessory drive 2 enable switch";
CM_ SG_ 3221225472 EnblSwitchPTOEngAccessoryDrive1 "Status of the PTO engine accessory drive 1 enable switch";
CM_ SG_ 3221225472 EnableSwitchPTOEngFlywheel "Status of the PTO Engine Flywheel enable switch";
CM_ SG_ 3221225472 AtLeastOnePTOEngaged "Indicates that at least one PTO is engaged";
CM_ SG_ 3221225472 EngVrableGeometryTurboActuator1 "Actuator that controls the variable geometry turbocharger geometry.";
CM_ SG_ 3221225472 EngTrbCmprssrBypssActtr1TmpStts "Used to identify the status of the Engine Turbocharger Compresssor Bypass Actuator 1 drive circuitry temperature.";
CM_ SG_ 3221225472 EngTrbCmprssrBypssActtr1PrlmnryF "Used to identify the appplicable J1939-73 FMI detected in the Engine Turbocharger Compressor Bypass Actuator 1 by";
CM_ SG_ 3221225472 EngTrbCmprssrBypassActuator2Cmd "The command to a compressor bypass actuator 2, normalized to percent, where 0% nominally represents fully closed and";
CM_ SG_ 3221225472 EngTrbCmprssrBypassActuator1Pos "Measures the position of the turbocharger compressor bypass actuator, where 0% represents bypass fully closed and";
CM_ SG_ 3221225472 EngTrbCmprssrBypassActuator1Cmd "The command to a compressor bypass actuator, normalized to percent, where 0% nominally represents fully closed and";
CM_ SG_ 3221225472 EngDsrdTrbCmprssrBypssActtr1Pos "The requested position of the Engine Turbocharger Compressor Bypass actuator by the engine ECM, where 0%";
CM_ SG_ 3221225472 EngFuelValve2OutletAbsPress "Absolute pressure of gas on outlet side of the second fuel system control valve.";
CM_ SG_ 3221225472 EngFuelTemp2 "Temperature 2 of fuel (or gas).";
CM_ SG_ 3221225472 EngGas2MassFlowRate "Gas mass flow rate delivered to an engine through its second fuel control system, using standard convention for";
CM_ SG_ 3221225472 EngFuelValve2IntakeAbsPress "Absolute pressure of gas on intake side of the second fuel system control valve, using standard convention for";
CM_ SG_ 3221225472 Aftrtrtmnt1FlInjctor1HeaterCtrl "Heating level that the controller is commanding the aftertreatment 1 fuel injector 1 heater control to maintain.";
CM_ SG_ 3221225472 Aftertreatment1FuelPress1Ctrl "Position that the controller is commanding the aftertreatment 1 fuel pressure control to maintain.";
CM_ SG_ 3221225472 Aftrtratment1FuelEnableActuator "Indicates whether aftertreatment 1 fuel enable actuator is on or off";
CM_ SG_ 3221225472 Aftrtratment1RegenerationStatus "Indicates whether regeneration is active or inactive in aftertreatment 1.";
CM_ SG_ 3221225472 Aftertreatment1Ignt "Indicates whether aftertreatment 1 ignition circuit is energized by the ECM.";
CM_ SG_ 3221225472 Aftrtreatment1FuelDrainActuator "Indicates whether aftertreatment 1 fuel drain actuator is on or off";
CM_ SG_ 3221225472 Aftertreatment1FuelRate "Rate of fuel being delivered to aftertreatment 1 for regeneration";
CM_ SG_ 3221225472 Aftertreatment1FuelPress1 "First fuel pressure measurement for the aftertreatment 1 system";
CM_ SG_ 3221225472 Aftrtrtmnt2FlInjctor1HeaterCtrl "Heating level that the controller is commanding the aftertreatment 2 fuel injector 1 heater control to maintain.";
CM_ SG_ 3221225472 Aftertreatment2FuelPress1Ctrl "Position that the controller is commanding the aftertreatment 2 fuel pressure control to maintain.";
CM_ SG_ 3221225472 Aftertreatment2FuelPress1 "Pressure of the fuel for Aftertreatment 2.";
CM_ SG_ 3221225472 Aftrtratment2FuelEnableActuator "Indicates whether aftertreatment 2 fuel enable actuator is on or off";
CM_ SG_ 3221225472 Aftrtratment2RegenerationStatus "Indicates whether regeneration is active or inactive in aftertreatment 2.";
CM_ SG_ 3221225472 Aftertreatment2Ignt "Indicates whether aftertreatment 2 ignition circuit is energized by the ECM.";
CM_ SG_ 3221225472 Aftrtreatment2FuelDrainActuator "Indicates whether aftertreatment 2 fuel drain actuator is on or off";
CM_ SG_ 3221225472 Aftertreatment2FuelRate "Rate of fuel being delivered to aftertreatment 2 for regeneration";
CM_ SG_ 3221225472 Aftrtreatment1AirEnableActuator "Indicates whether aftertreatment 1 air enable actuator is on or off";
CM_ SG_ 3221225472 Aftertreatment1PurgeAirActuator "Indicates whether aftertreatment 1 purge air actuator is on or off";
CM_ SG_ 3221225472 Aftrtrtmnt1AtmzationAirActuator "Indicates whether aftertreatment 1 atomization air actuator is on or off";
CM_ SG_ 3221225472 Aftertreatment1AirSystemRelay "Indicates whether aftertreatment 1 air system relay is on or off";
CM_ SG_ 3221225472 Aftrtrtment1AirPressActuatorPos "Position of the aftertreatment 1 air pressure actuator as measured by a position feedback sensor.";
CM_ SG_ 3221225472 Aftertreatment1AirPressCtrl "Position that the controller is commanding the aftertreatment 1 air pressure control to maintain.";
CM_ SG_ 3221225472 Aftertreatment1PurgeAirPress "Pressure of the purge air supply for aftertreatment 1";
CM_ SG_ 3221225472 Aftertreatment1SupplyAirPress "Pressure of the supply air for aftertreatment 1.";
CM_ SG_ 3221225472 Aftrtreatment2AirEnableActuator "Indicates whether aftertreatment 2 air enable actuator is on or off";
CM_ SG_ 3221225472 Aftertreatment2PurgeAirActuator "Indicates whether aftertreatment 2 purge air actuator is on or off";
CM_ SG_ 3221225472 Aftrtrtmnt2AtmzationAirActuator "Indicates whether aftertreatment 2 atomization air actuator is on or off";
CM_ SG_ 3221225472 Aftertreatment2AirSystemRelay "Indicates whether aftertreatment 2 air system relay is on or off";
CM_ SG_ 3221225472 Aftrtrtment2AirPressActuatorPos "Position of the aftertreatment 2 air pressure actuator as measured by a position feedback sensor.";
CM_ SG_ 3221225472 Aftertreatment2AirPressCtrl "Position that the controller is commanding the aftertreatment 2 air pressure control to maintain.";
CM_ SG_ 3221225472 Aftertreatment2PurgeAirPress "Pressure of the purge air supply for aftertreatment 2";
CM_ SG_ 3221225472 Aftertreatment2SupplyAirPress "Pressure of the supply air for aftertreatment 2.";
CM_ SG_ 3221225472 SensorSupplyVoltage4 "Sensor ECU supply voltage 4";
CM_ SG_ 3221225472 SensorSupplyVoltage3 "Sensor ECU supply voltage 3";
CM_ SG_ 3221225472 SensorSupplyVoltage2 "Sensor ECU supply voltage 2";
CM_ SG_ 3221225472 SensorSupplyVoltage1 "Sensor ECU supply voltage 1";
CM_ SG_ 3221225472 SensorSupplyVoltage6 "Sensor ECU supply voltage 6";
CM_ SG_ 3221225472 SensorSupplyVoltage5 "Sensor ECU supply voltage 5";
CM_ SG_ 3221225472 SensorSupplyVoltage8 "Sensor ECU supply voltage 8";
CM_ SG_ 3221225472 SensorSupplyVoltage7 "Sensor ECU supply voltage 7";
CM_ SG_ 3221225472 Aftrtrtmnt1SCRCtlystRgntTmp2Prlm "Used to identify the applicable J1939-73 FMI that applies to the most significant failure of the catalyst temperature sensor.";
CM_ SG_ 3221225472 Aftrtrtmnt1SCRCtlystRgntPrprtsPr "Used to identify the applicable J1939-73 FMI that applies to the most significant failure of the catalyst reagent properties";
CM_ SG_ 3221225472 Aftrtrtmnt1SCRCtlystRgntCndctvty "A measure of the conductivity of the reagent or fluid at the sensor.";
CM_ SG_ 3221225472 Aftrtrtmnt1SCRCtlystRgntCncntrtn "A measure of the concentration of urea in water.";
CM_ SG_ 3221225472 Aftrtrtmnt1SCRCtlystReagentType "This parameter indicates what reagent is in the tank.";
CM_ SG_ 3221225472 Aftrtrtmnt1SCRCtlystRagentTemp2 "Temperature of the catalyst reagent at the device measuring reagent quality";
CM_ SG_ 3221225472 Aftrtrtmnt2TtlNmbrOfActvRgnrtnMn "Total number of Aftertreatment device 2 active regeneration manual requests by the operator over the lifetime of the";
CM_ SG_ 3221225472 Aftrtrtmnt2TtlNmbrOfActvRgnrtnIn "Total number of Aftertreatment device 2 active regeneration inhibit requests by the operator over the lifetime of the";
CM_ SG_ 3221225472 Aftrtrtmnt2AvrgTmBtwnActvRgnrtns "Indicates the average time since last reset between active regenerations, that have not been forced to occur by manual";
CM_ SG_ 3221225472 Aftrtrtmnt2TtlNmbrOfPssvRgnrtns "Total number of passive regenerations by Aftertreatment device 2 over the lifetime of the device.";
CM_ SG_ 3221225472 Aftrtrtmnt2TtlPssvRgnrationTime "Total amount of time that Aftertreatment device 2 has been in passive regeneration over the lifetime of the device.";
CM_ SG_ 3221225472 Aftrtrtmnt2TtlNmbrOfActvRgnrtns "Total number of active regenerations by aftertreatment device 2 over the lifetime of the device.";
CM_ SG_ 3221225472 Aftrtreatment2TotalDisabledTime "Total amount of time that aftertreatment 2 regeneration has been manually disabled.";
CM_ SG_ 3221225472 Aftrtrtmnt2TtalRegenerationTime "Total amount of time that aftertreatment device 2 has been regenerating over the lifetime of the device.";
CM_ SG_ 3221225472 Aftertreatment2TotalFuelUsed "Total amount of fuel used by aftertreatment device 2 over the lifetime of the device.";
CM_ SG_ 3221225472 Aftrtrtmnt1TtlNmbrOfActvRgnrtnMn "Total number of aftertreatment device 1 active regeneration manual requests by the operator over the lifetime of the";
CM_ SG_ 3221225472 Aftrtrtmnt1TtlNmbrOfActvRgnrtnIn "Total number of aftertreatment device 1 active regeneration inhibit requests by the operator over the lifetime of the device.";
CM_ SG_ 3221225472 Aftrtrtmnt1AvrgTmBtwnActvRgnrtns "Indicates the average time since last reset between active regenerations, that have not been forced to occur by manual";
CM_ SG_ 3221225472 Aftrtrtmnt1TtlNmbrOfPssvRgnrtns "Total number of passive regenerations by aftertreatment device 1 over the lifetime of the device.";
CM_ SG_ 3221225472 Aftrtrtmnt1TtlPssvRgnrationTime "Total amount of time that aftertreatment device 1 has been in passive regeneration over the lifetime of the device.";
CM_ SG_ 3221225472 Aftrtrtmnt1TtlNmbrOfActvRgnrtns "Total number of active regenerations by aftertreatment device 1 over the lifetime of the device.";
CM_ SG_ 3221225472 Aftrtreatment1TotalDisabledTime "Total amount of time that aftertreatment 1 regeneration has been manually disabled.";
CM_ SG_ 3221225472 Aftrtrtmnt1TtalRegenerationTime "Total amount of time that aftertreatment device 1 has been regenerating over the lifetime of the device.";
CM_ SG_ 3221225472 Aftertreatment1TotalFuelUsed "Total amount of fuel used by aftertreatment device 1 over the lifetime of the device.";
CM_ SG_ 3221225472 TrnsTrqueConverterOilOutletTemp "Temperature of transmission torque converter outlet oil.";
CM_ SG_ 3221225472 TransOverheatIndicator "Signal from transmission indicating that its fluid temperature is above normal acceptable limits, and as a result,";
CM_ SG_ 3221225472 TransOilLifeRemaining "Signal which indicates the actual oil life remaining in percent.";
CM_ SG_ 3221225472 TransOilLevelSwitch "This switch indicates whether transmission oil level is full or empty.";
CM_ SG_ 3221225472 TransOilFilterRestrictionSwitch "This switch indicates whether the transmission oil filter is clogged.";
CM_ SG_ 3221225472 EngExhstGsRcrculation1Valve2Pos "The position of the second exhaust gas recirculation valve expressed as a percentage of full travel.";
CM_ SG_ 3221225472 EngExhstGsRcirculation1ValvePos "The position of the exhaust gas recirculation valve expressed as a percentage of full travel.";
CM_ SG_ 3221225472 EngCrnkcsBrthrOilSeparatorSpeed "The speed of a rotating (centrifugal) crankcase oil separator.";
CM_ SG_ 3221225472 CmdedEngIntakeManifoldPress "Provides the commanded set point value for the engine intake manifold pressure.";
CM_ SG_ 3221225472 EngDerateRq "This parameter is a derate request made from the engine control system to an external system, where the engine is";
CM_ SG_ 3221225472 EngEmergencyShutdownIndication "A signal issued by the engine control system to a user or external system indicating that it is immediately shutting the engine";
CM_ SG_ 3221225472 EngCtrlledShutdownRq "A signal issued by the engine control system to a user or external system requesting for a controlled shutdown.";
CM_ SG_ 3221225472 EngCoolantCirculatingPumpCtrl "Control setting for an electrically actuated engine coolant circulating pump.";
CM_ SG_ 3221225472 EngBlock_CoolantPreheaterCtrl "Control setting for an electrically actuated engine block or coolant pre-heating device.";
CM_ SG_ 3221225472 EngElctrclSystmPwrCnsrvtionCtrl "Control setting for cutting power to various devices when the engine is not in use.";
CM_ SG_ 3221225472 EngOilPreheaterCtrl "Control setting for an electrically actuated oil pre-heating device.";
CM_ SG_ 3221225472 EngOilPrimingPumpCtrl "This control is used to activate a pump that lubricates the engine, particularly prior to initial engine startup.";
CM_ SG_ 3221225472 EngFuelShutoffValveLeakTestCtrl "Control setting for fuel shutoff valve proving system test.";
CM_ SG_ 3221225472 EngFuelShutoff2Ctrl "Control setting for fuel shutoff 2.";
CM_ SG_ 3221225472 EngFuelShutoff1Ctrl "Control setting for fuel shutoff 1.";
CM_ SG_ 3221225472 EngFuelShutoffVentCtrl "Control setting for a fuel shutoff vent.";
CM_ SG_ 3221225472 TmeRemainingInEngOperatingState "This parameter is used to indicate the time remaining in the current engine operating state, based on the state defined in";
CM_ SG_ 3221225472 FuelPumpPrimerCtrl "Parameter used to activate or deactivate a priming system on the fuel transfer system.";
CM_ SG_ 3221225472 EngOperatingState "This parameter is used to indicate the current state, or mode, of operation by the engine.";
CM_ SG_ 3221225472 AETCTorqueValue "Engine torque value of the data points in PGN 64912 Advertised Engine Torque Curve (AETC).";
CM_ SG_ 3221225472 NumberOfAETCDataPoints "Indicates the number of speed / torque data points contained in the Advertised Engine Torque Curve broadcast (AETC).";
CM_ SG_ 3221225472 AETCDataCollectionStandard "Indicates the standardized method by which torque data was obtained for the Advertised Engine Torque Curve (AETC).";
CM_ SG_ 3221225472 DslPrticulateFilterOutletPress1 "This parameter indicates the diesel particulate filter outlet gage pressure 1 (bank 1).";
CM_ SG_ 3221225472 DslPrticulateFilterIntakePress1 "This parameter indicates the diesel particulate filter intake gage pressure 1 (bank 1).";
CM_ SG_ 3221225472 DslPrticulateFilterOutletPress2 "This parameter indicates the diesel particulate filter outlet gage pressure 2 (bank 2).";
CM_ SG_ 3221225472 DslPrticulateFilterIntakePress2 "This parameter indicates the diesel particulate filter intake gage pressure 2 (bank 2).";
CM_ SG_ 3221225472 J2012DTCOccurrenceCount "Number of occurrences of the respective SAE J2012 DTC being conveyed.";
CM_ SG_ 3221225472 J2012DTCStatus "Indicates if the respective SAE J2012 DTC is active or previously active.";
CM_ SG_ 3221225472 NumberOfJ2012DTCs "The number J2012 DTCs being conveyed in PGN 64906.";
CM_ SG_ 3221225472 VehicleRoll "This parameter indicates the roll in degrees from level.";
CM_ SG_ 3221225472 EngIntkVlvActtonOilPressForCyl4 "The gage pressure of the oil in the hydraulic accumulator that powers the engine intake valve for cylinder #4.";
CM_ SG_ 3221225472 EngIntkVlvActtonOilPressForCyl3 "The gage pressure of the oil in the hydraulic accumulator that powers the engine intake valve for cylinder #3.";
CM_ SG_ 3221225472 EngIntkVlvActtonOilPressForCyl2 "The gage pressure of the oil in the hydraulic accumulator that powers the engine intake valve for cylinder #2.";
CM_ SG_ 3221225472 EngIntkVlvActtonOilPressForCyl1 "The gage pressure of the oil in the hydraulic accumulator that powers the engine intake valve for cylinder #1.";
CM_ SG_ 3221225472 EngIntkVlvActtonOilPressForCyl8 "The gage pressure of the oil in the hydraulic accumulator that powers the engine intake valve for cylinder #8.";
CM_ SG_ 3221225472 EngIntkVlvActtonOilPressForCyl7 "The gage pressure of the oil in the hydraulic accumulator that powers the engine intake valve for cylinder #7.";
CM_ SG_ 3221225472 EngIntkVlvActtonOilPressForCyl6 "The gage pressure of the oil in the hydraulic accumulator that powers the engine intake valve for cylinder #6.";
CM_ SG_ 3221225472 EngIntkVlvActtonOilPressForCyl5 "The gage pressure of the oil in the hydraulic accumulator that powers the engine intake valve for cylinder #5.";
CM_ SG_ 3221225472 EngIntkVlvActtnOilPressForCyl12 "The gage pressure of the oil in the hydraulic accumulator that powers the engine intake valve for cylinder #12.";
CM_ SG_ 3221225472 EngIntkVlvActtnOilPressForCyl11 "The gage pressure of the oil in the hydraulic accumulator that powers the engine intake valve for cylinder #11.";
CM_ SG_ 3221225472 EngIntkVlvActtnOilPressForCyl10 "The gage pressure of the oil in the hydraulic accumulator that powers the engine intake valve for cylinder #10.";
CM_ SG_ 3221225472 EngIntkVlvActtonOilPressForCyl9 "The gage pressure of the oil in the hydraulic accumulator that powers the engine intake valve for cylinder #9.";
CM_ SG_ 3221225472 EngIntkVlvActtnOilPressForCyl16 "The gage pressure of the oil in the hydraulic accumulator that powers the engine intake valve for cylinder #16.";
CM_ SG_ 3221225472 EngIntkVlvActtnOilPressForCyl15 "The gage pressure of the oil in the hydraulic accumulator that powers the engine intake valve for cylinder #15.";
CM_ SG_ 3221225472 EngIntkVlvActtnOilPressForCyl14 "The gage pressure of the oil in the hydraulic accumulator that powers the engine intake valve for cylinder #14.";
CM_ SG_ 3221225472 EngIntkVlvActtnOilPressForCyl13 "The gage pressure of the oil in the hydraulic accumulator that powers the engine intake valve for cylinder #13.";
CM_ SG_ 3221225472 EngIntkVlvActtnOilPressForCyl20 "The gage pressure of the oil in the hydraulic accumulator that powers the engine intake valve for cylinder #20.";
CM_ SG_ 3221225472 EngIntkVlvActtnOilPressForCyl19 "The gage pressure of the oil in the hydraulic accumulator that powers the engine intake valve for cylinder #19.";
CM_ SG_ 3221225472 EngIntkVlvActtnOilPressForCyl18 "The gage pressure of the oil in the hydraulic accumulator that powers the engine intake valve for cylinder #18.";
CM_ SG_ 3221225472 EngIntkVlvActtnOilPressForCyl17 "The gage pressure of the oil in the hydraulic accumulator that powers the engine intake valve for cylinder #17.";
CM_ SG_ 3221225472 TransferCaseStatus "This parameter describes the feedback from the transfer case controller .";
CM_ SG_ 3221225472 EGR1CoolerBypassActuatorPostion "The parameter gives the % open of the EGR Cooler Bypass Actuator, where 0% = Fully Closed (no gas flowing through";
CM_ SG_ 3221225472 MaxCrankAttemptsPerStartAttempt "The number of cranking cycles that will be performed before ending the start attempt.";
CM_ SG_ 3221225472 RightHeadlampLightDistribution "This parameter indicates what kind of light distribution is set by the AFS system for the right headlamp.";
CM_ SG_ 3221225472 LeftHeadlampLightDistribution "This parameter indicates what kind of light distribution is set by the AFS system for the left headlamp.";
CM_ SG_ 3221225472 RghtHeadlampDynamicBendingLight "This parameter indicates whether the dynamic bending light of the left headlamp is working properly.";
CM_ SG_ 3221225472 LeftHeadlampDynamicBendingLight "This parameter indicates whether the dynamic bending light of the left headlamp is working properly.";
CM_ SG_ 3221225472 EngFuelLeakage2 "Status signal which indicates fuel leakage in the fuel rail of the engine.";
CM_ SG_ 3221225472 EngFuelLeakage1 "Status signal which indicates fuel leakage in the fuel rail of the engine.";
CM_ SG_ 3221225472 EngTorqueLimit6AxleInput "Limit applied to the engine output torque based on the maximum allowable axle input torque.";
CM_ SG_ 3221225472 EngTorqueLimit5Switch "Limit applied to the engine output torque based on activation of an ECU switch input.";
CM_ SG_ 3221225472 EngTorqueLimit4Trans "Limit applied to the engine output torque during vehicle operation in transmission gear ratios numerically less than or";
CM_ SG_ 3221225472 EngTorqueLimit3Trans "Limit applied to the engine output torque during vehicle operation in transmission gear ratios numerically less than or";
CM_ SG_ 3221225472 TransGearRatio3 "Gear ratio value stored in the ECU that is used to define a range of transmission gears for which a limit is applied to the";
CM_ SG_ 3221225472 EngTorqueLimit2Trans "Limit applied to the engine output torque during vehicle operation in transmission gear ratios numerically less than or";
CM_ SG_ 3221225472 TransGearRatio2 "Gear ratio value stored in the ECU that is used to define a range of transmission gears for which a limit is applied to the";
CM_ SG_ 3221225472 EngTorqueLimit1Trans "Limit applied to the engine output torque during vehicle operation in transmission gear ratios numerically greater than";
CM_ SG_ 3221225472 TransGearRatio1 "Gear ratio value stored in the ECU that is used to define a range of transmission gears for which a limit is applied to the";
CM_ SG_ 3221225472 EngTorqueLimitFeature "Torque limit rating described in the current record.";
CM_ SG_ 3221225472 TorqueLimitingFeatureStatus "Status of an ECU feature which limits the torque output of the engine.";
CM_ SG_ 3221225472 CalibRecordDurationTime "Duration in hours for which the engine operated in the conditions captured in the current record.";
CM_ SG_ 3221225472 CalibRecordStartYear "Calendar year timestamp when an ECU record was established.";
CM_ SG_ 3221225472 CalibRecordStartDay "Calendar day timestamp when an ECU record was established.";
CM_ SG_ 3221225472 CalibRecordStartMonth "Calendar month timestamp when an ECU record was established.";
CM_ SG_ 3221225472 EngPeakTorque2 "Maximum torque output of the current ECU calibration when the engine operates on torque curve 2.";
CM_ SG_ 3221225472 EngPeakTorque1 "Maximum torque output of the current ECU calibration when the engine operates on torque curve 1.";
CM_ SG_ 3221225472 EngPower "Advertised engine power capability.";
CM_ SG_ 3221225472 NumberOfEngTorqueHistoryRecords "Number of torque history records contained in the engine torque history PGN.";
CM_ SG_ 3221225472 EngExtlShutdownAirSupplyPress "Pressure of the air used to shut off the fuel supply to the engine.";
CM_ SG_ 3221225472 TimeSinceLastService "The vehicle operation time since the last service was performed.";
CM_ SG_ 3221225472 ECUPowerOutputSupplyVoltage3 "The third power output from an ECM.";
CM_ SG_ 3221225472 ECUPowerOutputSupplyVoltage2 "The second power output from an ECM.";
CM_ SG_ 3221225472 ECUPowerOutputSupplyVoltage1 "The first power output from an ECM";
CM_ SG_ 3221225472 BatteryPotential_PowerInput2 "This parameter measures the second source of battery potential as measured at the input of the ECM/actuator etc.";
CM_ SG_ 3221225472 RelativeHumidity "Measures humidity of combustion air prior to entry into turbocharger";
CM_ SG_ 3221225472 AuxLevel "Level measured by a sensor.";
CM_ SG_ 3221225472 AuxPress2 "Pressure measured by auxiliary pressure sensor #2.";
CM_ SG_ 3221225472 AuxPress1 "Pressure measured by auxiliary pressure sensor #1.";
CM_ SG_ 3221225472 AuxTemp2 "Temperature measured by auxiliary temperature sensor #2.";
CM_ SG_ 3221225472 AuxTemp1 "Temperature measured by auxiliary temperature sensor #1.";
CM_ SG_ 3221225472 EngFuelValve1OutletAbsPress "Absolute Pressure of gas on outlet side of the first or only fuel system control valve.";
CM_ SG_ 3221225472 EngAirToFuelDiffPress "The differential pressure between the gaseous fuel and the air intake manifold.";
CM_ SG_ 3221225472 EngFuelValveDiffPress "The differential pressure between the intake and the outlet of a gaseous fuel valve.";
CM_ SG_ 3221225472 EngFuelValve1IntakeAbsPress "The absolute pressure of gas on the intake side of the first system control valve.";
CM_ SG_ 3221225472 EngCyl20IgntTransSecondOutput "This parameter indicates the relative intensity of the secondary output voltage of the ignition transformer.";
CM_ SG_ 3221225472 EngCyl19IgntTransSecondOutput "This parameter indicates the relative intensity of the secondary output voltage of the ignition transformer.";
CM_ SG_ 3221225472 EngCyl18IgntTransSecondOutput "This parameter indicates the relative intensity of the secondary output voltage of the ignition transformer.";
CM_ SG_ 3221225472 EngCyl17IgntTransSecondOutput "This parameter indicates the relative intensity of the secondary output voltage of the ignition transformer.";
CM_ SG_ 3221225472 EngCyl16IgntTransSecondOutput "This parameter indicates the relative intensity of the secondary output voltage of the ignition transformer.";
CM_ SG_ 3221225472 EngCyl15IgntTransSecondOutput "This parameter indicates the relative intensity of the secondary output voltage of the ignition transformer.";
CM_ SG_ 3221225472 EngCyl14IgntTransSecondOutput "This parameter indicates the relative intensity of the secondary output voltage of the ignition transformer.";
CM_ SG_ 3221225472 EngCyl13IgntTransSecondOutput "This parameter indicates the relative intensity of the secondary output voltage of the ignition transformer.";
CM_ SG_ 3221225472 EngCyl12IgntTransSecondOutput "This parameter indicates the relative intensity of the secondary output voltage of the ignition transformer.";
CM_ SG_ 3221225472 EngCyl11IgntTransSecondOutput "This parameter indicates the relative intensity of the secondary output voltage of the ignition transformer.";
CM_ SG_ 3221225472 EngCyl10IgntTransSecondOutput "This parameter indicates the relative intensity of the secondary output voltage of the ignition transformer.";
CM_ SG_ 3221225472 EngCyl9IgntTransSecondOutput "This parameter indicates the relative intensity of the secondary output voltage of the ignition transformer.";
CM_ SG_ 3221225472 EngCyl8IgntTransSecondOutput "This parameter indicates the relative intensity of the secondary output voltage of the ignition transformer.";
CM_ SG_ 3221225472 EngCyl7IgntTransSecondOutput "This parameter indicates the relative intensity of the secondary output voltage of the ignition transformer.";
CM_ SG_ 3221225472 EngCyl6IgntTransSecondOutput "This parameter indicates the relative intensity of the secondary output voltage of the ignition transformer.";
CM_ SG_ 3221225472 EngCyl5IgntTransSecondOutput "This parameter indicates the relative intensity of the secondary output voltage of the ignition transformer.";
CM_ SG_ 3221225472 EngCyl4IgntTransSecondOutput "This parameter indicates the relative intensity of the secondary output voltage of the ignition transformer.";
CM_ SG_ 3221225472 EngCyl3IgntTransSecondOutput "This parameter indicates the relative intensity of the secondary output voltage of the ignition transformer.";
CM_ SG_ 3221225472 EngCyl2IgntTransSecondOutput "This parameter indicates the relative intensity of the secondary output voltage of the ignition transformer.";
CM_ SG_ 3221225472 EngCyl1IgntTransSecondOutput "This parameter indicates the relative intensity of the secondary output voltage of the ignition transformer.";
CM_ SG_ 3221225472 EngActualIgntTiming "The actual ignition timing at the current engine conditions.";
CM_ SG_ 3221225472 EngDesiredIgntTiming3 "A programmable timing value specific to the engine's application.";
CM_ SG_ 3221225472 EngDesiredIgntTiming2 "A programmable timing value specific to the engine's application.";
CM_ SG_ 3221225472 EngDesiredIgntTiming1 "A programmable timing value specific to the engine's application.";
CM_ SG_ 3221225472 EngCyl20IgntTiming "The ignition timing of the cylinder.";
CM_ SG_ 3221225472 EngCyl19IgntTiming "The ignition timing of the cylinder.";
CM_ SG_ 3221225472 EngCyl18IgntTiming "The ignition timing of the cylinder.";
CM_ SG_ 3221225472 EngCyl17IgntTiming "The ignition timing of the cylinder.";
CM_ SG_ 3221225472 EngCyl16IgntTiming "The ignition timing of the cylinder.";
CM_ SG_ 3221225472 EngCyl15IgntTiming "The ignition timing of the cylinder.";
CM_ SG_ 3221225472 EngCyl14IgntTiming "The ignition timing of the cylinder.";
CM_ SG_ 3221225472 EngCyl13IgntTiming "The ignition timing of the cylinder.";
CM_ SG_ 3221225472 EngCyl12IgntTiming "The ignition timing of the cylinder.";
CM_ SG_ 3221225472 EngCyl11IgntTiming "The ignition timing of the cylinder.";
CM_ SG_ 3221225472 EngCyl10IgntTiming "The ignition timing of the cylinder.";
CM_ SG_ 3221225472 EngCyl9IgntTiming "The ignition timing of the cylinder.";
CM_ SG_ 3221225472 EngCyl8IgntTiming "The ignition timing of the cylinder.";
CM_ SG_ 3221225472 EngCyl7IgntTiming "The ignition timing of the cylinder.";
CM_ SG_ 3221225472 EngCyl6IgntTiming "The ignition timing of the cylinder.";
CM_ SG_ 3221225472 EngCyl5IgntTiming "The ignition timing of the cylinder.";
CM_ SG_ 3221225472 EngCyl4IgntTiming "The ignition timing of the cylinder.";
CM_ SG_ 3221225472 EngCyl3IgntTiming "The ignition timing of the cylinder.";
CM_ SG_ 3221225472 EngCyl2IgntTiming "The ignition timing of the cylinder.";
CM_ SG_ 3221225472 EngCyl1IgntTiming "The ignition timing of the cylinder.";
CM_ SG_ 3221225472 EngFuelFlowRate2 "The rate at which the fuel is flowing through a fuel valve.";
CM_ SG_ 3221225472 EngFuelFlowRate1 "The rate at which the fuel is flowing through a fuel valve.";
CM_ SG_ 3221225472 EngRqedFuelValve2Pos "The requested position of a gaseous fuel valve 2 that is metering the fuel flow to the engine, as requested by the Engine";
CM_ SG_ 3221225472 EngRqedFuelValve1Pos "The requested position of a gaseous fuel valve 1 that is metering the fuel flow to the engine.";
CM_ SG_ 3221225472 EngFuelValve2Pos "The position of a gaseous fuel valve that is metering the fuel flow to the engine.";
CM_ SG_ 3221225472 EngFuelValve1Pos "The position of a gaseous fuel valve that is metering the fuel flow to the engine.";
CM_ SG_ 3221225472 EngAverageCombustionTime "The average combustion time of all cylinders of an engine.";
CM_ SG_ 3221225472 EngDesiredCombustionTime "The desired combustion time based upon engine load and speed lookup maps.";
CM_ SG_ 3221225472 EngCyl20CombustionTime "The amount of time from when the ignition of the fuel is initiated to when the fuel is completely ignited (i.";
CM_ SG_ 3221225472 EngCyl19CombustionTime "The amount of time from when the ignition of the fuel is initiated to when the fuel is completely ignited (i.";
CM_ SG_ 3221225472 EngCyl18CombustionTime "The amount of time from when the ignition of the fuel is initiated to when the fuel is completely ignited (i.";
CM_ SG_ 3221225472 EngCyl17CombustionTime "The amount of time from when the ignition of the fuel is initiated to when the fuel is completely ignited (i.";
CM_ SG_ 3221225472 EngCyl16CombustionTime "The amount of time from when the ignition of the fuel is initiated to when the fuel is completely ignited (i.";
CM_ SG_ 3221225472 EngCyl15CombustionTime "The amount of time from when the ignition of the fuel is initiated to when the fuel is completely ignited (i.";
CM_ SG_ 3221225472 EngCyl14CombustionTime "The amount of time from when the ignition of the fuel is initiated to when the fuel is completely ignited (i.";
CM_ SG_ 3221225472 EngCyl13CombustionTime "The amount of time from when the ignition of the fuel is initiated to when the fuel is completely ignited (i.";
CM_ SG_ 3221225472 EngCyl12CombustionTime "The amount of time from when the ignition of the fuel is initiated to when the fuel is completely ignited (i.";
CM_ SG_ 3221225472 EngCyl11CombustionTime "The amount of time from when the ignition of the fuel is initiated to when the fuel is completely ignited (i.";
CM_ SG_ 3221225472 EngCyl10CombustionTime "The amount of time from when the ignition of the fuel is initiated to when the fuel is completely ignited (i.";
CM_ SG_ 3221225472 EngCyl9CombustionTime "The amount of time from when the ignition of the fuel is initiated to when the fuel is completely ignited (i.";
CM_ SG_ 3221225472 EngCyl8CombustionTime "The amount of time from when the ignition of the fuel is initiated to when the fuel is completely ignited (i.";
CM_ SG_ 3221225472 EngCyl7CombustionTime "The amount of time from when the ignition of the fuel is initiated to when the fuel is completely ignited (i.";
CM_ SG_ 3221225472 EngCyl6CombustionTime "The amount of time from when the ignition of the fuel is initiated to when the fuel is completely ignited (i.";
CM_ SG_ 3221225472 EngCyl5CombustionTime "The amount of time from when the ignition of the fuel is initiated to when the fuel is completely ignited (i.";
CM_ SG_ 3221225472 EngCyl4CombustionTime "The amount of time from when the ignition of the fuel is initiated to when the fuel is completely ignited (i.";
CM_ SG_ 3221225472 EngCyl3CombustionTime "The amount of time from when the ignition of the fuel is initiated to when the fuel is completely ignited (i.";
CM_ SG_ 3221225472 EngCyl2CombustionTime "The amount of time from when the ignition of the fuel is initiated to when the fuel is completely ignited (i.";
CM_ SG_ 3221225472 EngCyl1CombustionTime "The amount of time from when the ignition of the fuel is initiated to when the fuel is completely ignited (i.";
CM_ SG_ 3221225472 SteerChannelTirePress "The latest gage pressure reading of the steer group of tires, as opposed to the pressure in each tire.";
CM_ SG_ 3221225472 DriveChannelTirePress "The latest gage pressure reading of the drive group of tires, as opposed to the pressure in each tire.";
CM_ SG_ 3221225472 TrailerTagPushChannelTirePress "The latest gage pressure reading of the trailer, tag, or push group of tires, as opposed to the pressure in each tire.";
CM_ SG_ 3221225472 SteerChannelTirePressTarget "The tire pressure control system's target gage pressure for the steer group of tires.";
CM_ SG_ 3221225472 DriveChannelTirePressTarget "The tire pressure control system's target gage pressure for the drive group of tires.";
CM_ SG_ 3221225472 TrlrTgPshChannelTirePressTarget "The tire pressure control system's target gage pressure for the trailer, tag, or push group of tires.";
CM_ SG_ 3221225472 PCUSupplySolenoidStatus "Current state of the supply solenoid used to implement a tire pressure control system in its pneumatic control unit (PCU).";
CM_ SG_ 3221225472 PCUCtrlSolenoidStatus "Current state of the control solenoid used to implement a tire pressure control system in its pneumatic control unit (PCU).";
CM_ SG_ 3221225472 PCUDeflateSolenoidStatus "Current state of the deflate solenoid used to implement a tire pressure control system in its pneumatic control unit (PCU).";
CM_ SG_ 3221225472 TirePressSupplySwitchStatus "Current state of an open/closed type switch used to determine if adequate pressure exists for system implementation.";
CM_ SG_ 3221225472 PCUSteerSolenoidStatus "Current state of the steer solenoid used to implement a tire pressure control system in its pneumatic control unit (PCU).";
CM_ SG_ 3221225472 PCUDriveSolenoidStatus "Current state of the drive solenoid used to implement a tire pressure control system in its pneumatic control unit (PCU).";
CM_ SG_ 3221225472 DriveChannelMode "Indicates the functional mode of trailer/tag channel of the tire pressure control system.";
CM_ SG_ 3221225472 Trailer_TagChannelMode "Indicates the functional mode of trailer/tag channel of the tire pressure control system.";
CM_ SG_ 3221225472 SteerChannelMode "Indicates the functional mode of steer channel of the tire pressure control system.";
CM_ SG_ 3221225472 TirePressCheckInterval "The interval at which the system will check the tire pressures (e.";
CM_ SG_ 3221225472 PCUTrailerTagPushSolenoidStatus "Current state of the trailer, tag, or push solenoid used to implement a tire pressure control system in its pneumatic control";
CM_ SG_ 3221225472 AuxAbsPressReading "Identifies the current absolute pressure (relative to 0 pressure) that is configured uniquely per application.";
CM_ SG_ 3221225472 AuxGagePressReading1 "Identifies the current gage pressure (relative to atmosphere) that is configured uniquely per application.";
CM_ SG_ 3221225472 AuxVacuumPressReading "Identifies the current vacuum pressure (relative to atmosphere) that is configured uniquely per application.";
CM_ SG_ 3221225472 DisplayDeadbands "Sets Display Deadbands mode.";
CM_ SG_ 3221225472 LEDPatternCtrl "Sets LED Pattern control mode on laser leveling systems.";
CM_ SG_ 3221225472 LEDDisplayDeadbandCtrl "This parameter informs the system what the selected Display deadband will be.";
CM_ SG_ 3221225472 LEDDisplayModeCtrl "This parameter informs the system what the selected Display mode will be.";
CM_ SG_ 3221225472 LEDDisplayData1 "Informs display devices how to display the current vertical position.";
CM_ SG_ 3221225472 LaserStrikeDataLatency "Time from laser strike to CAN message transmission.";
CM_ SG_ 3221225472 LaserReceiverType "Identifies which type of Laser Receiver transmitted the message.";
CM_ SG_ 3221225472 LaserStrikeVerticalDeviation "The calculated distance from the laser strike position to the current land leveling system reference point.";
CM_ SG_ 3221225472 AbsLaserStrikePos "Laser Strike location on the survey type laser receiver.";
CM_ SG_ 3221225472 BldHeightSetPointHighResolution "High resolution for the laser guided blade set point.";
CM_ SG_ 3221225472 ModifyLevelingSystemSetPoint "Used to control and coordinate the set point for the leveling system.";
CM_ SG_ 3221225472 MastPos "Used to monitor the position of the sensor attached to the land leveling mast.";
CM_ SG_ 3221225472 BladeCtrlMode "Allows the user to select the type of blade control for the land leveling system.";
CM_ SG_ 3221225472 BladeDurationAndDirection "Used to indicate the duration and direction that the land leveling system blade moves.";
CM_ SG_ 3221225472 LandLevelingSystemEnableStatus "Communicate the enable/disable status of the Land Leveling System.";
CM_ SG_ 3221225472 BladeCtrlModeRight "Indicate if the land leveling system's automatic control is active or inactive for the elevation sensor on the right side of the";
CM_ SG_ 3221225472 BladeCtrlModeLeft "Indicate if the land leveling system's automatic control is active or inactive for the elevation sensor on the left side of the";
CM_ SG_ 3221225472 LaserTracerInformation "Provides the status of the laser tracer to the operator.";
CM_ SG_ 3221225472 LEDDisplayData2 "Informs display devices how to display the current position of the laser tracer.";
CM_ SG_ 3221225472 LaserTracerHorizontalDeviation "The calculated percent deviation between the target distance and the center of the laser tracer.";
CM_ SG_ 3221225472 LaserTracerVerticalDistance "The elevation of the laser tracer sensor in a laser leveling system.";
CM_ SG_ 3221225472 LaserTracerTargetDeviation "The calculated distance for the laser target to the current laser tracer reference point.";
CM_ SG_ 3221225472 PoweredVehicleWeight "Total mass imposed by the tires of the powered vehicle on the road surface.";
CM_ SG_ 3221225472 GrossCombinationVehicleWeight "The total weight of the truck and all attached trailers.";
CM_ SG_ 3221225472 ForwardCollisionWarning "This parameter indicates if a collision is imminent and strong driver reaction either by braking hard or by an avoidance";
CM_ SG_ 3221225472 ACCDistanceAlertSignal "Signal to indicate to the operator that the ACC system is not able to maintain the distance to the target.";
CM_ SG_ 3221225472 ACCSystemShutoffWarning "Signal to warn the driver of system deactivation due to non-driver actions.";
CM_ SG_ 3221225472 ACCTargetDetected "Signal to indicate to the driver that the ACC system has detected a target.";
CM_ SG_ 3221225472 RoadCurvature "Estimated value of the current road curvature for use by the adaptive cruise control system.";
CM_ SG_ 3221225472 AdptveCruiseCtrlSetDistanceMode "Selected distance mode for adaptive cruise control.";
CM_ SG_ 3221225472 AdaptiveCruiseCtrlMode "This parameter is used to indicate the current state, or mode, of operation by the Adaptive Cruise Control (ACC) device.";
CM_ SG_ 3221225472 AdaptiveCruiseCtrlSetSpeed "Value of the desired (chosen) velocity of the adaptive cruise control system.";
CM_ SG_ 3221225472 DistanceToForwardVehicle "Distance to the preceding vehicle situated within 250 m in the same lane and moving in the same direction.";
CM_ SG_ 3221225472 SpeedOfForwardVehicle "Absolute velocity of the preceding vehicle situated within 250 m in the same lane and moving in the same direction.";
CM_ SG_ 3221225472 RearAxleRightWheelSpeed "High resolution measurement of the speed of the right wheel on the rear axle.";
CM_ SG_ 3221225472 RearAxleLeftWheelSpeed "High resolution measurement of the speed of the left wheel on the rear axle.";
CM_ SG_ 3221225472 FrontAxleRightWheelSpeed "High resolution measurement of the speed of the right wheel on the front axle.";
CM_ SG_ 3221225472 FrontAxleLeftWheelSpeed "High resolution measurement of the speed of the left wheel on the front axle.";
CM_ SG_ 3221225472 CabHeatingZone "Parameter indicating whether the cab zone is being heated.";
CM_ SG_ 3221225472 EngHeatingZone "Parameter indicating whether the engine zone is being heated.";
CM_ SG_ 3221225472 CabVentilation "Indicates whether the cab is being ventilated or not.";
CM_ SG_ 3221225472 AuxHeaterMode "State of the auxiliary heater";
CM_ SG_ 3221225472 AuxHeaterOutputPowerPercent "Current auxiliary heater output power, relative to the auxiliary heater maximum output power.";
CM_ SG_ 3221225472 AuxHeaterInputAirTemp "Temperature of the input air in an auxiliary heater system.";
CM_ SG_ 3221225472 AuxHeaterOutputCoolantTemp "Temperature of the auxiliary heater output coolant (I.";
CM_ SG_ 3221225472 AuxHeaterWaterPumpStatus "Parameter indicating whether the auxiliary heater water pump is running";
CM_ SG_ 3221225472 VehicleOverspeed "Indicates whether the vehicle is exceeding the legal speed limit set in the tachograph.";
CM_ SG_ 3221225472 VehicleMotion "Indicates whether motion of the vehicle is detected or not.";
CM_ SG_ 3221225472 TachographVehicleSpeed "Speed of the vehicle registered by the tachograph.";
CM_ SG_ 3221225472 TachographOutputShaftSpeed "Calculated speed of the transmission output shaft.";
CM_ SG_ 3221225472 DirectionIndicator "Indicates the direction of the vehicle.";
CM_ SG_ 3221225472 TachographPerformance "Indicates the tachograph performance; including electronic or mechanical analysis, instrument analysis, speed sensor";
CM_ SG_ 3221225472 HandlingInformation "Indicates that handling information is present.";
CM_ SG_ 3221225472 SystemEvent "Indicates that a tachograph event has occurred.";
CM_ SG_ 3221225472 DriverCardDriver2 "Indicates the presence of a driver card";
CM_ SG_ 3221225472 Driver2TimeRelatedStates "Indicates if the driver approaches or exceeds working time limits (or other limits).";
CM_ SG_ 3221225472 DriverCardDriver1 "Indicates the presence of a driver card";
CM_ SG_ 3221225472 Driver1TimeRelatedStates "Indicates if the driver approaches or exceeds working time limits (or other limits).";
CM_ SG_ 3221225472 Driver2WorkingState "State of work of the driver.";
CM_ SG_ 3221225472 Driver1WorkingState "State of work of the driver.";
CM_ SG_ 3221225472 FuelPumpPrimerStatus "Parameter used to transmit the actual status of the fuel priming system.";
CM_ SG_ 3221225472 EngFuelSupplyPumpIntakePress "Absolute pressure of fuel at the fuel supply pump intake.";
CM_ SG_ 3221225472 EngFuelFilterDiffPress "Differential pressure measured across the fuel filter located between the fuel tank and the supply pump.";
CM_ SG_ 3221225472 EngOilLevelRemoteReservoir "Ratio of current volume of engine oil in a remote reservoir to the maximum required volume.";
CM_ SG_ 3221225472 EngWasteOilReservoirLevel "Level of crankcase blowby emulsion collected by a container.";
CM_ SG_ 3221225472 EngVentilationStatus "Engine ventilation control states.";
CM_ SG_ 3221225472 EngOilPrimingState "Determination of whether or not the engine is (or has recently been) sufficiently lubricated for starting purposes.";
CM_ SG_ 3221225472 EngOilPrimingPumpSwitch "Switch input for activating the engine oil priming pump.";
CM_ SG_ 3221225472 EngOilPreHeatedState "Indicates whether the engine oil pre-heated sufficiently for starting purposes.";
CM_ SG_ 3221225472 EngOilFilterOutletPress "Oil pressure (gauge) measured just downstream of oil filter.";
CM_ SG_ 3221225472 EngCoolantPreheatedState "Indicates whether the engine coolant is pre-heated sufficiently for starting purposes.";
CM_ SG_ 3221225472 EngChargeAirCooler1OutletTemp "Temperature of combustion air after it exits from the Charge Air Cooler 1 but before any mixing of recirculated exhaust";
CM_ SG_ 3221225472 EngIntkVlvActationSystemOilTemp "The temperature of the oil in the hydraulic system that powers the intake valve actuation system.";
CM_ SG_ 3221225472 EngIntakeManifold1AirTemp "Temperature of pre-combustion air found in intake manifold of engine air supply system.";
CM_ SG_ 3221225472 EngCoolantTempHiRes "Temperature of liquid found in engine cooling system.";
CM_ SG_ 3221225472 WinchOilPressSwitch "State of switch used to determine if Winch Oil Pressure is above desired minimum";
CM_ SG_ 3221225472 HydOilLevel "This parameter indicates the level of the hydraulic fluid in tank as a ratio of current volume to total tank volume.";
CM_ SG_ 3221225472 HydOilFilterRestrictionSwitch "This switch indicates whether hydraulic oil filter is clogged.";
CM_ SG_ 3221225472 HydTemp "Temperature of hydraulic fluid.";
CM_ SG_ 3221225472 AuxHeaterMaxOutputPower "The maximum output power of the auxiliary heater.";
CM_ SG_ 3221225472 BatteryMainSwitchHoldState "Parameter indicating whether the battery main switch is held due to an external request or not.";
CM_ SG_ 3221225472 AmbientAirTemperature "Temperature of air surrounding vehicle.";
CM_ SG_ 3221225472 TrailerLeftSideMarkerLight "This signal indicates the state of the trailer left-hand side marker light(s).";
CM_ SG_ 3221225472 TrailerLeftReversingLight "This signal indicates the state of the trailer left-hand reversing light(s).";
CM_ SG_ 3221225472 TrailerLeftRearWidIndLight "This signal indicates the state of the trailer left-hand rear width indicator light(s).";
CM_ SG_ 3221225472 TrailerLeftRearRegPltLight "This signal indicates the state of the trailer left-hand rear registration-plate light(s).";
CM_ SG_ 3221225472 TrailerLeftRearLight "This signal indicates the state of the trailer left-hand rear light(s).";
CM_ SG_ 3221225472 TrailerLeftRearFogLight "This signal indicates the state of the trailer left-hand rear fog light(s).";
CM_ SG_ 3221225472 TrailerLeftDirIndLight "This signal indicates the state of the trailer left-hand direction indicator light(s).";
CM_ SG_ 3221225472 TrailerLeftCrnMarkerLight "This signal indicates the state of the trailer left-hand corner marker light(s).";
CM_ SG_ 3221225472 TrailerInteriorLight "This signal indicates the state of the trailer interior light(s).";
CM_ SG_ 3221225472 TrailerWorkLamp "This signal indicates the state of the trailer work lamp(s).";
CM_ SG_ 3221225472 TrailerRotatingIdentLight "This signal indicates the state of the trailer rotating identification light(s).";
CM_ SG_ 3221225472 TrailerRightStopLight "This signal indicates the state of the trailer right-hand stop light(s).";
CM_ SG_ 3221225472 TrailerRightSideMrkLight "This signal indicates the state of the trailer right-hand side marker light(s).";
CM_ SG_ 3221225472 TrailerRightReversingLight "This signal indicates the state of the trailer right-hand reversing light(s).";
CM_ SG_ 3221225472 TrailRightRearWidIndLight "This signal indicates the state of the trailer right-hand rear width indicator light(s).";
CM_ SG_ 3221225472 TrailerRightRearRegPltLight "This signal indicates the state of the trailer right-hand rear registration-plate light(s).";
CM_ SG_ 3221225472 TrailerRightRearLight "This signal indicates the state of the trailer right-hand rear light(s).";
CM_ SG_ 3221225472 TrailerRightRearFogLight "This signal indicates the state of the trailer right-hand rear fog light(s).";
CM_ SG_ 3221225472 TrailerRightDirIndLight "This signal indicates the state of the trailer right-hand direction indicator light(s).";
CM_ SG_ 3221225472 TrailerRightCrnMarkerLight "This signal indicates the state of the trailer right-hand corner marker light(s).";
CM_ SG_ 3221225472 TrailerRearWarningLight "This signal indicates the state of the trailer rear warning light(s).";
CM_ SG_ 3221225472 TrailerLeftStopLight "This signal indicates the state of the trailer left-hand stop light(s).";
CM_ SG_ 3221225472 ReferenceEngineTorque "The 100 % reference value for all defined indicated engine torque parameters.";
CM_ SG_ 3221225472 FuelLevelWarning "This signal indicates the decrease of the fuel level to a certain minimum.";
CM_ SG_ 3221225472 EngineOilPressureWarning "Signal which indicates that the engine oil pressure has reached its warning level.";
CM_ SG_ 3221225472 EngineCoolantTempWarning "Signal which indicates that the engine coolant temperature has reached its warning level.";
CM_ SG_ 3221225472 EngineOilPressure "Gauge pressure of the oil in the engine lubrication system as provided by the oil pump.";
CM_ SG_ 3221225472 EngineOilTemperature "Temperature of the engine lubricant.";
CM_ SG_ 3221225472 SecEngineMtdPTOSwitch "Signal which indicates the state of the second engine mounted power take off switch.";
CM_ SG_ 3221225472 SecClutchDpdtPTOSwitch "Signal which indicates the state of the second clutch dependent power take off switch.";
CM_ SG_ 3221225472 FirstClutchDpdtPTOSwitch "Signal which indicates the state of the first clutch dependent power take off switch.";
CM_ SG_ 3221225472 OperatingPanelActive "Signal which indicates that the operating panel is active.";
CM_ SG_ 3221225472 RefusePackerStepSwitch "Signal which indicates the state of the refuse packer step switch.";
CM_ SG_ 3221225472 EngineStopSwitch "Signal which indicates the state of the engine stop switch.";
CM_ SG_ 3221225472 EngineStartSwitch "Signal which indicates the state of the engine start switch.";
CM_ SG_ 3221225472 StarterLockoutSwitch "Signal which indicates the state of the starter lockout switch.";
CM_ SG_ 3221225472 RqstedPercentClutchSlip "Command signal to influence the clutch.";
CM_ SG_ 3221225472 FirstEngineMtdPTOSwitch "Signal which indicates the state of the first engine mounted power take off switch.";
CM_ SG_ 3221225472 ClutchIndpdtPTOSwitch "Signal which indicates the state of the clutch independent power take off switch.";
CM_ SG_ 3221225472 ClutchIndptdPTOFeedback "Signal which indicates the current state of the clutch independent power take off.";
CM_ SG_ 3221225472 AccelPedalPosition "The ratio of actual accelerator pedal position to maximum pedal position.";
CM_ SG_ 3221225472 AccelPedalLowIdleSwitch "Switch signal which indicates whether the accelerator pedal low idle switch is opened or closed.";
CM_ SG_ 3221225472 StarterActive "Signal which indicates whether the starter is in use.";
CM_ SG_ 3221225472 TorqueConvOilTemp "Temperature of the torque converter lubricant.";
CM_ SG_ 3221225472 TorqueConvtOilTempWarning "Signal which indicates that the torque converter oil temperature has reached its warning level.";
CM_ SG_ 3221225472 PTOControlAllowed "Switch signal which indicates that PTO control is allowed.";
CM_ SG_ 3221225472 SecEngineMtdPTOFeedback "Signal which indicates the current state of the second engine mounted power take off.";
CM_ SG_ 3221225472 FirstEngineMtdPTOFeedback "Signal which indicates the current state of the first engine mounted power take off.";
CM_ SG_ 3221225472 SecClutchDptdPTOFeedback "Signal which indicates the current state of the second clutch dependent power take off.";
CM_ SG_ 3221225472 FirstClutchDpdtPTOFeedback "Signal which indicates the current state of the first clutch dependent power take off.";
CM_ SG_ 3221225472 CurrentGear "The gear currently engaged in the transmission or the last gear engaged while the transmission is in process of shifting to the new or selected gear.";
CM_ SG_ 3221225472 ReqEngineSpeedUpperLim "The requested engine speed which is not to be exceeded.";
CM_ SG_ 3221225472 ReqEngineSpeedLowerLim "The requested minimum engine speed which the engine is to allow.";
CM_ SG_ 3221225472 ReqEngineTorqueLimit "The requested engine torque that the engine is not allowed to exceed, indicated as a ratio of the reference engine torque.";
CM_ SG_ 3221225472 ReqEngineSpeedLimit "The requested vehicle speed which the vehicle is not allowed to exceed.";
CM_ SG_ 3221225472 ReqEngineSpeed "This is the engine speed which the engine is expected to operate at.";
CM_ SG_ 3221225472 EngineTorqueMode "State signal which indicates which engine torque mode is currently generating, limiting, or controlling the torque";
CM_ SG_ 3221225472 PercentLoadAtCurrentSpeed "The ratio of actual engine percent torque to maximum indicated torque available at the current engine speed, clipped to zero torque during engine braking.";
CM_ SG_ 3221225472 EngineSpeed "Actual engine speed which is calculated over a minimum crankshaft angle of 720 degrees divided by
the number of cylinders.";
CM_ SG_ 3221225472 ActualEngine_PercTorque "The calculated output torque of the engine.";
CM_ SG_ 3221225472 DriversDemandEngine_PercTorque "The torque output of the engine requested by the driver.";
CM_ SG_ 3221225472 EngineRunning "Signal which indicates whether the engine is running.";
CM_ SG_ 3221225472 EngineControlAllowed "Switch signal which indicates that engine control is allowed.";
CM_ SG_ 3221225472 TyrePressThresholdDetect "Signal indicating the pressure level of the tyre.";
CM_ SG_ 3221225472 TyreModulePowerSupply "Signal indicating the power supply of the tyre module is sufficient to achieve the specified performance of the module.";
CM_ SG_ 3221225472 TyreTemperature "The temperature measured by the tyre module.";
CM_ SG_ 3221225472 AirLeakageDetection "The pressure loss of a tyre.";
CM_ SG_ 3221225472 TyreWheelIdentification2 "First part of the identification number of the tyre or whee (number of axles).";
CM_ SG_ 3221225472 TyreWheelIdentification1 "First part of the identification number of the tyre or whee (position on each axle).";
CM_ SG_ 3221225472 MaxVehicleSpeedLimit "Maximum vehicle velocity allowed.";
CM_ SG_ 3221225472 EngineSpeedUpperLimit "The engine speed which cannot be exceeded.";
CM_ SG_ 3221225472 EngineSpeedLowerLimit "The minimum engine speed which the engine is allowed to reach.";
CM_ SG_ 3221225472 RelVehBodyLevelRearAxle "Actual relative vehicle body height.";
CM_ SG_ 3221225472 RelVehBodyLevelFrontAxle "Actual relative vehicle body height.";
CM_ SG_ 3221225472 LnDprtureIndicationEnableStatus "Indicates whether lane departure indication is active.";
CM_ SG_ 3221225472 LaneTrackingStatusLeftSide "Indicates whether the left side is tracking lane.";
CM_ SG_ 3221225472 LaneTrackingStatusRightSide "Indicates whether right side is tracking lane.";
CM_ SG_ 3221225472 SpeedDependantLevelCtrlStatus "This parameter indicates if the function Speed Dependant Level Control is active.";
CM_ SG_ 3221225472 MemoryLevel "Signal which indicates that the air suspension control has memory levels selected or stored.";
CM_ SG_ 3221225472 AllwLvelCtrlDuringBrakingStatus "This parameter indicates if the function Allow Level Control During Braking is active.";
CM_ SG_ 3221225472 SspensionCtrlRefusalInformation "Signal which indicates that the air suspension control cannot perform a request due to the operating conditions.";
CM_ SG_ 3221225472 SuspensionRemoteCtrl2 "Signal which indicates that the suspension system is controlled by remote control #2.";
CM_ SG_ 3221225472 SuspensionRemoteCtrl1 "Signal which indicates that the suspension system is controlled by remote control #1.";
CM_ SG_ 3221225472 RearAxleInBumperRange "Signal which indicates that the vehicle height at the rear axle (SPNs 1723 and 1724) is within the bumper range.";
CM_ SG_ 3221225472 FrontAxleInBumperRange "Signal which indicates that the vehicle height at the front axle (SPNs 1721 and 1722) is within the bumper range.";
CM_ SG_ 3221225472 DoorRelease "Signal which indicates that the doors may be opened.";
CM_ SG_ 3221225472 VehicleMotionInhibit "Signal which indicates whether vehicle motion is inhibited.";
CM_ SG_ 3221225472 SecurityDevice "The signal which indicates the status of the security device.";
CM_ SG_ 3221225472 LevelCtrlMode "Signal which indicates the actual control mode of the air suspension system";
CM_ SG_ 3221225472 KneelingInformation "Signal which indicates the actual level change in case of kneeling function";
CM_ SG_ 3221225472 LiftingCtrlModeRearAxle "Signal which indicates the actual lifting level change at the rear axle";
CM_ SG_ 3221225472 LiftingCtrlModeFrontAxle "Signal which indicates the actual lifting level change at the front axle";
CM_ SG_ 3221225472 LoweringCtrlModeRearAxle "Signal which indicates the actual lowering level change at the rear axle";
CM_ SG_ 3221225472 LoweringCtrlModeFrontAxle "Signal which indicates the actual lowering level change at the front axle";
CM_ SG_ 3221225472 AboveNominalLevelRearAxle "Signal which indicates whether the actual height of the rear axle is above the nominal (desired) level of the rear axle.";
CM_ SG_ 3221225472 AboveNominalLevelFrontAxle "Signal which indicates whether the actual height of the front axle is above the nominal (desired) level of the front axle.";
CM_ SG_ 3221225472 BelowNominalLevelRearAxle "Signal which indicates whether the actual height of the rear axle is below the nominal (desired) level for the rear axle.";
CM_ SG_ 3221225472 BelowNominalLevelFrontAxle "Signal which indicates whether the actual height of the front axle is below the nominal (desired) level for the front axle.";
CM_ SG_ 3221225472 NominalLevelRearAxle "Signal which indicates the nominal (desired) height of the rear axle to be controlled by the suspension system.";
CM_ SG_ 3221225472 NominalLevelFrontAxle "Signal which indicates the nominal (desired) height of the front axle to be controlled by the suspension system.";
CM_ SG_ 3221225472 RelativeLevelRearAxleRight "Information of the height at the left side of the rear axle referred to normal level 1.";
CM_ SG_ 3221225472 RelativeLevelRearAxleLeft "Information of the height at the left side of the rear axle referred to normal level 1.";
CM_ SG_ 3221225472 RelativeLevelFrontAxleRight "Information of the height at the right side of the front axle referred to normal level 1.";
CM_ SG_ 3221225472 RelativeLevelFrontAxleLeft "Information of the height at the left side of the front axle referred to normal level 1.";
CM_ SG_ 3221225472 BellowPressRearAxleRight "Information of the pressure of the air suspension bellow at the right side of the rear axle";
CM_ SG_ 3221225472 BellowPressRearAxleLeft "Information of the pressure of the air suspension bellow at the left side of the rear axle";
CM_ SG_ 3221225472 BellowPressFrontAxleRight "Information of the pressure of the air suspension bellow at the right side of the front axle";
CM_ SG_ 3221225472 BellowPressFrontAxleLeft "Information of the pressure of the air suspension bellow at the left side of the front axle";
CM_ SG_ 3221225472 ElctrncShckAbsrbrCtrlMdLft_TgAxl "Signal which indicates the current mode of operation of the electronic shock absorber control at the lift/tag axle.";
CM_ SG_ 3221225472 ElctrncShckAbsrbrCtrlMdRearAxle "Signal which indicates the current mode of operation of the electronic shock absorber control at the rear axle.";
CM_ SG_ 3221225472 ElctrncShckAbsrbrCtrlMdFrntAxle "Signal which indicates the current mode of operation of the electronic shock absorber control at the front axle.";
CM_ SG_ 3221225472 DamperStiffnessLift_TagAxle "Damper stiffness information of the shock absorber control at the lift of tag axle";
CM_ SG_ 3221225472 DamperStiffnessRearAxle "Damper stiffness information of the shock absorber control at the rear axle";
CM_ SG_ 3221225472 DamperStiffnessFrontAxle "Damper stiffness information of the shock absorber control at the front axle";
CM_ SG_ 3221225472 Aftrtrtmnt1SCRCtlystRgntTnk1HtrP "Used to identify the applicable J1939-73 FMI detected in the SCR catalyst reagent tank 1 heater, by the manufacturer's";
CM_ SG_ 3221225472 Aftrtrtmnt1SCRCtalystTankHeater "Percentage of heating applied to the aftertreatment 1 catalyst tank heater.";
CM_ SG_ 3221225472 AftrtrtmntSCROprtrIndcmntSvrity "The severity of operator inducement for anomolies with the SCR system, such as tampering, low DEF quality, and DEF";
CM_ SG_ 3221225472 Aftrtrtmnt1SCRCtlystRgntTnk1TmpP "Used to identify the applicable J1939-73 FMI detected in the SCR catalyst reagent tank 1 temperature, by the";
CM_ SG_ 3221225472 Aftrtrtmnt1DEFTnkLwLvlIndicator "The desired illumination of the driver's warning indicator for diesel exhaust fluid (DEF) tank low level.";
CM_ SG_ 3221225472 Aftrtrtmnt1SCRCtlystTnkLvlPrlmnr "Used to identify the applicable J1939-73 FMI that applies to the most significant failure of the catalyst tank level sensor.";
CM_ SG_ 3221225472 Aftrtrtmnt1SCRCtalystTankLevel2 "The measure of the reagent level in the catalyst tank.";
CM_ SG_ 3221225472 Aftrtrtment1SCRCatalystTankTemp "Temperature of the reagent in the storage tank.";
CM_ SG_ 3221225472 Aftrtrtmnt1SCRCatalystTankLevel "A special catalyst uses a chemical reagent to reach legal requirement for NOX emissions.";
CM_ SG_ 3221225472 SpecificHeatRatio "The specific heat ratio of the fuel.";
CM_ SG_ 3221225472 EngLwLmtThrshldFrMxTrqFrmEngine "Minimum allowable value for maximum continuous torque from engine";
CM_ SG_ 3221225472 EngLwLmtThrshldFrMxRPMFrmEngine "Minimum allowable value for maximum continuous RPM from engine";
CM_ SG_ 3221225472 EngHghLmtThrshldFrMnCntnsTrqFrmE "Maximum allowable value for minimum continuous torque from engine";
CM_ SG_ 3221225472 EngHghLmtThrshldFrMnCntnsEngnRPM "Maximum allowable value for minimum continuous RPM from engine";
CM_ SG_ 3221225472 EngMinContinuousTorque "Applied limit for minimum continuous engine torque";
CM_ SG_ 3221225472 EngMaxContinuousTorque "Applied limit for maximum continuous engine torque.";
CM_ SG_ 3221225472 EngMinContinuousRPM "Applied limit for minimum continuous engine RPM";
CM_ SG_ 3221225472 EngMaxContinuousRPM "Applied limit for maximum continuous engine RPM";
CM_ SG_ 3221225472 MaxContinuousRetarderTorque "Applied limit for maximum continuous retarder torque.";
CM_ SG_ 3221225472 MinContinuousRetarderSpeed "Applied limit for minimum continuous retarder RPM";
CM_ SG_ 3221225472 MaxContinuousRetarderSpeed "Applied limit for maximum continuous retarder RPM";
CM_ SG_ 3221225472 MinContinuousRetarderTorque "Applied limit for minimum continuous retarder torque";
CM_ SG_ 3221225472 LwLmtThrshldFrMxTrqFromRetarder "Minimum allowable value for maximum continuous retarder torque.";
CM_ SG_ 3221225472 LwLmtThrshldFrMxRPMFromRetarder "Minimum allowable value for maximum continuous retarder speed";
CM_ SG_ 3221225472 HghLmtThrshldFrMnCntnsTrqFrmRtrd "Maximum allowable value for minimum continuous retarder torque.";
CM_ SG_ 3221225472 HghLmtThrshldFrMnCntnsRPMFrmRtrd "Maximum allowable value for minimum continuous retarder speed";
CM_ SG_ 3221225472 NetBatteryCurrentHiRes "Net flow of electrical current into/out-of the battery or batteries.";
CM_ SG_ 3221225472 AltCurrentHiRes "This parameter indicates the amount of electrical current output from the alternator of the main vehicle.";
CM_ SG_ 3221225472 ACCUsageDemand "This parameter indicates the drivers demand to activate or deactivate ACC keeping distance control.";
CM_ SG_ 3221225472 RqedACCDistanceMode "The Requested Distance Control Mode to the ACC system from the operators interface.";
CM_ SG_ 3221225472 Battery2Temp "Temperature of the battery 2.";
CM_ SG_ 3221225472 Battery1Temp "Temperature of the battery 1.";
CM_ SG_ 3221225472 YCBrakeCtrlActive "State signal which indicates that Yaw Control (YC) has activated brake control.";
CM_ SG_ 3221225472 YCEngCtrlActive "State Signal which indicates that the Yaw Control (YC) has commanded engine control to be active.";
CM_ SG_ 3221225472 ROPBrakeCtrlActive "State signal which indicates that Roll over Prevention (ROP) has activated brake control.";
CM_ SG_ 3221225472 ROPEngCtrlActive "State Signal which indicates that the Roll Over Prevention (ROP) has commanded engine control to be active.";
CM_ SG_ 3221225472 VDCBrakeLightRq "Indicates whether VDC requests to turn the vehicle brake lights on";
CM_ SG_ 3221225472 VDCFullyOperational "Signal that indicates whether VDC is fully operational or whether its functionality is reduced by a permanent or temporary";
CM_ SG_ 3221225472 VDCInformationSignal "This parameter commands the VDC information signal, for example a dash lamp.";
CM_ SG_ 3221225472 Status2OfDoors "Composite indication of all bus door statuses.";
CM_ SG_ 3221225472 Ramp_WheelChairLiftPos "Signal which indicates the actual position of the ramp / wheel chair lift.";
CM_ SG_ 3221225472 PosOfDoors "Signal which indicates the actual position of the doors.";
CM_ SG_ 3221225472 EngTotalAverageFuelEconomy "Average fuel economy, equal to total vehicle distance divided by total fuel used, over the life of the engine";
CM_ SG_ 3221225472 EngTotalAverageFuelRate "Average fuel rate, equal to total fuel used divided by total engine hours, over the life of the engine";
CM_ SG_ 3221225472 OprtrsBlckOutIntensitySelection "Operators Selection of lamp intensity in black out mode.";
CM_ SG_ 3221225472 BlackOutWorkLampSelect "Black Out Work Lamp Selection";
CM_ SG_ 3221225472 NightVisionIlluminatorSelect "Night Vision Illuminator Selection";
CM_ SG_ 3221225472 BlackOutBrake_StopLampSelect "Black Out Brake/Stop Lamp Selection";
CM_ SG_ 3221225472 ConvoyDrivingLampSelect "Black Out Convoy Driving Lamp Selection";
CM_ SG_ 3221225472 ConvoyLampSelect "Black Out Convoy Lamp Selection";
CM_ SG_ 3221225472 FrontBlackOutMarkerLampSelect "Front Black Out Marker Lamp Selection";
CM_ SG_ 3221225472 RearBlackOutMarkerSelect "Rear Black Out Marker Selection";
CM_ SG_ 3221225472 TransTorqueLimit "Parameter provided to the engine from the transmission as a torque limit to be invoked by the engine in the event that";
CM_ SG_ 3221225472 TrnsRvrseGearShiftInhibitStatus "Reflects the status of transmission reverse inhibit activity in response to requests via SPN 4242 - Transmission Reverse";
CM_ SG_ 3221225472 TrnsCrrntRangeDisplayBlankState "State signal indicating a transmission request for the display of the Transmission Current Range parameter (SPN 163) to";
CM_ SG_ 3221225472 TransWarningIndicator "Signal from transmission indicating that some aspect of its operation is not functioning correctly, and as a result,";
CM_ SG_ 3221225472 TransMode8Indicator "Indicates whether transmission mode 8 is enabled.";
CM_ SG_ 3221225472 TransMode7Indicator "Indicates whether transmission mode 7 is enabled.";
CM_ SG_ 3221225472 TransMode6Indicator "Indicates whether transmission mode 6 is enabled.";
CM_ SG_ 3221225472 TransMode5Indicator "Indicates whether transmission mode 5 is enabled.";
CM_ SG_ 3221225472 TransRqedGearFeedback "Feedback of the SPN 525 Transmission Requested Gear input as received from the shift selector, ABS or engine via";
CM_ SG_ 3221225472 TransMode1Indicator "This state signal is the transmission's indication that it is operating under transmission mode 1 (SPN 1852) as";
CM_ SG_ 3221225472 TransMode2Indicator "This state signal is the transmission's indication that it is operating under transmission mode 2 (SPN 1853) as";
CM_ SG_ 3221225472 TransMode3Indicator "This state signal is the transmission's indication that it is operating under transmission mode 3 (SPN 1854) as";
CM_ SG_ 3221225472 TransMode4Indicator "This state signal is the transmission's indication that it is operating under transmission mode 4 (SPN 1855) as";
CM_ SG_ 3221225472 TransShiftInhibitIndicator "State signal indicating a transmission request for the Shift Inhibit Indicator to be active or inactive.";
CM_ SG_ 3221225472 TransEngCrankEnable "State signal from the transmission indicating if the transmission's status is such that engine cranking is allowed (i.";
CM_ SG_ 3221225472 ActiveShiftConsoleIndicator "Signal from transmission control unit indicating which shift console (primary or secondary) it currently considers as the";
CM_ SG_ 3221225472 TransReadyForBrakeRelease "This parameter indicates that enough torque / motive force is available at the transmission output shaft to release all the";
CM_ SG_ 3221225472 TransRqedRangeDisplayFlashState "State signal indicating a transmission request for the display of the Transmission Requested Range parameter (SPN 162)";
CM_ SG_ 3221225472 TransRqedRangeDisplayBlankState "State signal indicating a transmission request for the display of the Transmission Requested Range parameter (SPN162)";
CM_ SG_ 3221225472 TransServiceIndicator "Signal from transmission indicating that some aspect of the gearbox requires servicing, such as the oil, filter, clutch(es) or";
CM_ SG_ 3221225472 ImplementRearWorkLightCmd "Command to activate or de-activate implement rear work lights.";
CM_ SG_ 3221225472 ImplmentLeftForwardWorkLightCmd "Command to activate or de-activate the forward facing work lights toward the left end of the implement.";
CM_ SG_ 3221225472 ImplmntRightForwardWorkLightCmd "Command to activate or de-activate the forward facing work lights toward the right end of the implement.";
CM_ SG_ 3221225472 LightingDataRqCmd "Command to provide a response of the light state";
CM_ SG_ 3221225472 ImplementLeftFacingWorkLightCmd "Command to activate or de-activate work lights mounted on an implement to illuminate beyond left end of the implement.";
CM_ SG_ 3221225472 ImplmentRightFacingWorkLightCmd "Command to activate or de-activate work lights mounted on an implement to illuminate beyond right end of the implement.";
CM_ SG_ 3221225472 ImplementOEMOption1LightCmd "Command to activate or de-activate an implement OEM option 1 light.";
CM_ SG_ 3221225472 ImplementOEMOption2LightCmd "Command to activate or de-activate an implement OEM option 2 light.";
CM_ SG_ 3221225472 TrctrFrntHghMuntedWorkLightsCmd "Command to activate or de-activate the tractor front high mounted work lights.";
CM_ SG_ 3221225472 TrctrFrntLwMountedWorkLightsCmd "Command to activate or de-activate the tractor front low mounted work lights.";
CM_ SG_ 3221225472 TrctrSdHighMountedWorkLightsCmd "Command to activate or de-activate the tractor side high mounted work lights.";
CM_ SG_ 3221225472 TrctrSdeLowMountedWorkLightsCmd "Command to activate or de-activate the tractor side low mounted work lights.";
CM_ SG_ 3221225472 TrctrRrHighMountedWorkLightsCmd "Command to activate or de-activate the tractor rear high mounted work lights.";
CM_ SG_ 3221225472 TrctrRarLowMountedWorkLightsCmd "Command to activate or de-activate the tractor rear low mounted work lights.";
CM_ SG_ 3221225472 TrctrUndrsdMountedWorkLightsCmd "Command to activate or de-activate the tractor underside mounted work lights.";
CM_ SG_ 3221225472 RearFogLightCmd "Command to activate or de-activate tractor or implement rear fog lights.";
CM_ SG_ 3221225472 TractorMarkerLightCmd "Command to activate or de-activate tractor and implement front position lights, rear red tail lights, side amber running";
CM_ SG_ 3221225472 ImplementMarkerLightCmd "Command to activate or de-activate implement front position lights, rear red tail lights, side amber running lights, license";
CM_ SG_ 3221225472 TractorClearanceLightCmd "Command to activate or de-activate the tractor high mounted clearance and center ID lights";
CM_ SG_ 3221225472 ImplementClearanceLightCmd "Command to activate or de-activate the implement high mounted clearance and lights.";
CM_ SG_ 3221225472 LeftStopLightCmd "Command to activate or de-activate the tractor and implement left stop lights";
CM_ SG_ 3221225472 RightStopLightCmd "Command to activate or de-activate the tractor and implement right stop light";
CM_ SG_ 3221225472 CenterStopLightCmd "Command to activate or de-activate the tractor and implement center stop light";
CM_ SG_ 3221225472 BackUpLightAndAlarmHornCmd "Command to activate or de-activate the back up lights and/ or associated alarm if required";
CM_ SG_ 3221225472 LeftTurnSignalLightsCmd "Command to activate or de-activate left turn signal lights on the tractor and all connected implements";
CM_ SG_ 3221225472 RightTurnSignalLightsCmd "Command to activate or de-activate right turn signal lights on the tractor and all connected implements";
CM_ SG_ 3221225472 RotatingBeaconLightCmd "Command to activate or de-activate slow moving vehicle indicator lights on tractor and/or implements.";
CM_ SG_ 3221225472 TractorFrontFogLightsCmd "Command to activate or de-activate tractor front fog lights.";
CM_ SG_ 3221225472 HighBeamHeadLightCmd "Command to activate or de-activate the tractor high beam head light lamps.";
CM_ SG_ 3221225472 LowBeamHeadLightCmd "Command to activate or de-activate the tractor low beam head light lamps.";
CM_ SG_ 3221225472 AltBeamHeadLightCmd "Command to activate or de-activate the tractor alternate head lights (only low beam is available on alternate head lights).";
CM_ SG_ 3221225472 RunningLightCmd "Command to activate or de-activate the tractor or powered vehicle running lights.";
CM_ SG_ 3221225472 ImplementRearWorkLight "This parameter provides measured data from the implement rear work lamps.";
CM_ SG_ 3221225472 ImplementLeftForwardWorkLight "This parameter provides measured data from the forward facing work lights toward the left end of the implement.";
CM_ SG_ 3221225472 ImplementRightForwardWorkLight "This parameter provides measured data from the forward facing work lights toward the right end of the implement.";
CM_ SG_ 3221225472 ImplementLeftFacingWorkLight "This parameter provides measured data from the work lights mounted on an implement to illuminate beyond left end of";
CM_ SG_ 3221225472 ImplementRightFacingWorkLight "This parameter provides measured data from the work lights mounted on an implement to illuminate beyond right end of";
CM_ SG_ 3221225472 ImplementOEMOption1Light "This parameter provides measured data from the implement OEM option 1 light.";
CM_ SG_ 3221225472 ImplementOEMOption2Light "This parameter provides measured data from the implement OEM option 2 light.";
CM_ SG_ 3221225472 TrctrFrontHighMountedWorkLights "This parameter provides measured data from the tractor front high mounted work lights.";
CM_ SG_ 3221225472 TrctorFrontLowMountedWorkLights "This parameter provides measured data from the tractor front low mounted work lights.";
CM_ SG_ 3221225472 TrctorSideHighMountedWorkLights "This parameter provides measured data from the tractor side high mounted work lights.";
CM_ SG_ 3221225472 TractorSideLowMountedWorkLights "This parameter provides measured data from the tractor side low mounted work lights.";
CM_ SG_ 3221225472 TrctorRearHighMountedWorkLights "This parameter provides measured data from the tractor rear high mounted work lights.";
CM_ SG_ 3221225472 TractorRearLowMountedWorkLights "This parameter provides measured data from the tractor rear low mounted work lights.";
CM_ SG_ 3221225472 TrctrUndersideMountedWorkLights "This parameter provides measured data from the tractor underside mounted work lights.";
CM_ SG_ 3221225472 RearFogLights "This parameter provides measured data from the tractor and/or implement rear fog lights.";
CM_ SG_ 3221225472 TractorMarkerLight "This parameter provides measured data from the tractor and attached implement marker lights, including front position";
CM_ SG_ 3221225472 ImplementMarkerLight "This parameter provides measured data from an attached implement marker lights, including front position lights, rear tail";
CM_ SG_ 3221225472 TractorClearanceLight "This parameter provides measured data from the tractor high mounted clearance and center ID lights.";
CM_ SG_ 3221225472 ImplementClearanceLight "This parameter provides measured data from an attached implement high mounted clearance lights.";
CM_ SG_ 3221225472 LeftStopLight "This parameter provides measured data from the tractor and attached implement left stop lights.";
CM_ SG_ 3221225472 RightStopLight "This parameter provides measured data from the tractor and attached implement right stop lights.";
CM_ SG_ 3221225472 CenterStopLight "This parameter provides measured data from the tractor and attached implement center stop lights.";
CM_ SG_ 3221225472 BackUpLightAndAlarmHorn "This parameter provides measured data from the back up lights and/ or associated alarm.";
CM_ SG_ 3221225472 LeftTurnSignalLights "This parameter provides measured data from the tractor and attached implement left turn signal lights.";
CM_ SG_ 3221225472 RightTurnSignalLights "This parameter provides measured data from the tractor and attached implement right turn signal lights.";
CM_ SG_ 3221225472 RotatingBeaconLight "This parameter provides measured data from the beacon light on tractor or attached implements.";
CM_ SG_ 3221225472 TractorFrontFogLights "This parameter provides measured data from the tractor front fog lights.";
CM_ SG_ 3221225472 HighBeamHeadLightData "This parameter provides measured data from the tractor high beam head light lamps.";
CM_ SG_ 3221225472 LowBeamHeadLightData "This parameter provides measured data from the tractor low beam head light lamps.";
CM_ SG_ 3221225472 AltBeamHeadLightData "This parameter provides measured data from the tractor alternate beam head light lamps.";
CM_ SG_ 3221225472 RunningLight "This parameter provides measured data from the vehicle's running lights.";
CM_ SG_ 3221225472 EngExhaustGasTempRightManifold "Temperature of combustion byproducts within the right engine exhaust manifold.";
CM_ SG_ 3221225472 EngExhaustGasTempLeftManifold "Temperature of combustion byproducts within the left engine exhaust manifold.";
CM_ SG_ 3221225472 GeneratorAverageACRMSCurrent "Average RMS current measured at the generator output.";
CM_ SG_ 3221225472 GeneratorAverageACFrequency "Average AC frequency measured at the generator output.";
CM_ SG_ 3221225472 GnrtrAvrgLneNeutralACRMSVoltage "The average Line to Neutral AC RMS voltage measured at the Generator output.";
CM_ SG_ 3221225472 GnrtrAvrageLineLineACRMSVoltage "Average Line to Line RMS voltage measured at the generator output.";
CM_ SG_ 3221225472 GeneratorTotalApparentPower "The total apparent power delivered by the generator.";
CM_ SG_ 3221225472 GeneratorTotalRealPower "Total real power delivered by the generator.";
CM_ SG_ 3221225472 GnrtorOverallPowerFactorLagging "Lead/lag status for generator average power factor.";
CM_ SG_ 3221225472 GeneratorOverallPowerFactor "The average power factor of the generator.";
CM_ SG_ 3221225472 GeneratorTotalReactivePower "The total reactive power delivered by the generator";
CM_ SG_ 3221225472 GeneratorPhaseAACRMSCurrent "RMS current measured at the generator phase A output.";
CM_ SG_ 3221225472 GeneratorPhaseAACFrequency "AC frequency measured at the generator phase A output.";
CM_ SG_ 3221225472 GnrtrPhsALneNeutralACRMSVoltage "Line to Neutral RMS voltage measured at the generator phase A output.";
CM_ SG_ 3221225472 GnrtrPhseABLineLineACRMSVoltage "Line to Line RMS voltage measured at the generator phase AB output.";
CM_ SG_ 3221225472 GeneratorPhaseAApparentPower "The apparent power delivered by phase A of the generator.";
CM_ SG_ 3221225472 GeneratorPhaseARealPower "The real power delivered by phase A of the generator.";
CM_ SG_ 3221225472 GnratorPhaseAPowerFactorLagging "Lead/lag status for generator phase A power factor.";
CM_ SG_ 3221225472 GeneratorPhaseAPowerFactor "The power factor of phase A of the generator.";
CM_ SG_ 3221225472 GeneratorPhaseAReactivePower "The reactive power delivered by phase A of the generator";
CM_ SG_ 3221225472 GeneratorPhaseBACRMSCurrent "RMS current measured at the generator phase B output.";
CM_ SG_ 3221225472 GeneratorPhaseBACFrequency "AC frequency measured at the generator phase B output.";
CM_ SG_ 3221225472 GnrtrPhsBLneNeutralACRMSVoltage "Line to Neutral RMS voltage measured at the generator phase B output.";
CM_ SG_ 3221225472 GnrtrPhseBCLineLineACRMSVoltage "Line to Line RMS voltage measured at the generator phase BC output.";
CM_ SG_ 3221225472 GeneratorPhaseBApparentPower "The apparent power delivered by phase B of the generator.";
CM_ SG_ 3221225472 GeneratorPhaseBRealPower "The real power delivered by phase B of the generator.";
CM_ SG_ 3221225472 GnratorPhaseBPowerFactorLagging "Lead/lag status for generator phase B power factor.";
CM_ SG_ 3221225472 GeneratorPhaseBPowerFactor "The power factor of phases B of the generator.";
CM_ SG_ 3221225472 GeneratorPhaseBReactivePower "The reactive power delivered by phase B of the generator";
CM_ SG_ 3221225472 GeneratorPhaseCACRMSCurrent "RMS current measured at the generator phase C output.";
CM_ SG_ 3221225472 GeneratorPhaseCACFrequency "AC frequency measured at the generator phase C output.";
CM_ SG_ 3221225472 GnrtrPhsCLneNeutralACRMSVoltage "Line to Neutral RMS voltage measured at the generator phase C output.";
CM_ SG_ 3221225472 GnrtrPhseCALineLineACRMSVoltage "Line to Line RMS voltage measured at the generator phase CA output.";
CM_ SG_ 3221225472 GeneratorPhaseCApparentPower "The apparent power delivered by phase C of the generator.";
CM_ SG_ 3221225472 GeneratorPhaseCRealPower "The real power delivered by phase C of the generator.";
CM_ SG_ 3221225472 GnratorPhaseCPowerFactorLagging "Lead/lag status for generator phase C power factor.";
CM_ SG_ 3221225472 GeneratorPhaseCPowerFactor "The power factor of phases C of the generator.";
CM_ SG_ 3221225472 GeneratorPhaseCReactivePower "The reactive power delivered by phase C of the generator";
CM_ SG_ 3221225472 GeneratorTotalKWHoursImport "The total kilowatt-hours that have been imported by the generator.";
CM_ SG_ 3221225472 GeneratorTotalKWHoursExport "The total kilowatt-hours that have been exported by the generator.";
CM_ SG_ 3221225472 UtilityAverageACRMSCurrent "Average RMS current measured at the utility incomer.";
CM_ SG_ 3221225472 UtilityAverageACFrequency "Average AC frequency measured at the utility incomer.";
CM_ SG_ 3221225472 UtltyAvrgLneNeutralACRMSVoltage "The average Line to Neutral AC RMS voltage measured at the utility incomer .";
CM_ SG_ 3221225472 UtltyAvrageLineLineACRMSVoltage "Average Line to Line RMS voltage measured at the utility incomer .";
CM_ SG_ 3221225472 UtilityTotalApparentPower "The total apparent power delivered by the utility incomer.";
CM_ SG_ 3221225472 UtilityTotalRealPower "Total real power delivered by the utility incomer.";
CM_ SG_ 3221225472 UtlityOverallPowerFactorLagging "Lead/lag status for utility incomer average power factor.";
CM_ SG_ 3221225472 UtilityOverallPowerFactor "The average power factor of the utility incomer.";
CM_ SG_ 3221225472 UtilityTotalReactivePower "The total reactive power delivered by the utility incomer";
CM_ SG_ 3221225472 UtilityPhaseAACRMSCurrent "RMS current measured at the utility incomer phase A.";
CM_ SG_ 3221225472 UtilityPhaseAACFrequency "AC frequency measured at the utility incomer phase A.";
CM_ SG_ 3221225472 UtltyPhsALneNeutralACRMSVoltage "Line to Neutral RMS voltage measured at the utility incomer phase A.";
CM_ SG_ 3221225472 UtltyPhseABLineLineACRMSVoltage "Line to Line RMS voltage measured at the utility incomer phase AB.";
CM_ SG_ 3221225472 UtilityPhaseAApparentPower "The apparent power delivered by phase A of the utility incomer.";
CM_ SG_ 3221225472 UtilityPhaseARealPower "The real power delivered by phase A of the utility incomer.";
CM_ SG_ 3221225472 UtilityPhaseAPowerFactorLagging "Lead/lag status for utility incomer phase A power factor.";
CM_ SG_ 3221225472 UtilityPhaseAPowerFactor "The power factor of phase A of the utility incomer.";
CM_ SG_ 3221225472 UtilityPhaseAReactivePower "The reactive power delivered by phase A of the utility incomer";
CM_ SG_ 3221225472 UtilityPhaseBACRMSCurrent "RMS current measured at the utility incomer phase B.";
CM_ SG_ 3221225472 UtilityPhaseBACFrequency "AC frequency measured at the utility incomer phase B.";
CM_ SG_ 3221225472 UtltyPhsBLneNeutralACRMSVoltage "Line to Neutral RMS voltage measured at the utility incomer phase B.";
CM_ SG_ 3221225472 UtltyPhseBCLineLineACRMSVoltage "Line to Line RMS voltage measured at the utility incomer phase BC.";
CM_ SG_ 3221225472 UtilityPhaseBApparentPower "The apparent power delivered by phase B of the utility incomer.";
CM_ SG_ 3221225472 UtilityPhaseBRealPower "The real power delivered by phase B of the utility incomer.";
CM_ SG_ 3221225472 UtilityPhaseBPowerFactorLagging "Lead/lag status for utility incomer phase B power factor.";
CM_ SG_ 3221225472 UtilityPhaseBPowerFactor "The power factor of phases B of the utility incomer.";
CM_ SG_ 3221225472 UtilityPhaseBReactivePower "The reactive power delivered by phase B of the utility incomer";
CM_ SG_ 3221225472 UtilityPhaseCACRMSCurrent "RMS current measured at the utility incomer phase C.";
CM_ SG_ 3221225472 UtilityPhaseCACFrequency "AC frequency measured at the utility incomer phase C.";
CM_ SG_ 3221225472 UtltyPhsCLneNeutralACRMSVoltage "Line to Neutral RMS voltage measured at the utility incomer phase C.";
CM_ SG_ 3221225472 UtltyPhseCALineLineACRMSVoltage "Line to Line RMS voltage measured at the utility incomer phase CA.";
CM_ SG_ 3221225472 UtilityPhaseCApparentPower "The apparent power delivered by phase C of the utility incomer.";
CM_ SG_ 3221225472 UtilityPhaseCRealPower "The real power delivered by phase C of the utility incomer.";
CM_ SG_ 3221225472 UtilityPhaseCPowerFactorLagging "Lead/lag status for utility incomer phase C power factor.";
CM_ SG_ 3221225472 UtilityPhaseCPowerFactor "The power factor of phases C of the utility incomer.";
CM_ SG_ 3221225472 UtilityPhaseCReactivePower "The reactive power delivered by phase C of the utility incomer";
CM_ SG_ 3221225472 UtilityTotalKWHoursImport "The total kilowatt-hours that have been imported by the utility incomer.";
CM_ SG_ 3221225472 UtilityTotalKWHoursExport "The total kilowatt-hours that have been exported by the utility incomer.";
CM_ SG_ 3221225472 Bus1AverageACFrequency "Average AC frequency measured at bus #1.";
CM_ SG_ 3221225472 Bs1AvrgeLineNeutralACRMSVoltage "The average Line to Neutral AC RMS voltage measured at bus #1 .";
CM_ SG_ 3221225472 Bus1AverageLineLineACRMSVoltage "Average Line to Line RMS voltage measured at bus #1 .";
CM_ SG_ 3221225472 Bus1PhaseAACFrequency "AC frequency measured at bus #1 phase A.";
CM_ SG_ 3221225472 Bs1PhseALineNeutralACRMSVoltage "Line to Neutral RMS voltage measured at bus #1 phase A.";
CM_ SG_ 3221225472 Bus1PhaseABLineLineACRMSVoltage "Line to Line RMS voltage measured at bus #1 phase AB.";
CM_ SG_ 3221225472 Bus1PhaseBACFrequency "AC frequency measured at bus #1 phase B.";
CM_ SG_ 3221225472 Bs1PhseBLineNeutralACRMSVoltage "Line to Neutral RMS voltage measured at bus #1 phase B.";
CM_ SG_ 3221225472 Bus1PhaseBCLineLineACRMSVoltage "Line to Line RMS voltage measured at bus #1 phase BC.";
CM_ SG_ 3221225472 Bus1PhaseCACFrequency "AC frequency measured at bus #1 phase C.";
CM_ SG_ 3221225472 Bs1PhseCLineNeutralACRMSVoltage "Line to Neutral RMS voltage measured at bus #1 phase C.";
CM_ SG_ 3221225472 Bus1PhaseCALineLineACRMSVoltage "Line to Line RMS voltage measured at bus #1 phase CA.";
CM_ SG_ 3221225472 Bus1_GeneratorACPhaseDifference "The phase difference between the Bus #1 voltage and Generator voltage.";
CM_ SG_ 3221225472 Bus1_GeneratorInSync "Indicator of whether Bus #1 and Generator are properly synchronized for paralleling. This indicator will be based on parameters such as Voltage Match, Frequency Match, and Phase Match.";
CM_ SG_ 3221225472 Bus1_GeneratorVoltageMatch "Indicator of whether voltage difference between Bus #1 and Generator is adequate for paralleling. This indicator will be based on the measured AC voltages qualified using parameters such as Voltage Tolerance.";
CM_ SG_ 3221225472 Bus1_GeneratorFrequencyMatch "Indicator of whether frequency difference between Bus #1 and Generator is adequate for paralleling. This indicator will be based on the measured AC frequencies qualified using parameters such as Frequency Tolerance, Phase Tolerance, and Dwell Time.";
CM_ SG_ 3221225472 Bus1_GeneratorPhaseMatch "Indicator of whether phase difference between Bus #1 and Generator is adequate for paralleling. This indicator will be based on the measured AC phase difference qualified using parameters such as Phase Tolerance and Dwell Time.";
CM_ SG_ 3221225472 Bus1_GeneratorDeadBus "Indicator of whether Bus #1 is considered dead for closing to the generator. This indicator will be based on parameters such as Bus #1 Voltage and dead bus threshold values.";
CM_ SG_ 3221225472 Bus1_UtilityACPhaseDifference "The phase difference between the Bus #1 voltage and Utility voltage.";
CM_ SG_ 3221225472 Bus1_UtilityInSync "Indicator of whether Bus #1 and Utility are properly synchronized for paralleling. This indicator will be based on parameters such as Voltage Match, Frequency Match, and Phase Match.";
CM_ SG_ 3221225472 Bus1_UtilityVoltageMatch "Indicator of whether voltage difference between Bus #1 and Utility is adequate for paralleling. This indicator will be based on the measured AC voltages qualified using parameters such as Voltage Tolerance.";
CM_ SG_ 3221225472 Bus1_UtilityFrequencyMatch "Indicator of whether frequency difference between Bus #1 and Utility is adequate for paralleling. This indicator will be based on the measured AC frequencies qualified using parameters such as Frequency Tolerance, Phase Tolerance, and Dwell Time.";
CM_ SG_ 3221225472 Bus1_UtilityPhaseMatch "Indicator of whether phase difference between Bus #1 and Utility is adequate for paralleling. This indicator will be based on the measured AC phase difference qualified using parameters such as Phase Tolerance and Dwell Time.";
CM_ SG_ 3221225472 Bus1_UtilityDeadBus "Indicator of whether Bus #1 is considered dead for closing to the utility. This indicator will be based on parameters such as Bus #1 Voltage and dead bus threshold values.";
CM_ SG_ 3221225472 HydBrakeFluidLevelSwitch "Signal which indicates whether the hydraulic fluid level in the reservoir(s) is sufficient.";
CM_ SG_ 3221225472 HydBrakeSystemAudibleWarningCmd "Signal which commands an audible warning by the hydraulic braking system.";
CM_ SG_ 3221225472 HydBrkePressSupplyStateCircuit2 "Signal which indicates whether the hydraulic brake pressure supply of circuit 2 is reliable; that is, able to support";
CM_ SG_ 3221225472 HydBrkePressSupplyStateCircuit1 "Signal which indicates whether the hydraulic brake pressure supply of circuit 1 is reliable; that is, able to support";
CM_ SG_ 3221225472 HydBrkPressWarningStateCircuit2 "Signal which indicates whether the hydraulic brake pressure of circuit 2 is below the warning level";
CM_ SG_ 3221225472 HydBrkPressWarningStateCircuit1 "Signal which indicates whether the hydraulic brake pressure of circuit 1 is below the warning level";
CM_ SG_ 3221225472 HydBrakePressCircuit2 "Gage hydraulic pressure in circuit 2 of the hydraulic brake system";
CM_ SG_ 3221225472 HydBrakePressCircuit1 "Gage hydraulic pressure in circuit 1 of the hydraulic brake system";
CM_ SG_ 3221225472 AppliedVehicleSpeedLimit "The vehicle speed limit in effect.";
CM_ SG_ 3221225472 MaxVehicleSpeedLimit7 "The highest of the seven lowest vehicle speed limits";
CM_ SG_ 3221225472 MaxVehicleSpeedLimit6 "The highest of the six lowest vehicle speed limits";
CM_ SG_ 3221225472 MaxVehicleSpeedLimit5 "The highest of the five lowest vehicle speed limits";
CM_ SG_ 3221225472 MaxVehicleSpeedLimit4 "The highest of the four lowest vehicle speed limits";
CM_ SG_ 3221225472 MaxVehicleSpeedLimit3 "The highest of the three lowest vehicle speed limits";
CM_ SG_ 3221225472 MaxVehicleSpeedLimit2 "The highest of the two lowest vehicle speed limits";
CM_ SG_ 3221225472 MaxVehicleSpeedLimit1 "The lowest Maximum Vehicle Speed Limit.";
CM_ SG_ 3221225472 PayloadPercentage "The current payload of the equipment, reported as a percentage of the equipment's rated payload limit.";
CM_ SG_ 3221225472 TravelVelocityCtrlPos "The position of the travel velocity control component reported as a percentage of the control's full displacement in each";
CM_ SG_ 3221225472 AirSuspensionSupplyPressRq "Command signal to influence the pneumatic pressure in the circuit for the electronically controlled air suspension system.";
CM_ SG_ 3221225472 AuxEquipmentSupplyPressRq "Command signal to influence the pneumatic pressure in the auxiliary circuit.";
CM_ SG_ 3221225472 ServiceBrakeAirPressRqCircuit2 "Command signal to influence the pneumatic pressure in the service brake circuit or reservoir #2.";
CM_ SG_ 3221225472 ServiceBrakeAirPressRqCircuit1 "Command signal to influence the pneumatic pressure in the service brake circuit or reservoir #1.";
CM_ SG_ 3221225472 ParkingAnd_OrTrailerAirPressRq "Command signal to influence the pneumatic pressure in the circuit or reservoir for the parking brake and/or the trailer supply.";
CM_ SG_ 3221225472 PneumaticSupplyPressRq "Command signal to influence the pneumatic pressure in the main reservoir.";
CM_ SG_ 3221225472 CbA_CRfrgrntCmprssorOutletPress "This is the gage pressure at the compressor outlet in the cab air conditioning system.";
CM_ SG_ 3221225472 SpecificHumidity "Specific humidity of the ambient intake air.";
CM_ SG_ 3221225472 SolarSensorMax "This is the maximum value which can be reported by the sensor for the solar intensity.";
CM_ SG_ 3221225472 SolarIntensityPercent "This is the solar radiation (power density) falling on the vehicle in percent of the maximum sensor value (SPN 2611).";
CM_ SG_ 3221225472 FrontWheelDriveActuatorStatus "Feedback on the front wheel drive actuator.";
CM_ SG_ 3221225472 SlowVesselModeStatus "The status of the Slow Vessel Mode.";
CM_ SG_ 3221225472 TrollingModeStatus "The status of the Trolling Mode.";
CM_ SG_ 3221225472 EngThrttlSynchrnztionModeStatus "The status of the Throttle Synchronization Mode.";
CM_ SG_ 3221225472 Jystck3GripXAxisDetentPosStatus "Reports when the current joystick grip position is in the detent position for that axis of travel.";
CM_ SG_ 3221225472 Jystck3GripYAxisDetentPosStatus "Reports when the current joystick grip position is in the detent position for that axis of travel.";
CM_ SG_ 3221225472 Jystck3ThetaAxisDetentPosStatus "Reports when the current joystick position is in the detent position for that axis of travel.";
CM_ SG_ 3221225472 Joystick3ThetaAxisPos "The position of the joystick in the relative motion of travel from the neutral position.";
CM_ SG_ 3221225472 Jystck3ThtAxsClckwsPstvPsStatus "Reports when the current joystick position is on the positive travel side (forward, right, clockwise, up) relative to the";
CM_ SG_ 3221225472 Jystck3ThtaAxisNeutralPosStatus "Reports when the current joystick position is in the neutral position for that axis of travel.";
CM_ SG_ 3221225472 Joystick3GripYAxisPos "The position of the joystick grip in the relative motion of travel from the neutral position.";
CM_ SG_ 3221225472 Jystck3GrpYAxsLvrFrwrdPstvPsStts "Reports when the current joystick grip position is on the positive travel side (forward, right, clockwise, up) relative to the";
CM_ SG_ 3221225472 Jystck3GrpYAxsLvrBckNgtvPsSttus "Reports when the current joystick grip position is on the negative travel side (back, left, counterclockwise, down) relative";
CM_ SG_ 3221225472 Jystck3GrpYAxisNeutralPosStatus "Reports when the current joystick grip position is in the neutral position for that axis of travel.";
CM_ SG_ 3221225472 Joystick3GripXAxisPos "The position of the joystick grip in the relative motion of travel from the neutral position.";
CM_ SG_ 3221225472 Jystck3GrpXAxsLvrRghtPstvPsStts "Reports when the current joystick grip position is on the positive travel side (forward, right, clockwise, up) relative to the";
CM_ SG_ 3221225472 Jystck3GrpXAxsLvrLftNgtvPsSttus "Reports when the current joystick grip position is on the negative travel side (back, left, counterclockwise, down) relative";
CM_ SG_ 3221225472 Jystck3GrpXAxisNeutralPosStatus "Reports when the current joystick grip position is in the neutral position for that axis of travel.";
CM_ SG_ 3221225472 Jystck3ThtAxsCntrClckwsNgtvPsStt "Reports when the current joystick position is on the negative travel side (back, left, counterclockwise, down) relative to the";
CM_ SG_ 3221225472 Joystick3XAxisDetentPosStatus "Reports when the current joystick position is in the detent position for that axis of travel.";
CM_ SG_ 3221225472 Joystick3Button9PressedStatus "Reports when the joystick button has been pressed.";
CM_ SG_ 3221225472 Joystick3Button10PressedStatus "Reports when the joystick button has been pressed.";
CM_ SG_ 3221225472 Joystick3Button11PressedStatus "Reports when the joystick button has been pressed.";
CM_ SG_ 3221225472 Joystick3Button12PressedStatus "Reports when the joystick button has been pressed.";
CM_ SG_ 3221225472 Joystick3YAxisDetentPosStatus "Reports when the current joystick position is in the detent position for that axis of travel.";
CM_ SG_ 3221225472 Joystick3YAxisPos "The position of the joystick in the relative motion of travel from the neutral position.";
CM_ SG_ 3221225472 Jystck3YAxsLvrFrwrdPstvPsStatus "Reports when the current joystick position is on the positive travel side (forward, right, clockwise, up) relative to the";
CM_ SG_ 3221225472 Jystck3YAxsLvrBckNgtvePosStatus "Reports when the current joystick position is on the negative travel side (back, left, counterclockwise, down) relative to the";
CM_ SG_ 3221225472 Joystick3YAxisNeutralPosStatus "Reports when the current joystick position is in the neutral position for that axis of travel.";
CM_ SG_ 3221225472 Joystick3XAxisPos "The position of the joystick in the relative motion of travel from the neutral position.";
CM_ SG_ 3221225472 Jystck3XAxsLvrRghtPstvPosStatus "Reports when the current joystick position is on the positive travel side (forward, right, clockwise, up) relative to the";
CM_ SG_ 3221225472 Jystck3XAxsLvrLftNgtvePosStatus "Reports when the current joystick position is on the negative travel side (back, left, counterclockwise, down) relative to the";
CM_ SG_ 3221225472 Joystick3XAxisNeutralPosStatus "Reports when the current joystick position is in the neutral position for that axis of travel.";
CM_ SG_ 3221225472 Joystick3Button5PressedStatus "Reports when the joystick button has been pressed.";
CM_ SG_ 3221225472 Joystick3Button6PressedStatus "Reports when the joystick button has been pressed.";
CM_ SG_ 3221225472 Joystick3Button7PressedStatus "Reports when the joystick button has been pressed.";
CM_ SG_ 3221225472 Joystick3Button8PressedStatus "Reports when the joystick button has been pressed.";
CM_ SG_ 3221225472 Joystick3Button1PressedStatus "Reports when the joystick button has been pressed.";
CM_ SG_ 3221225472 Joystick3Button2PressedStatus "Reports when the joystick button has been pressed.";
CM_ SG_ 3221225472 Joystick3Button3PressedStatus "Reports when the joystick button has been pressed.";
CM_ SG_ 3221225472 Joystick3Button4PressedStatus "Reports when the joystick button has been pressed.";
CM_ SG_ 3221225472 Jystck2GripXAxisDetentPosStatus "Reports when the current joystick grip position is in the detent position for that axis of travel.";
CM_ SG_ 3221225472 Jystck2GripYAxisDetentPosStatus "Reports when the current joystick grip position is in the detent position for that axis of travel.";
CM_ SG_ 3221225472 Jystck2ThetaAxisDetentPosStatus "Reports when the current joystick position is in the detent position for that axis of travel.";
CM_ SG_ 3221225472 Joystick2ThetaAxisPos "The position of the joystick in the relative motion of travel from the neutral position.";
CM_ SG_ 3221225472 Jystck2ThtAxsClckwsPstvPsStatus "Reports when the current joystick position is on the positive travel side (forward, right, clockwise, up) relative to the";
CM_ SG_ 3221225472 Jystck2ThtaAxisNeutralPosStatus "Reports when the current joystick position is in the neutral position for that axis of travel.";
CM_ SG_ 3221225472 Joystick2GripYAxisPos "The position of the joystick grip in the relative motion of travel from the neutral position.";
CM_ SG_ 3221225472 Jystck2GrpYAxsLvrFrwrdPstvPsStts "Reports when the current joystick grip position is on the positive travel side (forward, right, clockwise, up) relative to the";
CM_ SG_ 3221225472 Jystck2GrpYAxsLvrBckNgtvPsSttus "Reports when the current joystick grip position is on the negative travel side (back, left, counterclockwise, down) relative";
CM_ SG_ 3221225472 Jystck2GrpYAxisNeutralPosStatus "Reports when the current joystick grip position is in the neutral position for that axis of travel.";
CM_ SG_ 3221225472 Joystick2GripXAxisPos "The position of the joystick grip in the relative motion of travel from the neutral position.";
CM_ SG_ 3221225472 Jystck2GrpXAxsLvrRghtPstvPsStts "Reports when the current joystick grip position is on the positive travel side (forward, right, clockwise, up) relative to the";
CM_ SG_ 3221225472 Jystck2GrpXAxsLvrLftNgtvPsSttus "Reports when the current joystick grip position is on the negative travel side (back, left, counterclockwise, down) relative";
CM_ SG_ 3221225472 Jystck2GrpXAxisNeutralPosStatus "Reports when the current joystick grip position is in the neutral position for that axis of travel.";
CM_ SG_ 3221225472 Jystck2ThtAxsCntrClckwsNgtvPsStt "Reports when the current joystick position is on the negative travel side (back, left, counterclockwise, down) relative to the";
CM_ SG_ 3221225472 Joystick2XAxisDetentPosStatus "Reports when the current joystick position is in the detent position for that axis of travel.";
CM_ SG_ 3221225472 Joystick2YAxisDetentPosStatus "Reports when the current joystick position is in the detent position for that axis of travel.";
CM_ SG_ 3221225472 Joystick2YAxisPos "The position of the joystick in the relative motion of travel from the neutral position.";
CM_ SG_ 3221225472 Jystck2YAxsLvrFrwrdPstvPsStatus "Reports when the current joystick position is on the positive travel side (forward, right, clockwise, up) relative to the";
CM_ SG_ 3221225472 Jystck2YAxsLvrBckNgtvePosStatus "Reports when the current joystick position is on the negative travel side (back, left, counterclockwise, down) relative to the";
CM_ SG_ 3221225472 Joystick2YAxisNeutralPosStatus "Reports when the current joystick position is in the neutral position for that axis of travel.";
CM_ SG_ 3221225472 Joystick2XAxisPos "The position of the joystick in the relative motion of travel from the neutral position.";
CM_ SG_ 3221225472 Jystck2XAxsLvrRghtPstvPosStatus "Reports when the current joystick position is on the positive travel side (forward, right, clockwise, up) relative to the";
CM_ SG_ 3221225472 Jystck2XAxsLvrLftNgtvePosStatus "Reports when the current joystick position is on the negative travel side (back, left, counterclockwise, down) relative to the";
CM_ SG_ 3221225472 Joystick2XAxisNeutralPosStatus "Reports when the current joystick position is in the neutral position for that axis of travel.";
CM_ SG_ 3221225472 Joystick2Button9PressedStatus "Reports when the joystick button has been pressed.";
CM_ SG_ 3221225472 Joystick2Button10PressedStatus "Reports when the joystick button has been pressed.";
CM_ SG_ 3221225472 Joystick2Button11PressedStatus "Reports when the joystick button has been pressed.";
CM_ SG_ 3221225472 Joystick2Button12PressedStatus "Reports when the joystick button has been pressed.";
CM_ SG_ 3221225472 Joystick2Button5PressedStatus "Reports when the joystick button has been pressed.";
CM_ SG_ 3221225472 Joystick2Button6PressedStatus "Reports when the joystick button has been pressed.";
CM_ SG_ 3221225472 Joystick2Button7PressedStatus "Reports when the joystick button has been pressed.";
CM_ SG_ 3221225472 Joystick2Button8PressedStatus "Reports when the joystick button has been pressed.";
CM_ SG_ 3221225472 Joystick2Button1PressedStatus "Reports when the joystick button has been pressed.";
CM_ SG_ 3221225472 Joystick2Button2PressedStatus "Reports when the joystick button has been pressed.";
CM_ SG_ 3221225472 Joystick2Button3PressedStatus "Reports when the joystick button has been pressed.";
CM_ SG_ 3221225472 Joystick2Button4PressedStatus "Reports when the joystick button has been pressed.";
CM_ SG_ 3221225472 Jystck1GripXAxisDetentPosStatus "Reports when the current joystick grip position is in the detent position for that axis of travel.";
CM_ SG_ 3221225472 Jystck1GripYAxisDetentPosStatus "Reports when the current joystick grip position is in the detent position for that axis of travel.";
CM_ SG_ 3221225472 Jystck1ThetaAxisDetentPosStatus "Reports when the current joystick position is in the detent position for that axis of travel.";
CM_ SG_ 3221225472 Joystick1ThetaAxisPos "The position of the joystick in the relative motion of travel from the neutral position.";
CM_ SG_ 3221225472 Jystck1ThtAxsClckwsPstvPsStatus "Reports when the current joystick position is on the positive travel side (forward, right, clockwise, up) relative to the";
CM_ SG_ 3221225472 Jystck1ThtaAxisNeutralPosStatus "Reports when the current joystick position is in the neutral position for that axis of travel.";
CM_ SG_ 3221225472 Joystick1GripYAxisPos "The position of the joystick grip in the relative motion of travel from the neutral position.";
CM_ SG_ 3221225472 Jystck1GrpYAxsLvrFrwrdPstvPsStts "Reports when the current joystick grip position is on the positive travel side (forward, right, clockwise, up) relative to the";
CM_ SG_ 3221225472 Jystck1GrpYAxsLvrBckNgtvPsSttus "Reports when the current joystick grip position is on the negative travel side (back, left, counterclockwise, down) relative";
CM_ SG_ 3221225472 Jystck1GrpYAxisNeutralPosStatus "Reports when the current joystick grip position is in the neutral position for that axis of travel.";
CM_ SG_ 3221225472 Joystick1GripXAxisPos "The position of the joystick grip in the relative motion of travel from the neutral position.";
CM_ SG_ 3221225472 Jystck1GrpXAxsLvrRghtPstvPsStts "Reports when the current joystick grip position is on the positive travel side (forward, right, clockwise, up) relative to the";
CM_ SG_ 3221225472 Jystck1GrpXAxsLvrLftNgtvPsSttus "Reports when the current joystick grip position is on the negative travel side (back, left, counterclockwise, down) relative";
CM_ SG_ 3221225472 Jystck1GrpXAxisNeutralPosStatus "Reports when the current joystick grip position is in the neutral position for that axis of travel.";
CM_ SG_ 3221225472 Jystck1ThtAxsCntrClckwsNgtvPsStt "Reports when the current joystick position is on the negative travel side (back, left, counterclockwise, down) relative to the";
CM_ SG_ 3221225472 Joystick1XAxisDetentPosStatus "Reports when the current joystick position is in the detent position for that axis of travel.";
CM_ SG_ 3221225472 Joystick1YAxisDetentPosStatus "Reports when the current joystick position is in the detent position for that axis of travel.";
CM_ SG_ 3221225472 Joystick1YAxisPos "The position of the joystick in the relative motion of travel from the neutral position.";
CM_ SG_ 3221225472 Jystck1YAxsLvrFrwrdPstvPsStatus "Reports when the current joystick position is on the positive travel side (forward, right, clockwise, up) relative to the";
CM_ SG_ 3221225472 Jystck1YAxsLvrBckNgtvePosStatus "Reports when the current joystick position is on the negative travel side (back, left, counterclockwise, down) relative to the";
CM_ SG_ 3221225472 Joystick1YAxisNeutralPosStatus "Reports when the current joystick position is in the neutral position for that axis of travel.";
CM_ SG_ 3221225472 Joystick1XAxisPos "The position of the joystick in the relative motion of travel from the neutral position.";
CM_ SG_ 3221225472 Joystick1Button9PressedStatus "Reports when the joystick button has been pressed.";
CM_ SG_ 3221225472 Joystick1Button10PressedStatus "Reports when the joystick button has been pressed.";
CM_ SG_ 3221225472 Joystick1Button11PressedStatus "Reports when the joystick button has been pressed.";
CM_ SG_ 3221225472 Joystick1Button12PressedStatus "Reports when the joystick button has been pressed.";
CM_ SG_ 3221225472 Joystick1Button5PressedStatus "Reports when the joystick button has been pressed.";
CM_ SG_ 3221225472 Joystick1Button6PressedStatus "Reports when the joystick button has been pressed.";
CM_ SG_ 3221225472 Joystick1Button7PressedStatus "Reports when the joystick button has been pressed.";
CM_ SG_ 3221225472 Joystick1Button8PressedStatus "Reports when the joystick button has been pressed.";
CM_ SG_ 3221225472 Joystick1Button1PressedStatus "Reports when the joystick button has been pressed.";
CM_ SG_ 3221225472 Joystick1Button2PressedStatus "Reports when the joystick button has been pressed.";
CM_ SG_ 3221225472 Joystick1Button3PressedStatus "Reports when the joystick button has been pressed.";
CM_ SG_ 3221225472 Joystick1Button4PressedStatus "Reports when the joystick button has been pressed.";
CM_ SG_ 3221225472 Jystck1XAxsLvrRghtPstvPosStatus "Reports when the current joystick position is on the positive travel side (forward, right, clockwise, up) relative to the";
CM_ SG_ 3221225472 Jystck1XAxsLvrLftNgtvePosStatus "Reports when the current joystick position is on the negative travel side (back, left, counterclockwise, down) relative to the";
CM_ SG_ 3221225472 Joystick1XAxisNeutralPosStatus "Reports when the current joystick position is in the neutral position for that axis of travel.";
CM_ SG_ 3221225472 EngVrableGeometryTurbo1CtrlMode "Indicates if the variable geometry turbocharger control status is either open loop or closed loop.";
CM_ SG_ 3221225472 EngTrb1ClcltedTurbineIntakeTemp "Calculated value of turbine intake temperature based on engine operating conditions, such as intake manifold";
CM_ SG_ 3221225472 EngExhstGsRcrculation1ValveCtrl "Desired percentage of maximum Exhaust Gas Recirculation (EGR) valve opening.";
CM_ SG_ 3221225472 EngVrblGometryTurbo1ActuatorPos "Sensor that measures the position of the variable geometry turbocharger actuator.";
CM_ SG_ 3221225472 EngVrblGmtryTrbArCtrlShtffValve "Isolates vehicle brake air from the Variable Geometry Turbocharger (VGT) system when engine is not running.";
CM_ SG_ 3221225472 EngTrb1ClcltedTurbineOutletTemp "Calculated value of turbocharger compressor outlet air temperature.";
CM_ SG_ 3221225472 TransOilLevelRq "Conveys operator or vehicle system desire for a transmission oil level reading to be taken.";
CM_ SG_ 3221225472 FifthWheelReleaseCtrl "Operator input used to release the fifth wheel.";
CM_ SG_ 3221225472 FfthWhlRlaseCtrlSecurityLockout "Operator's fifth wheel release control interlock.";
CM_ SG_ 3221225472 TransferCaseSelectorSwitch "Operator switch to select the condition of the transfer case.";
CM_ SG_ 3221225472 EngTurbo4CompressorOutletTemp "Temperature of the air exiting the turbocharger 4 compressor outlet";
CM_ SG_ 3221225472 EngTurbo3CompressorOutletTemp "Temperature of the air exiting the turbocharger 3 compressor outlet";
CM_ SG_ 3221225472 EngTurbo2CompressorOutletTemp "Temperature of the air exiting the turbocharger 2 compressor outlet";
CM_ SG_ 3221225472 EngTurbo1CompressorOutletTemp "Temperature of the air exiting the turbocharger 1 compressor outlet";
CM_ SG_ 3221225472 DataMemoryUsage "The used storage capacity of the data buffer memory internal to an ECU, such as a data logger.";
CM_ SG_ 3221225472 KeepAliveBatteryConsumption "The capacity consumed from the direct battery connection since the key was last turned off.";
CM_ SG_ 3221225472 FMSstandardSWversionSupported "Information that identifies which issue level of the FMS-standard document the software included in the FMS gateway supports.";
CM_ SG_ 3221225472 FMSstandardRqsSupported "Status signal which indicates if the FMS Vehicle Interface (FMS Gateway) will respond to requests from the FMS device";
CM_ SG_ 3221225472 FMSstandardDiagnosticsSupported "Status signal which indicates if the FMS Vehicle Interface (FMS Gateway) supports the handling of diagnostic messages";
CM_ SG_ 3221225472 EngAirFilter4DiffPress "Change in engine air system pressure, measured across the fourth air filter, due to the filter and any accumulation of solid";
CM_ SG_ 3221225472 EngAirFilter3DiffPress "Change in engine air system pressure, measured across the third air filter, due to the filter and any accumulation of solid";
CM_ SG_ 3221225472 EngAirFilter2DiffPress "Change in engine air system pressure, measured across the second air filter, due to the filter and any accumulation of";
CM_ SG_ 3221225472 EngIntakeManifold1AbsPress "The absolute pressure measurement of the air intake manifold.The absolute pressure measurement of the air intake manifold.";
CM_ SG_ 3221225472 EngIntakeManifold2AbsPress "The absolute pressure measurement of the air intake manifold for bank 2 or the second air intake manifold.";
CM_ SG_ 3221225472 RoadCurvature "Estimated value of the current road curvature for use by the adaptive cruise control system.";
CM_ SG_ 3221225472 MaxVehicleSpeedLimit "Maximum vehicle velocity allowed.";
CM_ SG_ 3221225472 EngFuelFilterDiffPress "Differential pressure measured across the fuel filter located between the fuel tank and the supply pump.";
BA_DEF_ SG_  "SigType" ENUM  "Default","Range","RangeSigned","ASCII","Discrete","Control","ReferencePGN","DTC","StringDelimiter","StringLength","StringLengthControl";
BA_DEF_ SG_  "GenSigSendType" ENUM  "Cyclic","OnWrite","reserved","OnChange","reserved","reserved","reserved","NoSigSendType";
BA_DEF_ SG_  "GenSigILSupport" ENUM  "Yes","No";
BA_DEF_ SG_  "GenSigEVName" STRING ;
BA_DEF_ SG_  "SPN" INT 0 524287;
BA_DEF_ BO_  "GenMsgILSupport" ENUM  "Yes","No";
BA_DEF_ BO_  "GenMsgRequestable" INT 0 1;
BA_DEF_ BO_  "GenMsgSendType" ENUM  "cyclic","reserved","cyclicIfActive","reserved","reserved","reserved","reserved","reserved","noMsgSendType";
BA_DEF_ BO_  "VFrameFormat" ENUM  "StandardCAN","ExtendedCAN","reserved","J1939PG";
BA_DEF_ BO_  "GenMsgCycleTime" INT 0 3600000;
BA_DEF_ SG_  "SystemSignalLongSymbol" STRING ;
BA_DEF_DEF_  "SigType" "Default";
BA_DEF_DEF_  "GenSigSendType" "NoSigSendType";
BA_DEF_DEF_  "GenSigILSupport" "Yes";
BA_DEF_DEF_  "GenSigEVName" "Env@Nodename_@Signame";
BA_DEF_DEF_  "SPN" 0;
BA_DEF_DEF_  "GenMsgILSupport" "Yes";
BA_DEF_DEF_  "GenMsgRequestable" 1;
BA_DEF_DEF_  "GenMsgSendType" "noMsgSendType";
BA_DEF_DEF_  "VFrameFormat" "J1939PG";
BA_DEF_DEF_  "GenMsgCycleTime" 0;
BA_DEF_DEF_  "SystemSignalLongSymbol" "";
