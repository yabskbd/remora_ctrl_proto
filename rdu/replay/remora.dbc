VERSION ""

NS_ :

BS_:

BU_: Turbocharger OnBoardDataLogger OffBoardDiagnosticTool2 OffBoardDiagnosticTool1 FileServer ParkingBrakeController SeatControl2 FanDriveController SteeringColumnUnit CommunicationUnitRadio CommunicationUnitSatellite CommunicationUnitCellular PropulsionBatteryCharger ChassisController2 ChassisController1 EngineValveControl AuxiliaryHeater2 AuxiliaryHeater1 ClutchUnit RampControl InformationSystem1 SuspensionSystemController2 OilSensor VehicleDynamicStability ExhaustEmissionController TransmissionDisplay2 TransmissionDisplay1 ClimateControl2 WaterPumpController RearAxleSteeringController LightingOperatorControl SeatController1 IgnitionController2 IgnitionController1 TirePressureController CabController2 CabController1 PneumaticSystemController SuspensionSystemController1 HydraulicPumpController EnduranceBrakingSystem RetarderExhaustEngine2 OnBoardDiagnosticUnit HeadwayController RetarderExhaustEngine1 CabDisplay1 ManagementComputer VirtualTerminal OffVehicleGateway PowerTakeOffFront HitchControl AuxiliaryValveControl BodyController TractorTrailerBridge1 StarterSystem ElectricalSystem VehicleSecurity VehicleNavigation AerodynamicControl ElectricalChargingSystem ClimateControl1 TripRecorder InstrumentCluster SuspensionDriveAxle2 SuspensionDriveAxle1 SuspensionSteerAxle SteeringController FuelSystem CruiseControl RetarderDriveline RetarderEngine BrakesDriveAxle2 BrakesDriveAxle1 BrakesSystemController BrakesSteerAxle AxleDrive2 AxleDrive1 AxleSteering PowerTakeOff ShiftConsoleSecondary ShiftConsolePrimary Transmission2 Transmission1 Engine2 Engine1

BO_ 3221225472 VECTOR__INDEPENDENT_SIG_MSG: 0 Vector__XXX
 SG_ Aftrtrtmnt2FlFlwDvrterValveCtrl : 18|2@1+ (1,0) [0|3] "" Vector__XXX
 SG_ Aftrtreatment2FuelPumpRelayCtrl : 16|2@1+ (1,0) [0|3] "" Vector__XXX
 SG_ Aftertreatment2FuelPress2 : 0|16@1+ (0.1,0) [0|6425.5] "kPa" Vector__XXX
 SG_ Aftrtrtmnt1SCRCtlystRgntLnHtr4Pr : 58|5@1+ (1,0) [0|31] "" Vector__XXX
 SG_ Aftrtrtmnt1SCRCtlystRgntLnHtr4St : 56|2@1+ (1,0) [0|3] "" Vector__XXX
 SG_ Aftrtrtmnt1SCRCtlystRgntLnHtr3Pr : 50|5@1+ (1,0) [0|31] "" Vector__XXX
 SG_ Aftrtrtmnt1SCRCtlystRgntLnHtr3St : 48|2@1+ (1,0) [0|3] "" Vector__XXX
 SG_ Aftrtrtmnt1SCRCtlystRgntLnHtr2Pr : 42|5@1+ (1,0) [0|31] "" Vector__XXX
 SG_ Aftrtrtmnt1SCRCtlystRgntLnHtr2St : 40|2@1+ (1,0) [0|3] "" Vector__XXX
 SG_ Aftrtrtmnt1SCRCtlystRgntLnHtr1Pr : 34|5@1+ (1,0) [0|31] "" Vector__XXX
 SG_ Aftrtrtmnt1SCRCtlystRgntLnHtr1St : 32|2@1+ (1,0) [0|3] "" Vector__XXX
 SG_ Aftrtrtmnt1SCRFedbackCtrlStatus : 27|3@1+ (1,0) [0|7] "" Vector__XXX
 SG_ Aftrtrtmnt1SCRDsngVlvExhstTmpRdc : 24|3@1+ (1,0) [0|7] "" Vector__XXX
 SG_ Aftrtrtmnt1SCRDosingReagentTemp : 16|8@1+ (1,-40) [-40|210] "deg C" Vector__XXX
 SG_ Aftrtrtmnt1SCRDsngArAssistValve : 8|8@1+ (0.4,0) [0|100] "%" Vector__XXX
 SG_ Aftrtrtmnt1SCRDsngArAssstAbsPrss : 0|8@1+ (8,0) [0|2000] "kPa" Vector__XXX
 SG_ Aftrtrtmnt1SCRCtlystTnk2HterCmd : 24|8@1+ (0.4,0) [0|100] "%" Vector__XXX
 SG_ Aftrtrtmnt1SCRCtlystTnkHaterCmd : 16|8@1+ (0.4,0) [0|100] "%" Vector__XXX
 SG_ Aftrtrtmnt1SCRCtlystRgntLnHter4 : 14|2@1+ (1,0) [0|3] "" Vector__XXX
 SG_ Aftrtrtmnt1SCRCtlystRgntLnHter3 : 12|2@1+ (1,0) [0|3] "" Vector__XXX
 SG_ Aftrtrtmnt1SCRCtlystRgntLnHter2 : 10|2@1+ (1,0) [0|3] "" Vector__XXX
 SG_ Aftrtrtmnt1SCRCtlystRgntLnHter1 : 8|2@1+ (1,0) [0|3] "" Vector__XXX
 SG_ Aftrtrtmnt1SCRDserHeatingModeRq : 4|3@1+ (1,0) [0|7] "" Vector__XXX
 SG_ Aftrtrtmnt1SCRDsrFltSpprssionRq : 2|2@1+ (1,0) [0|3] "" Vector__XXX
 SG_ Aftrtrtmnt1SCRCtlystExhstGsDffPr : 16|5@1+ (1,0) [0|31] "" Vector__XXX
 SG_ Aftrtrtmnt1SCRCtlystExhstGs_0000 : 0|16@1+ (0.1,0) [0|6425.5] "kPa" Vector__XXX
 SG_ Aftrtrtmnt1SCRCtlystOtltGsTmpPrl : 40|5@1+ (1,0) [0|31] "" Vector__XXX
 SG_ Aftrtrtmnt1SCRCtlystOtltGasTemp : 24|16@1+ (0.03125,-273) [-273|1734.96875] "deg C" Vector__XXX
 SG_ Aftrtrtmnt1SCRCtlystIntkGsTmpPrl : 16|5@1+ (1,0) [0|31] "" Vector__XXX
 SG_ Aftrtrtmnt1SCRCtlystIntkGasTemp : 0|16@1+ (0.03125,-273) [-273|1734.96875] "deg C" Vector__XXX
 SG_ Aftrtrtmnt1SCRCtlystRgntTnk2HtrP : 56|5@1+ (1,0) [0|31] "" Vector__XXX
 SG_ Aftrtrtmnt1SCRCtlystRgntTnk2Htr : 48|8@1+ (0.4,0) [0|100] "%" Vector__XXX
 SG_ Aftrtrtmnt1SCRRgntTnk2TmpPrlmnry : 40|5@1+ (1,0) [0|31] "" Vector__XXX
 SG_ Aftrtrtmnt1SCRCtlystRgntTnk2LvlP : 32|5@1+ (1,0) [0|31] "" Vector__XXX
 SG_ Aftrtrtmnt1SCRCtlystRgntTnk2Lvl2 : 16|16@1+ (0.1,0) [0|6425.5] "mm" Vector__XXX
 SG_ Aftrtrtmnt1SCRCtlystRgntTnk2Tmp : 8|8@1+ (1,-40) [-40|210] "deg C" Vector__XXX
 SG_ Aftrtrtmnt1SCRCtlystRgntTnk2Lvl : 0|8@1+ (0.4,0) [0|100] "%" Vector__XXX
 SG_ Aftrtrtmnt1SCRCtlystRgntTnkDrnVl : 48|8@1+ (0.4,0) [0|100] "%" Vector__XXX
 SG_ Aftrtrtmnt1SCRCtlystRgntPmpStte : 40|2@1+ (1,0) [0|3] "" Vector__XXX
 SG_ Aftrtrtmnt1SCRCtlystRgntTnkFllVl : 32|8@1+ (0.4,0) [0|100] "%" Vector__XXX
 SG_ Aftrtrtmnt1SCRCtlystRgntRtrnVlv : 24|8@1+ (0.4,0) [0|100] "%" Vector__XXX
 SG_ Aftrtrtmnt1SCRCtlystRgntPmpDrvPr : 16|8@1+ (0.4,0) [0|100] "%" Vector__XXX
 SG_ Aftrtrtmnt1SCRCtlystRgntPmpMtrSp : 0|16@1+ (0.5,0) [0|32127.5] "rpm" Vector__XXX
 SG_ Aftrtrtmnt2SCRCtlystRgntLnHtr4Pr : 58|5@1+ (1,0) [0|31] "" Vector__XXX
 SG_ Aftrtrtmnt2SCRCtlystRgntLnHtr4St : 56|2@1+ (1,0) [0|3] "" Vector__XXX
 SG_ Aftrtrtmnt2SCRCtlystRgntLnHtr3Pr : 50|5@1+ (1,0) [0|31] "" Vector__XXX
 SG_ Aftrtrtmnt2SCRCtlystRgntLnHtr3St : 48|2@1+ (1,0) [0|3] "" Vector__XXX
 SG_ Aftrtrtmnt2SCRCtlystRgntLnHtr2Pr : 42|5@1+ (1,0) [0|31] "" Vector__XXX
 SG_ Aftrtrtmnt2SCRCtlystRgntLnHtr2St : 40|2@1+ (1,0) [0|3] "" Vector__XXX
 SG_ Aftrtrtmnt2SCRCtlystRgntLnHtr1Pr : 34|5@1+ (1,0) [0|31] "" Vector__XXX
 SG_ Aftrtrtmnt2SCRCtlystRgntLnHtr1St : 32|2@1+ (1,0) [0|3] "" Vector__XXX
 SG_ Aftrtrtmnt2SCRFedbackCtrlStatus : 27|3@1+ (1,0) [0|7] "" Vector__XXX
 SG_ Aftrtrtmnt2SCRDsngVlvExhstTmpRdc : 24|3@1+ (1,0) [0|7] "" Vector__XXX
 SG_ Aftrtrtmnt2SCRDosingReagentTemp : 16|8@1+ (1,-40) [-40|210] "deg C" Vector__XXX
 SG_ Aftrtrtmnt2SCRDsngArAssistValve : 8|8@1+ (0.4,0) [0|100] "%" Vector__XXX
 SG_ Aftrtrtmnt2SCRDsngArAssstAbsPrss : 0|8@1+ (8,0) [0|2000] "kPa" Vector__XXX
 SG_ Aftrtrtmnt2SCRCtlystTnk2HterCmd : 24|8@1+ (0.4,0) [0|100] "%" Vector__XXX
 SG_ Aftrtrtmnt2SCRCtlystTnkHaterCmd : 16|8@1+ (0.4,0) [0|100] "%" Vector__XXX
 SG_ Aftrtrtmnt2SCRCtlystRgntLnHter4 : 14|2@1+ (1,0) [0|3] "" Vector__XXX
 SG_ Aftrtrtmnt2SCRCtlystRgntLnHter3 : 12|2@1+ (1,0) [0|3] "" Vector__XXX
 SG_ Aftrtrtmnt2SCRCtlystRgntLnHter2 : 10|2@1+ (1,0) [0|3] "" Vector__XXX
 SG_ Aftrtrtmnt2SCRCtlystRgntLnHter1 : 8|2@1+ (1,0) [0|3] "" Vector__XXX
 SG_ Aftrtrtmnt2SCRDserHeatingModeRq : 4|3@1+ (1,0) [0|7] "" Vector__XXX
 SG_ Aftrtrtmnt2SCRDsrFltSpprssionRq : 2|2@1+ (1,0) [0|3] "" Vector__XXX
 SG_ Aftrtrtmnt2SCRCtlystExhstGsDffPr : 16|5@1+ (1,0) [0|31] "" Vector__XXX
 SG_ Aftrtrtmnt2SCRCtlystExhstGs_0000 : 0|16@1+ (0.1,0) [0|6425.5] "kPa" Vector__XXX
 SG_ Aftrtrtmnt2SCRCtlystOtltGsTmpPrl : 40|5@1+ (1,0) [0|31] "" Vector__XXX
 SG_ Aftrtrtmnt2SCRCtlystOtltGasTemp : 24|16@1+ (0.03125,-273) [-273|1734.96875] "deg C" Vector__XXX
 SG_ Aftrtrtmnt2SCRCtlystIntkGsTmpPrl : 16|5@1+ (1,0) [0|31] "" Vector__XXX
 SG_ Aftrtrtmnt2SCRCtlystIntkGasTemp : 0|16@1+ (0.03125,-273) [-273|1734.96875] "deg C" Vector__XXX
 SG_ Aftrtrtmnt2SCRCtlystCnvrsnEffcnc : 32|8@1+ (0.4,0) [0|100] "%" Vector__XXX
 SG_ Aftrtrtmnt2SCRCmddCtlystRgntCnsm : 16|16@1+ (0.05,0) [0|3212.75] "L/h" Vector__XXX
 SG_ Aftrtrtmnt2SCRAvrgCtlystRgntCnsm : 0|16@1+ (0.05,0) [0|3212.75] "L/h" Vector__XXX
 SG_ Aftrtrtmnt2SCRCtlystReagentType : 40|4@1+ (1,0) [0|15] "" Vector__XXX
 SG_ Aftrtrtmnt2SCRCtlystRgntPrprtsPr : 32|5@1+ (1,0) [0|31] "" Vector__XXX
 SG_ Aftrtrtmnt2SCRCtlystRgntTmp2Prlm : 24|5@1+ (1,0) [0|31] "" Vector__XXX
 SG_ Aftrtrtmnt2SCRCtlystRgntCndctvty : 16|8@1+ (5,0) [0|1250] "microSiemens/mm" Vector__XXX
 SG_ Aftrtrtmnt2SCRCtlystRgntCncntrtn : 8|8@1+ (0.25,0) [0|62.5] "%" Vector__XXX
 SG_ Aftrtrtmnt2SCRCtlystRagentTemp2 : 0|8@1+ (1,-40) [-40|210] "deg C" Vector__XXX
 SG_ Aftrtrtmnt2SCRCtlystRgntTnk1HtrP : 56|5@1+ (1,0) [0|31] "" Vector__XXX
 SG_ Aftrtrtmnt2SCRCtalystTankHeater : 48|8@1+ (0.4,0) [0|100] "%" Vector__XXX
 SG_ Aftrtrtmnt2SCRCtlystRgntTnk1TmpP : 40|5@1+ (1,0) [0|31] "" Vector__XXX
 SG_ Aftrtrtmnt2SCRCtlystTnkLvlPrlmnr : 32|5@1+ (1,0) [0|31] "" Vector__XXX
 SG_ Aftrtrtmnt2SCRCtalystTankLevel2 : 16|16@1+ (0.1,0) [0|6425.5] "mm" Vector__XXX
 SG_ Aftrtrtment2SCRCatalystTankTemp : 8|8@1+ (1,-40) [-40|210] "deg C" Vector__XXX
 SG_ Aftrtrtmnt2SCRCatalystTankLevel : 0|8@1+ (0.4,0) [0|100] "%" Vector__XXX
 SG_ Aftrtrtmnt2SCRCtlystRgntTnk2HtrP : 56|5@1+ (1,0) [0|31] "" Vector__XXX
 SG_ Aftrtrtmnt2SCRCtlystRgntTnk2Htr : 48|4@1+ (1,0) [0|15] "" Vector__XXX
 SG_ Aftrtrtmnt2SCRRgntTnk2TmpPrlmnry : 40|5@1+ (1,0) [0|31] "" Vector__XXX
 SG_ Aftrtrtmnt2SCRCtlystRgntTnk2LvlP : 32|5@1+ (1,0) [0|31] "" Vector__XXX
 SG_ Aftrtrtmnt2SCRCtlystRgntTnk2Lvl2 : 16|16@1+ (0.1,0) [0|6425.5] "mm" Vector__XXX
 SG_ Aftrtrtmnt2SCRCtlystRgntTnk2Tmp : 8|8@1+ (1,-40) [-40|210] "deg C" Vector__XXX
 SG_ Aftrtrtmnt2SCRCtlystRgntTnk2Lvl : 0|8@1+ (0.4,0) [0|100] "%" Vector__XXX
 SG_ Aftrtrtmnt2SCRCtlystRgntTnkDrnVl : 48|8@1+ (0.4,0) [0|100] "%" Vector__XXX
 SG_ Aftrtrtmnt2SCRCtlystRgntPmpStte : 40|2@1+ (1,0) [0|3] "" Vector__XXX
 SG_ Aftrtrtmnt2SCRCtlystRgntTnkFllVl : 32|8@1+ (0.4,0) [0|100] "%" Vector__XXX
 SG_ Aftrtrtmnt2SCRCtlystRgntRtrnVlv : 24|8@1+ (0.4,0) [0|100] "%" Vector__XXX
 SG_ Aftrtrtmnt2SCRCtlystRgntPmpDrvPr : 16|8@1+ (0.4,0) [0|100] "%" Vector__XXX
 SG_ Aftrtrtmnt2SCRCtlystRgntPmpMtrSp : 0|16@1+ (0.5,0) [0|32127.5] "rpm" Vector__XXX
 SG_ Joystick4Button9PressedStatus : 62|2@1+ (1,0) [0|3] "" Vector__XXX
 SG_ Joystick4Button10PressedStatus : 60|2@1+ (1,0) [0|3] "" Vector__XXX
 SG_ Joystick4Button11PressedStatus : 58|2@1+ (1,0) [0|3] "" Vector__XXX
 SG_ Joystick4Button12PressedStatus : 56|2@1+ (1,0) [0|3] "" Vector__XXX
 SG_ Joystick4Button5PressedStatus : 54|2@1+ (1,0) [0|3] "" Vector__XXX
 SG_ Joystick4Button6PressedStatus : 52|2@1+ (1,0) [0|3] "" Vector__XXX
 SG_ Joystick4Button7PressedStatus : 50|2@1+ (1,0) [0|3] "" Vector__XXX
 SG_ Joystick4Button8PressedStatus : 48|2@1+ (1,0) [0|3] "" Vector__XXX
 SG_ Joystick4Button1PressedStatus : 46|2@1+ (1,0) [0|3] "" Vector__XXX
 SG_ Joystick4Button2PressedStatus : 44|2@1+ (1,0) [0|3] "" Vector__XXX
 SG_ Joystick4Button3PressedStatus : 42|2@1+ (1,0) [0|3] "" Vector__XXX
 SG_ Joystick4Button4PressedStatus : 40|2@1+ (1,0) [0|3] "" Vector__XXX
 SG_ Joystick4XAxisDetentPosStatus : 38|2@1+ (1,0) [0|3] "" Vector__XXX
 SG_ Joystick4YAxisDetentPosStatus : 36|2@1+ (1,0) [0|3] "" Vector__XXX
 SG_ Joystick4YAxisPos : 22|10@1+ (0.1,0) [0|102] "%" Vector__XXX
 SG_ Jystck4YAxsLvrFrwrdPstvPsStatus : 20|2@1+ (1,0) [0|3] "" Vector__XXX
 SG_ Jystck4YAxsLvrBckNgtvePosStatus : 18|2@1+ (1,0) [0|3] "" Vector__XXX
 SG_ Joystick4YAxisNeutralPosStatus : 16|2@1+ (1,0) [0|3] "" Vector__XXX
 SG_ Joystick4XAxisPos : 6|10@1+ (0.1,0) [0|102] "%" Vector__XXX
 SG_ Jystck4XAxsLvrRghtPstvPosStatus : 4|2@1+ (1,0) [0|3] "" Vector__XXX
 SG_ Jystck4XAxsLvrLftNgtvePosStatus : 2|2@1+ (1,0) [0|3] "" Vector__XXX
 SG_ Joystick4XAxisNeutralPosStatus : 0|2@1+ (1,0) [0|3] "" Vector__XXX
 SG_ Jystck4GripXAxisDetentPosStatus : 54|2@1+ (1,0) [0|3] "" Vector__XXX
 SG_ Jystck4GripYAxisDetentPosStatus : 52|2@1+ (1,0) [0|3] "" Vector__XXX
 SG_ Jystck4ThetaAxisDetentPosStatus : 50|2@1+ (1,0) [0|3] "" Vector__XXX
 SG_ Joystick4ThetaAxisPos : 38|10@1+ (0.1,0) [0|102] "%" Vector__XXX
 SG_ Jystck4ThtAxsClckwsPstvPsStatus : 36|2@1+ (1,0) [0|3] "" Vector__XXX
 SG_ Jystck4ThtAxsCntrClckwsNgtvPsStt : 34|2@1+ (1,0) [0|3] "" Vector__XXX
 SG_ Jystck4ThtaAxisNeutralPosStatus : 32|2@1+ (1,0) [0|3] "" Vector__XXX
 SG_ Joystick4GripYAxisPos : 22|10@1+ (0.1,0) [0|102] "%" Vector__XXX
 SG_ Jystck4GrpYAxsLvrFrwrdPstvPsStts : 20|2@1+ (1,0) [0|3] "" Vector__XXX
 SG_ Jystck4GrpYAxsLvrBckNgtvPsSttus : 18|2@1+ (1,0) [0|3] "" Vector__XXX
 SG_ Jystck4GrpYAxisNeutralPosStatus : 16|2@1+ (1,0) [0|3] "" Vector__XXX
 SG_ Joystick4GripXAxisPos : 6|10@1+ (0.1,0) [0|102] "%" Vector__XXX
 SG_ Jystck4GrpXAxsLvrRghtPstvPsStts : 4|2@1+ (1,0) [0|3] "" Vector__XXX
 SG_ Jystck4GrpXAxsLvrLftNgtvPsSttus : 2|2@1+ (1,0) [0|3] "" Vector__XXX
 SG_ Jystck4GrpXAxisNeutralPosStatus : 0|2@1+ (1,0) [0|3] "" Vector__XXX
 SG_ Joystick5Button9PressedStatus : 62|2@1+ (1,0) [0|3] "" Vector__XXX
 SG_ Joystick5Button10PressedStatus : 60|2@1+ (1,0) [0|3] "" Vector__XXX
 SG_ Joystick5Button11PressedStatus : 58|2@1+ (1,0) [0|3] "" Vector__XXX
 SG_ Joystick5Button12PressedStatus : 56|2@1+ (1,0) [0|3] "" Vector__XXX
 SG_ Joystick5Button5PressedStatus : 54|2@1+ (1,0) [0|3] "" Vector__XXX
 SG_ Joystick5Button6PressedStatus : 52|2@1+ (1,0) [0|3] "" Vector__XXX
 SG_ Joystick5Button7PressedStatus : 50|2@1+ (1,0) [0|3] "" Vector__XXX
 SG_ Joystick5Button8PressedStatus : 48|2@1+ (1,0) [0|3] "" Vector__XXX
 SG_ Joystick5Button1PressedStatus : 46|2@1+ (1,0) [0|3] "" Vector__XXX
 SG_ Joystick5Button2PressedStatus : 44|2@1+ (1,0) [0|3] "" Vector__XXX
 SG_ Joystick5Button3PressedStatus : 42|2@1+ (1,0) [0|3] "" Vector__XXX
 SG_ Joystick5Button4PressedStatus : 40|2@1+ (1,0) [0|3] "" Vector__XXX
 SG_ Joystick5XAxisDetentPosStatus : 38|2@1+ (1,0) [0|3] "" Vector__XXX
 SG_ Joystick5YAxisDetentPosStatus : 36|2@1+ (1,0) [0|3] "" Vector__XXX
 SG_ Joystick5YAxisPos : 22|10@1+ (0.1,0) [0|102] "%" Vector__XXX
 SG_ Jystck5YAxsLvrFrwrdPstvPsStatus : 20|2@1+ (1,0) [0|3] "" Vector__XXX
 SG_ Jystck5YAxsLvrBckNgtvePosStatus : 18|2@1+ (1,0) [0|3] "" Vector__XXX
 SG_ Joystick5YAxisNeutralPosStatus : 16|2@1+ (1,0) [0|3] "" Vector__XXX
 SG_ Joystick5XAxisPos : 6|10@1+ (0.1,0) [0|102] "%" Vector__XXX
 SG_ Jystck5XAxsLvrRghtPstvPosStatus : 4|2@1+ (1,0) [0|3] "" Vector__XXX
 SG_ Jystck5XAxsLvrLftNgtvePosStatus : 2|2@1+ (1,0) [0|3] "" Vector__XXX
 SG_ Joystick5XAxisNeutralPosStatus : 0|2@1+ (1,0) [0|3] "" Vector__XXX
 SG_ Jystck5GripXAxisDetentPosStatus : 54|2@1+ (1,0) [0|3] "" Vector__XXX
 SG_ Jystck5GripYAxisDetentPosStatus : 52|2@1+ (1,0) [0|3] "" Vector__XXX
 SG_ Jystck5ThetaAxisDetentPosStatus : 50|2@1+ (1,0) [0|3] "" Vector__XXX
 SG_ Joystick5ThetaAxisPos : 38|10@1+ (0.1,0) [0|102] "%" Vector__XXX
 SG_ Jystck5ThtAxsClckwsPstvPsStatus : 36|2@1+ (1,0) [0|3] "" Vector__XXX
 SG_ Jystck5ThtAxsCntrClckwsNgtvPsStt : 34|2@1+ (1,0) [0|3] "" Vector__XXX
 SG_ Jystck5ThtaAxisNeutralPosStatus : 32|2@1+ (1,0) [0|3] "" Vector__XXX
 SG_ Joystick5GripYAxisPos : 22|10@1+ (0.1,0) [0|102] "%" Vector__XXX
 SG_ Jystck5GrpYAxsLvrFrwrdPstvPsStts : 20|2@1+ (1,0) [0|3] "" Vector__XXX
 SG_ Jystck5GrpYAxsLvrBckNgtvPsSttus : 18|2@1+ (1,0) [0|3] "" Vector__XXX
 SG_ Jystck5GrpYAxisNeutralPosStatus : 16|2@1+ (1,0) [0|3] "" Vector__XXX
 SG_ Joystick5GripXAxisPos : 6|10@1+ (0.1,0) [0|102] "%" Vector__XXX
 SG_ Jystck5GrpXAxsLvrRghtPstvPsStts : 4|2@1+ (1,0) [0|3] "" Vector__XXX
 SG_ Jystck5GrpXAxsLvrLftNgtvPsSttus : 2|2@1+ (1,0) [0|3] "" Vector__XXX
 SG_ Jystck5GrpXAxisNeutralPosStatus : 0|2@1+ (1,0) [0|3] "" Vector__XXX
 SG_ Joystick6Button9PressedStatus : 62|2@1+ (1,0) [0|3] "" Vector__XXX
 SG_ Joystick6Button10PressedStatus : 60|2@1+ (1,0) [0|3] "" Vector__XXX
 SG_ Joystick6Button11PressedStatus : 58|2@1+ (1,0) [0|3] "" Vector__XXX
 SG_ Joystick6Button12PressedStatus : 56|2@1+ (1,0) [0|3] "" Vector__XXX
 SG_ Joystick6Button5PressedStatus : 54|2@1+ (1,0) [0|3] "" Vector__XXX
 SG_ Joystick6Button6PressedStatus : 52|2@1+ (1,0) [0|3] "" Vector__XXX
 SG_ Joystick6Button7PressedStatus : 50|2@1+ (1,0) [0|3] "" Vector__XXX
 SG_ Joystick6Button8PressedStatus : 48|2@1+ (1,0) [0|3] "" Vector__XXX
 SG_ Joystick6Button1PressedStatus : 46|2@1+ (1,0) [0|3] "" Vector__XXX
 SG_ Joystick6Button2PressedStatus : 44|2@1+ (1,0) [0|3] "" Vector__XXX
 SG_ Joystick6Button3PressedStatus : 42|2@1+ (1,0) [0|3] "" Vector__XXX
 SG_ Joystick6Button4PressedStatus : 40|2@1+ (1,0) [0|3] "" Vector__XXX
 SG_ Joystick6XAxisDetentPosStatus : 38|2@1+ (1,0) [0|3] "" Vector__XXX
 SG_ Joystick6YAxisDetentPosStatus : 36|2@1+ (1,0) [0|3] "" Vector__XXX
 SG_ Joystick6YAxisPos : 22|10@1+ (0.1,0) [0|102] "%" Vector__XXX
 SG_ Jystck6YAxsLvrFrwrdPstvPsStatus : 20|2@1+ (1,0) [0|3] "" Vector__XXX
 SG_ Jystck6YAxsLvrBckNgtvePosStatus : 18|2@1+ (1,0) [0|3] "" Vector__XXX
 SG_ Joystick6YAxisNeutralPosStatus : 16|2@1+ (1,0) [0|3] "" Vector__XXX
 SG_ Joystick6XAxisPos : 6|10@1+ (0.1,0) [0|102] "%" Vector__XXX
 SG_ Jystck6XAxsLvrRghtPstvPosStatus : 4|2@1+ (1,0) [0|3] "" Vector__XXX
 SG_ Jystck6XAxsLvrLftNgtvePosStatus : 2|2@1+ (1,0) [0|3] "" Vector__XXX
 SG_ Joystick6XAxisNeutralPosStatus : 0|2@1+ (1,0) [0|3] "" Vector__XXX
 SG_ Jystck6GripXAxisDetentPosStatus : 54|2@1+ (1,0) [0|3] "" Vector__XXX
 SG_ Jystck6GripYAxisDetentPosStatus : 52|2@1+ (1,0) [0|3] "" Vector__XXX
 SG_ Jystck6ThetaAxisDetentPosStatus : 50|2@1+ (1,0) [0|3] "" Vector__XXX
 SG_ Joystick6ThetaAxisPos : 38|10@1+ (0.1,0) [0|102] "%" Vector__XXX
 SG_ Jystck6ThtAxsClckwsPstvPsStatus : 36|2@1+ (1,0) [0|3] "" Vector__XXX
 SG_ Jystck6ThtAxsCntrClckwsNgtvPsStt : 34|2@1+ (1,0) [0|3] "" Vector__XXX
 SG_ Jystck6ThtaAxisNeutralPosStatus : 32|2@1+ (1,0) [0|3] "" Vector__XXX
 SG_ Joystick6GripYAxisPos : 22|10@1+ (0.1,0) [0|102] "%" Vector__XXX
 SG_ Jystck6GrpYAxsLvrFrwrdPstvPsStts : 20|2@1+ (1,0) [0|3] "" Vector__XXX
 SG_ Jystck6GrpYAxsLvrBckNgtvPsSttus : 18|2@1+ (1,0) [0|3] "" Vector__XXX
 SG_ Jystck6GrpYAxisNeutralPosStatus : 16|2@1+ (1,0) [0|3] "" Vector__XXX
 SG_ Joystick6GripXAxisPos : 6|10@1+ (0.1,0) [0|102] "%" Vector__XXX
 SG_ Jystck6GrpXAxsLvrRghtPstvPsStts : 4|2@1+ (1,0) [0|3] "" Vector__XXX
 SG_ Jystck6GrpXAxsLvrLftNgtvPsSttus : 2|2@1+ (1,0) [0|3] "" Vector__XXX
 SG_ Jystck6GrpXAxisNeutralPosStatus : 0|2@1+ (1,0) [0|3] "" Vector__XXX
 SG_ Joystick7Button9PressedStatus : 62|2@1+ (1,0) [0|3] "" Vector__XXX
 SG_ Joystick7Button10PressedStatus : 60|2@1+ (1,0) [0|3] "" Vector__XXX
 SG_ Joystick7Button11PressedStatus : 58|2@1+ (1,0) [0|3] "" Vector__XXX
 SG_ Joystick7Button12PressedStatus : 56|2@1+ (1,0) [0|3] "" Vector__XXX
 SG_ Joystick7Button5PressedStatus : 54|2@1+ (1,0) [0|3] "" Vector__XXX
 SG_ Joystick7Button6PressedStatus : 52|2@1+ (1,0) [0|3] "" Vector__XXX
 SG_ Joystick7Button7PressedStatus : 50|2@1+ (1,0) [0|3] "" Vector__XXX
 SG_ Joystick7Button8PressedStatus : 48|2@1+ (1,0) [0|3] "" Vector__XXX
 SG_ Joystick7Button1PressedStatus : 46|2@1+ (1,0) [0|3] "" Vector__XXX
 SG_ Joystick7Button2PressedStatus : 44|2@1+ (1,0) [0|3] "" Vector__XXX
 SG_ Joystick7Button3PressedStatus : 42|2@1+ (1,0) [0|3] "" Vector__XXX
 SG_ Joystick7Button4PressedStatus : 40|2@1+ (1,0) [0|3] "" Vector__XXX
 SG_ Joystick7XAxisDetentPosStatus : 38|2@1+ (1,0) [0|3] "" Vector__XXX
 SG_ Joystick7YAxisDetentPosStatus : 36|2@1+ (1,0) [0|3] "" Vector__XXX
 SG_ Joystick7YAxisPos : 22|10@1+ (0.1,0) [0|102] "%" Vector__XXX
 SG_ Jystck7YAxsLvrFrwrdPstvPsStatus : 20|2@1+ (1,0) [0|3] "" Vector__XXX
 SG_ Jystck7YAxsLvrBckNgtvePosStatus : 18|2@1+ (1,0) [0|3] "" Vector__XXX
 SG_ Joystick7YAxisNeutralPosStatus : 16|2@1+ (1,0) [0|3] "" Vector__XXX
 SG_ Joystick7XAxisPos : 6|10@1+ (0.1,0) [0|102] "%" Vector__XXX
 SG_ Jystck7XAxsLvrRghtPstvPosStatus : 4|2@1+ (1,0) [0|3] "" Vector__XXX
 SG_ Jystck7XAxsLvrLftNgtvePosStatus : 2|2@1+ (1,0) [0|3] "" Vector__XXX
 SG_ Joystick7XAxisNeutralPosStatus : 0|2@1+ (1,0) [0|3] "" Vector__XXX
 SG_ Jystck7GripXAxisDetentPosStatus : 54|2@1+ (1,0) [0|3] "" Vector__XXX
 SG_ Jystck7GripYAxisDetentPosStatus : 52|2@1+ (1,0) [0|3] "" Vector__XXX
 SG_ Jystck7ThetaAxisDetentPosStatus : 50|2@1+ (1,0) [0|3] "" Vector__XXX
 SG_ Joystick7ThetaAxisPos : 38|10@1+ (0.1,0) [0|102] "%" Vector__XXX
 SG_ Jystck7ThtAxsClckwsPstvPsStatus : 36|2@1+ (1,0) [0|3] "" Vector__XXX
 SG_ Jystck7ThtAxsCntrClckwsNgtvPsStt : 34|2@1+ (1,0) [0|3] "" Vector__XXX
 SG_ Jystck7ThtaAxisNeutralPosStatus : 32|2@1+ (1,0) [0|3] "" Vector__XXX
 SG_ Joystick7GripYAxisPos : 22|10@1+ (0.1,0) [0|102] "%" Vector__XXX
 SG_ Jystck7GrpYAxsLvrFrwrdPstvPsStts : 20|2@1+ (1,0) [0|3] "" Vector__XXX
 SG_ Jystck7GrpYAxsLvrBckNgtvPsSttus : 18|2@1+ (1,0) [0|3] "" Vector__XXX
 SG_ Jystck7GrpYAxisNeutralPosStatus : 16|2@1+ (1,0) [0|3] "" Vector__XXX
 SG_ Joystick7GripXAxisPos : 6|10@1+ (0.1,0) [0|102] "%" Vector__XXX
 SG_ Jystck7GrpXAxsLvrRghtPstvPsStts : 4|2@1+ (1,0) [0|3] "" Vector__XXX
 SG_ Jystck7GrpXAxsLvrLftNgtvPsSttus : 2|2@1+ (1,0) [0|3] "" Vector__XXX
 SG_ Jystck7GrpXAxisNeutralPosStatus : 0|2@1+ (1,0) [0|3] "" Vector__XXX
 SG_ Joystick8Button9PressedStatus : 62|2@1+ (1,0) [0|3] "" Vector__XXX
 SG_ Joystick8Button10PressedStatus : 60|2@1+ (1,0) [0|3] "" Vector__XXX
 SG_ Joystick8Button11PressedStatus : 58|2@1+ (1,0) [0|3] "" Vector__XXX
 SG_ Joystick8Button12PressedStatus : 56|2@1+ (1,0) [0|3] "" Vector__XXX
 SG_ Joystick8Button5PressedStatus : 54|2@1+ (1,0) [0|3] "" Vector__XXX
 SG_ Joystick8Button6PressedStatus : 52|2@1+ (1,0) [0|3] "" Vector__XXX
 SG_ Joystick8Button7PressedStatus : 50|2@1+ (1,0) [0|3] "" Vector__XXX
 SG_ Joystick8Button8PressedStatus : 48|2@1+ (1,0) [0|3] "" Vector__XXX
 SG_ Joystick8Button1PressedStatus : 46|2@1+ (1,0) [0|3] "" Vector__XXX
 SG_ Joystick8Button2PressedStatus : 44|2@1+ (1,0) [0|3] "" Vector__XXX
 SG_ Joystick8Button3PressedStatus : 42|2@1+ (1,0) [0|3] "" Vector__XXX
 SG_ Joystick8Button4PressedStatus : 40|2@1+ (1,0) [0|3] "" Vector__XXX
 SG_ Joystick8XAxisDetentPosStatus : 38|2@1+ (1,0) [0|3] "" Vector__XXX
 SG_ Joystick8YAxisDetentPosStatus : 36|2@1+ (1,0) [0|3] "" Vector__XXX
 SG_ Joystick8YAxisPos : 22|10@1+ (0.1,0) [0|102] "%" Vector__XXX
 SG_ Jystck8YAxsLvrFrwrdPstvPsStatus : 20|2@1+ (1,0) [0|3] "" Vector__XXX
 SG_ Jystck8YAxsLvrBckNgtvePosStatus : 18|2@1+ (1,0) [0|3] "" Vector__XXX
 SG_ Joystick8YAxisNeutralPosStatus : 16|2@1+ (1,0) [0|3] "" Vector__XXX
 SG_ Joystick8XAxisPos : 6|10@1+ (0.1,0) [0|102] "%" Vector__XXX
 SG_ Jystck8XAxsLvrRghtPstvPosStatus : 4|2@1+ (1,0) [0|3] "" Vector__XXX
 SG_ Jystck8XAxsLvrLftNgtvePosStatus : 2|2@1+ (1,0) [0|3] "" Vector__XXX
 SG_ Joystick8XAxisNeutralPosStatus : 0|2@1+ (1,0) [0|3] "" Vector__XXX
 SG_ Jystck8GripXAxisDetentPosStatus : 54|2@1+ (1,0) [0|3] "" Vector__XXX
 SG_ Jystck8GripYAxisDetentPosStatus : 52|2@1+ (1,0) [0|3] "" Vector__XXX
 SG_ Jystck8ThetaAxisDetentPosStatus : 50|2@1+ (1,0) [0|3] "" Vector__XXX
 SG_ Joystick8ThetaAxisPos : 38|10@1+ (0.1,0) [0|102] "%" Vector__XXX
 SG_ Jystck8ThtAxsClckwsPstvPsStatus : 36|2@1+ (1,0) [0|3] "" Vector__XXX
 SG_ Jystck8ThtAxsCntrClckwsNgtvPsStt : 34|2@1+ (1,0) [0|3] "" Vector__XXX
 SG_ Jystck8ThtaAxisNeutralPosStatus : 32|2@1+ (1,0) [0|3] "" Vector__XXX
 SG_ Joystick8GripYAxisPos : 22|10@1+ (0.1,0) [0|102] "%" Vector__XXX
 SG_ Jystck8GrpYAxsLvrFrwrdPstvPsStts : 20|2@1+ (1,0) [0|3] "" Vector__XXX
 SG_ Jystck8GrpYAxsLvrBckNgtvPsSttus : 18|2@1+ (1,0) [0|3] "" Vector__XXX
 SG_ Jystck8GrpYAxisNeutralPosStatus : 16|2@1+ (1,0) [0|3] "" Vector__XXX
 SG_ Joystick8GripXAxisPos : 6|10@1+ (0.1,0) [0|102] "%" Vector__XXX
 SG_ Jystck8GrpXAxsLvrRghtPstvPsStts : 4|2@1+ (1,0) [0|3] "" Vector__XXX
 SG_ Jystck8GrpXAxsLvrLftNgtvPsSttus : 2|2@1+ (1,0) [0|3] "" Vector__XXX
 SG_ Jystck8GrpXAxisNeutralPosStatus : 0|2@1+ (1,0) [0|3] "" Vector__XXX
 SG_ Joystick9Button9PressedStatus : 62|2@1+ (1,0) [0|3] "" Vector__XXX
 SG_ Joystick9Button10PressedStatus : 60|2@1+ (1,0) [0|3] "" Vector__XXX
 SG_ Joystick9Button11PressedStatus : 58|2@1+ (1,0) [0|3] "" Vector__XXX
 SG_ Joystick9Button12PressedStatus : 56|2@1+ (1,0) [0|3] "" Vector__XXX
 SG_ Joystick9Button5PressedStatus : 54|2@1+ (1,0) [0|3] "" Vector__XXX
 SG_ Joystick9Button6PressedStatus : 52|2@1+ (1,0) [0|3] "" Vector__XXX
 SG_ Joystick9Button7PressedStatus : 50|2@1+ (1,0) [0|3] "" Vector__XXX
 SG_ Joystick9Button8PressedStatus : 48|2@1+ (1,0) [0|3] "" Vector__XXX
 SG_ Joystick9Button1PressedStatus : 46|2@1+ (1,0) [0|3] "" Vector__XXX
 SG_ Joystick9Button2PressedStatus : 44|2@1+ (1,0) [0|3] "" Vector__XXX
 SG_ Joystick9Button3PressedStatus : 42|2@1+ (1,0) [0|3] "" Vector__XXX
 SG_ Joystick9Button4PressedStatus : 40|2@1+ (1,0) [0|3] "" Vector__XXX
 SG_ Joystick9XAxisDetentPosStatus : 38|2@1+ (1,0) [0|3] "" Vector__XXX
 SG_ Joystick9YAxisDetentPosStatus : 36|2@1+ (1,0) [0|3] "" Vector__XXX
 SG_ Joystick9YAxisPos : 22|10@1+ (0.1,0) [0|102] "%" Vector__XXX
 SG_ Jystck9YAxsLvrFrwrdPstvPsStatus : 20|2@1+ (1,0) [0|3] "" Vector__XXX
 SG_ Jystck9YAxsLvrBckNgtvePosStatus : 18|2@1+ (1,0) [0|3] "" Vector__XXX
 SG_ Joystick9YAxisNeutralPosStatus : 16|2@1+ (1,0) [0|3] "" Vector__XXX
 SG_ Joystick9XAxisPos : 6|10@1+ (0.1,0) [0|102] "%" Vector__XXX
 SG_ Jystck9XAxsLvrRghtPstvPosStatus : 4|2@1+ (1,0) [0|3] "" Vector__XXX
 SG_ Jystck9XAxsLvrLftNgtvePosStatus : 2|2@1+ (1,0) [0|3] "" Vector__XXX
 SG_ Joystick9XAxisNeutralPosStatus : 0|2@1+ (1,0) [0|3] "" Vector__XXX
 SG_ Jystck9GripXAxisDetentPosStatus : 54|2@1+ (1,0) [0|3] "" Vector__XXX
 SG_ Jystck9GripYAxisDetentPosStatus : 52|2@1+ (1,0) [0|3] "" Vector__XXX
 SG_ Jystck9ThetaAxisDetentPosStatus : 50|2@1+ (1,0) [0|3] "" Vector__XXX
 SG_ Joystick9ThetaAxisPos : 38|10@1+ (0.1,0) [0|102] "%" Vector__XXX
 SG_ Jystck9ThtAxsClckwsPstvPsStatus : 36|2@1+ (1,0) [0|3] "" Vector__XXX
 SG_ Jystck9ThtAxsCntrClckwsNgtvPsStt : 34|2@1+ (1,0) [0|3] "" Vector__XXX
 SG_ Jystck9ThtaAxisNeutralPosStatus : 32|2@1+ (1,0) [0|3] "" Vector__XXX
 SG_ Joystick9GripYAxisPos : 22|10@1+ (0.1,0) [0|102] "%" Vector__XXX
 SG_ Jystck9GrpYAxsLvrFrwrdPstvPsStts : 20|2@1+ (1,0) [0|3] "" Vector__XXX
 SG_ Jystck9GrpYAxsLvrBckNgtvPsSttus : 18|2@1+ (1,0) [0|3] "" Vector__XXX
 SG_ Jystck9GrpYAxisNeutralPosStatus : 16|2@1+ (1,0) [0|3] "" Vector__XXX
 SG_ Joystick9GripXAxisPos : 6|10@1+ (0.1,0) [0|102] "%" Vector__XXX
 SG_ Jystck9GrpXAxsLvrRghtPstvPsStts : 4|2@1+ (1,0) [0|3] "" Vector__XXX
 SG_ Jystck9GrpXAxsLvrLftNgtvPsSttus : 2|2@1+ (1,0) [0|3] "" Vector__XXX
 SG_ Jystck9GrpXAxisNeutralPosStatus : 0|2@1+ (1,0) [0|3] "" Vector__XXX
 SG_ Joystick10Button9PressedStatus : 62|2@1+ (1,0) [0|3] "" Vector__XXX
 SG_ Joystick10Button10PressedStatus : 60|2@1+ (1,0) [0|3] "" Vector__XXX
 SG_ Joystick10Button11PressedStatus : 58|2@1+ (1,0) [0|3] "" Vector__XXX
 SG_ Joystick10Button12PressedStatus : 56|2@1+ (1,0) [0|3] "" Vector__XXX
 SG_ Joystick10Button5PressedStatus : 54|2@1+ (1,0) [0|3] "" Vector__XXX
 SG_ Joystick10Button6PressedStatus : 52|2@1+ (1,0) [0|3] "" Vector__XXX
 SG_ Joystick10Button7PressedStatus : 50|2@1+ (1,0) [0|3] "" Vector__XXX
 SG_ Joystick10Button8PressedStatus : 48|2@1+ (1,0) [0|3] "" Vector__XXX
 SG_ Joystick10Button1PressedStatus : 46|2@1+ (1,0) [0|3] "" Vector__XXX
 SG_ Joystick10Button2PressedStatus : 44|2@1+ (1,0) [0|3] "" Vector__XXX
 SG_ Joystick10Button3PressedStatus : 42|2@1+ (1,0) [0|3] "" Vector__XXX
 SG_ Joystick10Button4PressedStatus : 40|2@1+ (1,0) [0|3] "" Vector__XXX
 SG_ Joystick10XAxisDetentPosStatus : 38|2@1+ (1,0) [0|3] "" Vector__XXX
 SG_ Joystick10YAxisDetentPosStatus : 36|2@1+ (1,0) [0|3] "" Vector__XXX
 SG_ Joystick10YAxisPos : 22|10@1+ (0.1,0) [0|102] "%" Vector__XXX
 SG_ Jystck10YAxsLvrFrwrdPstvPsSttus : 20|2@1+ (1,0) [0|3] "" Vector__XXX
 SG_ Jystck10YAxsLvrBckNgtvPosStatus : 18|2@1+ (1,0) [0|3] "" Vector__XXX
 SG_ Joystick10YAxisNeutralPosStatus : 16|2@1+ (1,0) [0|3] "" Vector__XXX
 SG_ Joystick10XAxisPos : 6|10@1+ (0.1,0) [0|102] "%" Vector__XXX
 SG_ Jystck10XAxsLvrRghtPstvPsStatus : 4|2@1+ (1,0) [0|3] "" Vector__XXX
 SG_ Jystck10XAxsLvrLftNgtvPosStatus : 2|2@1+ (1,0) [0|3] "" Vector__XXX
 SG_ Joystick10XAxisNeutralPosStatus : 0|2@1+ (1,0) [0|3] "" Vector__XXX
 SG_ Jystck10GrpXAxisDetentPosStatus : 54|2@1+ (1,0) [0|3] "" Vector__XXX
 SG_ Jystck10GrpYAxisDetentPosStatus : 52|2@1+ (1,0) [0|3] "" Vector__XXX
 SG_ Jystck10ThtaAxisDetentPosStatus : 50|2@1+ (1,0) [0|3] "" Vector__XXX
 SG_ Joystick10ThetaAxisPos : 38|10@1+ (0.1,0) [0|102] "%" Vector__XXX
 SG_ Jystck10ThtAxsClckwsPstvPsSttus : 36|2@1+ (1,0) [0|3] "" Vector__XXX
 SG_ Jystck10ThtAxsCntrClckwsNgtvPsSt : 34|2@1+ (1,0) [0|3] "" Vector__XXX
 SG_ Jystck10ThtAxisNeutralPosStatus : 32|2@1+ (1,0) [0|3] "" Vector__XXX
 SG_ Joystick10GripYAxisPos : 22|10@1+ (0.1,0) [0|102] "%" Vector__XXX
 SG_ Jystck10GrpYAxsLvrFrwrdPstvPsStt : 20|2@1+ (1,0) [0|3] "" Vector__XXX
 SG_ Jystck10GrpYAxsLvrBckNgtvPsStts : 18|2@1+ (1,0) [0|3] "" Vector__XXX
 SG_ Jystck10GrpYAxsNeutralPosStatus : 16|2@1+ (1,0) [0|3] "" Vector__XXX
 SG_ Joystick10GripXAxisPos : 6|10@1+ (0.1,0) [0|102] "%" Vector__XXX
 SG_ Jystck10GrpXAxsLvrRghtPstvPsStts : 4|2@1+ (1,0) [0|3] "" Vector__XXX
 SG_ Jystck10GrpXAxsLvrLftNgtvPsStts : 2|2@1+ (1,0) [0|3] "" Vector__XXX
 SG_ Jystck10GrpXAxsNeutralPosStatus : 0|2@1+ (1,0) [0|3] "" Vector__XXX
 SG_ Aftrtrtmnt1GsOxdtnCtlystDffPrssP : 58|5@1+ (1,0) [0|31] "" Vector__XXX
 SG_ Aftrtrtmnt1GsOxdtnCtlystOtltGsTm : 53|5@1+ (1,0) [0|31] "" Vector__XXX
 SG_ Aftrtrtmnt1GsOxdtnCtlystIntkGsTm : 48|5@1+ (1,0) [0|31] "" Vector__XXX
 SG_ Aftrtrtmnt1GsOxdtnCtlystDffPrss : 32|16@1+ (0.1,0) [0|6425.5] "kPa" Vector__XXX
 SG_ Aftrtrtmnt1GsOxdtnCtlystOtl_0000 : 16|16@1+ (0.03125,-273) [-273|1734.96875] "deg C" Vector__XXX
 SG_ Aftrtrtmnt1GsOxdtnCtlystInt_0000 : 0|16@1+ (0.03125,-273) [-273|1734.96875] "deg C" Vector__XXX
 SG_ Aftrtrtmnt2GsOxdtnCtlystDffPrssP : 58|5@1+ (1,0) [0|31] "" Vector__XXX
 SG_ Aftrtrtmnt2GsOxdtnCtlystOtltGsTm : 53|5@1+ (1,0) [0|31] "" Vector__XXX
 SG_ Aftrtrtmnt2GsOxdtnCtlystIntkGsTm : 48|5@1+ (1,0) [0|31] "" Vector__XXX
 SG_ Aftrtrtmnt2GsOxdtnCtlystDffPrss : 32|16@1+ (0.1,0) [0|6425.5] "kPa" Vector__XXX
 SG_ Aftrtrtmnt2GsOxdtnCtlystOtl_0000 : 16|16@1+ (0.03125,-273) [-273|1734.96875] "deg C" Vector__XXX
 SG_ Aftrtrtmnt2GsOxdtnCtlystInt_0000 : 0|16@1+ (0.03125,-273) [-273|1734.96875] "deg C" Vector__XXX
 SG_ Aftrtrtmnt1DslOxdtnCtlystDf_0000 : 58|5@1+ (1,0) [0|31] "" Vector__XXX
 SG_ Aftrtrtmnt1DslOxdtnCtlystOtltGsT : 53|5@1+ (1,0) [0|31] "" Vector__XXX
 SG_ Aftrtrtmnt1DslOxdtnCtlystIntkGsT : 48|5@1+ (1,0) [0|31] "" Vector__XXX
 SG_ Aftrtrtmnt1DslOxdtnCtlystDffPrss : 32|16@1+ (0.1,0) [0|6425.5] "kPa" Vector__XXX
 SG_ Aftrtrtmnt1DslOxdtnCtlystOt_0000 : 16|16@1+ (0.03125,-273) [-273|1734.96875] "deg C" Vector__XXX
 SG_ Aftrtrtmnt1DslOxdtnCtlystIn_0000 : 0|16@1+ (0.03125,-273) [-273|1734.96875] "deg C" Vector__XXX
 SG_ Aftrtrtmnt2DslOxdtnCtlystOtltGsT : 53|5@1+ (1,0) [0|31] "" Vector__XXX
 SG_ Aftrtrtmnt2DslOxdtnCtlystIntkGsT : 48|5@1+ (1,0) [0|31] "" Vector__XXX
 SG_ Aftrtrtmnt2DslOxdtnCtlystDffPrss : 32|16@1+ (0.5,0) [0|32127.5] "kPa" Vector__XXX
 SG_ Aftrtrtmnt2DslOxdtnCtlystOt_0000 : 16|16@1+ (0.03125,-273) [-273|1734.96875] "deg C" Vector__XXX
 SG_ Aftrtrtmnt2DslOxdtnCtlystIn_0000 : 0|16@1+ (0.03125,-273) [-273|1734.96875] "deg C" Vector__XXX
 SG_ Aftrtrtmnt2DslOxdtnCtlystDf_0000 : 58|5@1+ (1,0) [0|31] "" Vector__XXX
 SG_ Aftrtrtmnt2GsOxdtnCtlystDffGsTmp : 16|16@1+ (0.03125,-273) [-273|1734.96875] "deg C" Vector__XXX
 SG_ Aftrtrtmnt1GsOxdtnCtlystDffGsTmp : 0|16@1+ (0.03125,-273) [-273|1734.96875] "deg C" Vector__XXX
 SG_ Aftrtrtmnt2ThrWyCtlystDffGsTemp : 16|16@1+ (0.03125,-273) [-273|1734.96875] "deg C" Vector__XXX
 SG_ Aftrtrtmnt1ThrWyCtlystDffGsTemp : 0|16@1+ (0.03125,-273) [-273|1734.96875] "deg C" Vector__XXX
 SG_ DslPrtcltFltr1StSnsrPrlmnaryFMI : 48|5@1+ (1,0) [0|31] "" Vector__XXX
 SG_ DslPrtcltFlter1MedianSootSignal : 32|16@1+ (0.0025,0) [0|160.6375] "%" Vector__XXX
 SG_ DslPrtclteFilter1MeanSootSignal : 16|16@1+ (0.0025,0) [0|160.6375] "%" Vector__XXX
 SG_ DslPrticulateFilter1SootDensity : 8|8@1+ (0.08,0) [0|20] "g/L" Vector__XXX
 SG_ DeselParticulateFilter1SootMass : 0|8@1+ (4,0) [0|1000] "g" Vector__XXX
 SG_ DslPrtcltFltr2StSnsrPrlmnaryFMI : 48|5@1+ (1,0) [0|31] "" Vector__XXX
 SG_ DslPrtcltFlter2MedianSootSignal : 32|16@1+ (0.0025,0) [0|160.6375] "%" Vector__XXX
 SG_ DslPrtclteFilter2MeanSootSignal : 16|16@1+ (0.0025,0) [0|160.6375] "%" Vector__XXX
 SG_ DslPrticulateFilter2SootDensity : 8|8@1+ (0.08,0) [0|20] "g/L" Vector__XXX
 SG_ DeselParticulateFilter2SootMass : 0|8@1+ (4,0) [0|1000] "g" Vector__XXX
 SG_ Aftrtrtmnt1WrmUpDslOxdtnCtlystOt : 16|16@1+ (0.03125,-273) [-273|1734.96875] "deg C" Vector__XXX
 SG_ Aftrtrtmnt1WrmUpDslOxdtnCtlystIn : 0|16@1+ (0.03125,-273) [-273|1734.96875] "deg C" Vector__XXX
 SG_ SpecialIgnitorLoop90Resistance : 1584|16@1+ (0.1,0) [0|6425.5] "ohm" Vector__XXX
 SG_ SpecialIgnitorLoop89Resistance : 1568|16@1+ (0.1,0) [0|6425.5] "ohm" Vector__XXX
 SG_ SpecialIgnitorLoop88Resistance : 1552|16@1+ (0.1,0) [0|6425.5] "ohm" Vector__XXX
 SG_ SpecialIgnitorLoop87Resistance : 1536|16@1+ (0.1,0) [0|6425.5] "ohm" Vector__XXX
 SG_ SpecialIgnitorLoop86Resistance : 1520|16@1+ (0.1,0) [0|6425.5] "ohm" Vector__XXX
 SG_ SpecialIgnitorLoop85Resistance : 1504|16@1+ (0.1,0) [0|6425.5] "ohm" Vector__XXX
 SG_ SpecialIgnitorLoop84Resistance : 1488|16@1+ (0.1,0) [0|6425.5] "ohm" Vector__XXX
 SG_ SpecialIgnitorLoop83Resistance : 1472|16@1+ (0.1,0) [0|6425.5] "ohm" Vector__XXX
 SG_ SpecialIgnitorLoop82Resistance : 1456|16@1+ (0.1,0) [0|6425.5] "ohm" Vector__XXX
 SG_ SpecialIgnitorLoop81Resistance : 1440|16@1+ (0.1,0) [0|6425.5] "ohm" Vector__XXX
 SG_ SpecialIgnitorLoop80Resistance : 1424|16@1+ (0.1,0) [0|6425.5] "ohm" Vector__XXX
 SG_ SpecialIgnitorLoop79Resistance : 1408|16@1+ (0.1,0) [0|6425.5] "ohm" Vector__XXX
 SG_ SpecialIgnitorLoop78Resistance : 1392|16@1+ (0.1,0) [0|6425.5] "ohm" Vector__XXX
 SG_ SpecialIgnitorLoop77Resistance : 1376|16@1+ (0.1,0) [0|6425.5] "ohm" Vector__XXX
 SG_ SpecialIgnitorLoop76Resistance : 1360|16@1+ (0.1,0) [0|6425.5] "ohm" Vector__XXX
 SG_ SpecialIgnitorLoop75Resistance : 1344|16@1+ (0.1,0) [0|6425.5] "ohm" Vector__XXX
 SG_ SpecialIgnitorLoop74Resistance : 1328|16@1+ (0.1,0) [0|6425.5] "ohm" Vector__XXX
 SG_ SpecialIgnitorLoop73Resistance : 1312|16@1+ (0.1,0) [0|6425.5] "ohm" Vector__XXX
 SG_ SpecialIgnitorLoop72Resistance : 1296|16@1+ (0.1,0) [0|6425.5] "ohm" Vector__XXX
 SG_ SpecialIgnitorLoop71Resistance : 1280|16@1+ (0.1,0) [0|6425.5] "ohm" Vector__XXX
 SG_ SpecialIgnitorLoop70Resistance : 1264|16@1+ (0.1,0) [0|6425.5] "ohm" Vector__XXX
 SG_ SpecialIgnitorLoop69Resistance : 1248|16@1+ (0.1,0) [0|6425.5] "ohm" Vector__XXX
 SG_ SpecialIgnitorLoop68Resistance : 1232|16@1+ (0.1,0) [0|6425.5] "ohm" Vector__XXX
 SG_ SpecialIgnitorLoop67Resistance : 1216|16@1+ (0.1,0) [0|6425.5] "ohm" Vector__XXX
 SG_ SpecialIgnitorLoop66Resistance : 1200|16@1+ (0.1,0) [0|6425.5] "ohm" Vector__XXX
 SG_ SpecialIgnitorLoop65Resistance : 1184|16@1+ (0.1,0) [0|6425.5] "ohm" Vector__XXX
 SG_ SpecialIgnitorLoop64Resistance : 1168|16@1+ (0.1,0) [0|6425.5] "ohm" Vector__XXX
 SG_ SpecialIgnitorLoop63Resistance : 1152|16@1+ (0.1,0) [0|6425.5] "ohm" Vector__XXX
 SG_ SpecialIgnitorLoop61Resistance : 1120|16@1+ (0.1,0) [0|6425.5] "ohm" Vector__XXX
 SG_ SpecialIgnitorLoop60Resistance : 1104|16@1+ (0.1,0) [0|6425.5] "ohm" Vector__XXX
 SG_ SpecialIgnitorLoop59Resistance : 1088|16@1+ (0.1,0) [0|6425.5] "ohm" Vector__XXX
 SG_ SpecialIgnitorLoop58Resistance : 1072|16@1+ (0.1,0) [0|6425.5] "ohm" Vector__XXX
 SG_ SpecialIgnitorLoop57Resistance : 1056|16@1+ (0.1,0) [0|6425.5] "ohm" Vector__XXX
 SG_ SpecialIgnitorLoop56Resistance : 1040|16@1+ (0.1,0) [0|6425.5] "ohm" Vector__XXX
 SG_ SpecialIgnitorLoop55Resistance : 1024|16@1+ (0.1,0) [0|6425.5] "ohm" Vector__XXX
 SG_ SpecialIgnitorLoop54Resistance : 1008|16@1+ (0.1,0) [0|6425.5] "ohm" Vector__XXX
 SG_ SpecialIgnitorLoop53Resistance : 992|16@1+ (0.1,0) [0|6425.5] "ohm" Vector__XXX
 SG_ SpecialIgnitorLoop52Resistance : 976|16@1+ (0.1,0) [0|6425.5] "ohm" Vector__XXX
 SG_ SpecialIgnitorLoop51Resistance : 960|16@1+ (0.1,0) [0|6425.5] "ohm" Vector__XXX
 SG_ SpecialIgnitorLoop50Resistance : 944|16@1+ (0.1,0) [0|6425.5] "ohm" Vector__XXX
 SG_ SpecialIgnitorLoop49Resistance : 928|16@1+ (0.1,0) [0|6425.5] "ohm" Vector__XXX
 SG_ SpecialIgnitorLoop48Resistance : 912|16@1+ (0.1,0) [0|6425.5] "ohm" Vector__XXX
 SG_ SpecialIgnitorLoop47Resistance : 896|16@1+ (0.1,0) [0|6425.5] "ohm" Vector__XXX
 SG_ SpecialIgnitorLoop46Resistance : 880|16@1+ (0.1,0) [0|6425.5] "ohm" Vector__XXX
 SG_ SpecialIgnitorLoop45Resistance : 864|16@1+ (0.1,0) [0|6425.5] "ohm" Vector__XXX
 SG_ SpecialIgnitorLoop44Resistance : 848|16@1+ (0.1,0) [0|6425.5] "ohm" Vector__XXX
 SG_ SpecialIgnitorLoop43Resistance : 832|16@1+ (0.1,0) [0|6425.5] "ohm" Vector__XXX
 SG_ SpecialIgnitorLoop42Resistance : 816|16@1+ (0.1,0) [0|6425.5] "ohm" Vector__XXX
 SG_ SpecialIgnitorLoop41Resistance : 800|16@1+ (0.1,0) [0|6425.5] "ohm" Vector__XXX
 SG_ SpecialIgnitorLoop40Resistance : 784|16@1+ (0.1,0) [0|6425.5] "ohm" Vector__XXX
 SG_ SpecialIgnitorLoop39Resistance : 768|16@1+ (0.1,0) [0|6425.5] "ohm" Vector__XXX
 SG_ SpecialIgnitorLoop38Resistance : 752|16@1+ (0.1,0) [0|6425.5] "ohm" Vector__XXX
 SG_ SpecialIgnitorLoop37Resistance : 736|16@1+ (0.1,0) [0|6425.5] "ohm" Vector__XXX
 SG_ SpecialIgnitorLoop36Resistance : 720|16@1+ (0.1,0) [0|6425.5] "ohm" Vector__XXX
 SG_ SpecialIgnitorLoop35Resistance : 704|16@1+ (0.1,0) [0|6425.5] "ohm" Vector__XXX
 SG_ SpecialIgnitorLoop34Resistance : 688|16@1+ (0.1,0) [0|6425.5] "ohm" Vector__XXX
 SG_ SpecialIgnitorLoop33Resistance : 672|16@1+ (0.1,0) [0|6425.5] "ohm" Vector__XXX
 SG_ SpecialIgnitorLoop32Resistance : 656|16@1+ (0.1,0) [0|6425.5] "ohm" Vector__XXX
 SG_ SpecialIgnitorLoop31Resistance : 640|16@1+ (0.1,0) [0|6425.5] "ohm" Vector__XXX
 SG_ SpecialIgnitorLoop30Resistance : 624|16@1+ (0.1,0) [0|6425.5] "ohm" Vector__XXX
 SG_ SpecialIgnitorLoop29Resistance : 608|16@1+ (0.1,0) [0|6425.5] "ohm" Vector__XXX
 SG_ SpecialIgnitorLoop28Resistance : 592|16@1+ (0.1,0) [0|6425.5] "ohm" Vector__XXX
 SG_ SpecialIgnitorLoop27Resistance : 576|16@1+ (0.1,0) [0|6425.5] "ohm" Vector__XXX
 SG_ SpecialIgnitorLoop26Resistance : 560|16@1+ (0.1,0) [0|6425.5] "ohm" Vector__XXX
 SG_ SpecialIgnitorLoop25Resistance : 544|16@1+ (0.1,0) [0|6425.5] "ohm" Vector__XXX
 SG_ SpecialIgnitorLoop24Resistance : 528|16@1+ (0.1,0) [0|6425.5] "ohm" Vector__XXX
 SG_ SpecialIgnitorLoop23Resistance : 512|16@1+ (0.1,0) [0|6425.5] "ohm" Vector__XXX
 SG_ SpecialIgnitorLoop22Resistance : 496|16@1+ (0.1,0) [0|6425.5] "ohm" Vector__XXX
 SG_ SpecialIgnitorLoop21Resistance : 480|16@1+ (0.1,0) [0|6425.5] "ohm" Vector__XXX
 SG_ SpecialIgnitorLoop20Resistance : 464|16@1+ (0.1,0) [0|6425.5] "ohm" Vector__XXX
 SG_ SpecialIgnitorLoop19Resistance : 448|16@1+ (0.1,0) [0|6425.5] "ohm" Vector__XXX
 SG_ SpecialIgnitorLoop18Resistance : 432|16@1+ (0.1,0) [0|6425.5] "ohm" Vector__XXX
 SG_ SpecialIgnitorLoop17Resistance : 416|16@1+ (0.1,0) [0|6425.5] "ohm" Vector__XXX
 SG_ SpecialIgnitorLoop16Resistance : 400|16@1+ (0.1,0) [0|6425.5] "ohm" Vector__XXX
 SG_ SpecialIgnitorLoop15Resistance : 384|16@1+ (0.1,0) [0|6425.5] "ohm" Vector__XXX
 SG_ SpecialIgnitorLoop14Resistance : 368|16@1+ (0.1,0) [0|6425.5] "ohm" Vector__XXX
 SG_ SpecialIgnitorLoop13Resistance : 352|16@1+ (0.1,0) [0|6425.5] "ohm" Vector__XXX
 SG_ SpecialIgnitorLoop12Resistance : 336|16@1+ (0.1,0) [0|6425.5] "ohm" Vector__XXX
 SG_ SpecialIgnitorLoop11Resistance : 320|16@1+ (0.1,0) [0|6425.5] "ohm" Vector__XXX
 SG_ SpecialIgnitorLoop10Resistance : 304|16@1+ (0.1,0) [0|6425.5] "ohm" Vector__XXX
 SG_ SpecialIgnitorLoop9Resistance : 288|16@1+ (0.1,0) [0|6425.5] "ohm" Vector__XXX
 SG_ SpecialIgnitorLoop8Resistance : 272|16@1+ (0.1,0) [0|6425.5] "ohm" Vector__XXX
 SG_ SpecialIgnitorLoop7Resistance : 256|16@1+ (0.1,0) [0|6425.5] "ohm" Vector__XXX
 SG_ SpecialIgnitorLoop6Resistance : 240|16@1+ (0.1,0) [0|6425.5] "ohm" Vector__XXX
 SG_ SpecialIgnitorLoop5Resistance : 224|16@1+ (0.1,0) [0|6425.5] "ohm" Vector__XXX
 SG_ SpecialIgnitorLoop4Resistance : 208|16@1+ (0.1,0) [0|6425.5] "ohm" Vector__XXX
 SG_ SpecialIgnitorLoop3Resistance : 192|16@1+ (0.1,0) [0|6425.5] "ohm" Vector__XXX
 SG_ SpecialIgnitorLoop2Resistance : 176|16@1+ (0.1,0) [0|6425.5] "ohm" Vector__XXX
 SG_ SpecialIgnitorLoop1Resistance : 160|16@1+ (0.1,0) [0|6425.5] "ohm" Vector__XXX
 SG_ SdBgIgnitorLoop2RightResistance : 144|16@1+ (0.1,0) [0|6425.5] "ohm" Vector__XXX
 SG_ SdBgIgnitorLoop1RightResistance : 128|16@1+ (0.1,0) [0|6425.5] "ohm" Vector__XXX
 SG_ SdBagIgnitorLoop2LeftResistance : 112|16@1+ (0.1,0) [0|6425.5] "ohm" Vector__XXX
 SG_ SdBagIgnitorLoop1LeftResistance : 96|16@1+ (0.1,0) [0|6425.5] "ohm" Vector__XXX
 SG_ PssngrBltTnsnrIgntrLpResistance : 80|16@1+ (0.1,0) [0|6425.5] "ohm" Vector__XXX
 SG_ DrvrBltTnsnrIgntrLoopResistance : 64|16@1+ (0.1,0) [0|6425.5] "ohm" Vector__XXX
 SG_ PssngrArbgIgntrLp2ndStgRsstance : 48|16@1+ (0.1,0) [0|6425.5] "ohm" Vector__XXX
 SG_ DrvrArbgIgntrLp2ndStgResistance : 32|16@1+ (0.1,0) [0|6425.5] "ohm" Vector__XXX
 SG_ PssngrArbgIgntrLp1stStgRsstance : 16|16@1+ (0.1,0) [0|6425.5] "ohm" Vector__XXX
 SG_ DrvrArbgIgntrLp1stStgResistance : 0|16@1+ (0.1,0) [0|6425.5] "ohm" Vector__XXX
 SG_ RearCollisionSensor4Type : 60|4@1+ (1,0) [0|15] "" Vector__XXX
 SG_ RearCollisionSensor3Type : 56|4@1+ (1,0) [0|15] "" Vector__XXX
 SG_ RearCollisionSensor2Type : 52|4@1+ (1,0) [0|15] "" Vector__XXX
 SG_ RearCollisionSensor1Type : 48|4@1+ (1,0) [0|15] "" Vector__XXX
 SG_ SdeCollisionSensorRearRightType : 44|4@1+ (1,0) [0|15] "" Vector__XXX
 SG_ SdCllsionSensorMidRearRightType : 40|4@1+ (1,0) [0|15] "" Vector__XXX
 SG_ SdCllsonSensorMidFrontRightType : 36|4@1+ (1,0) [0|15] "" Vector__XXX
 SG_ SdCollisionSensorFrontRightType : 32|4@1+ (1,0) [0|15] "" Vector__XXX
 SG_ SideCollisionSensorRearLeftType : 28|4@1+ (1,0) [0|15] "" Vector__XXX
 SG_ SdCllisionSensorMidRearLeftType : 24|4@1+ (1,0) [0|15] "" Vector__XXX
 SG_ SdCllsionSensorMidFrontLeftType : 20|4@1+ (1,0) [0|15] "" Vector__XXX
 SG_ SdeCollisionSensorFrontLeftType : 16|4@1+ (1,0) [0|15] "" Vector__XXX
 SG_ FrontalCollisionSensor4Type : 12|4@1+ (1,0) [0|15] "" Vector__XXX
 SG_ FrontalCollisionSensor3Type : 8|4@1+ (1,0) [0|15] "" Vector__XXX
 SG_ FrontalCollisionSensor2Type : 4|4@1+ (1,0) [0|15] "" Vector__XXX
 SG_ FrontalCollisionSensor1Type : 0|4@1+ (1,0) [0|15] "" Vector__XXX
 SG_ PssngrArbgDctvationSwitchStatus : 20|2@1+ (1,0) [0|3] "" Vector__XXX
 SG_ Beltlock10Status : 18|2@1+ (1,0) [0|3] "" Vector__XXX
 SG_ Beltlock9Status : 16|2@1+ (1,0) [0|3] "" Vector__XXX
 SG_ Beltlock8Status : 14|2@1+ (1,0) [0|3] "" Vector__XXX
 SG_ Beltlock7Status : 12|2@1+ (1,0) [0|3] "" Vector__XXX
 SG_ Beltlock6Status : 10|2@1+ (1,0) [0|3] "" Vector__XXX
 SG_ Beltlock5Status : 8|2@1+ (1,0) [0|3] "" Vector__XXX
 SG_ Beltlock4Status : 6|2@1+ (1,0) [0|3] "" Vector__XXX
 SG_ Beltlock3Status : 4|2@1+ (1,0) [0|3] "" Vector__XXX
 SG_ PassengerBeltlockStatus : 2|2@1+ (1,0) [0|3] "" Vector__XXX
 SG_ DriverBeltlockStatus : 0|2@1+ (1,0) [0|3] "" Vector__XXX
 SG_ OccpntClssfcationSystem10Status : 22|2@1+ (1,0) [0|3] "" Vector__XXX
 SG_ OccpntClssficationSystem9Status : 20|2@1+ (1,0) [0|3] "" Vector__XXX
 SG_ OccpntClssficationSystem8Status : 18|2@1+ (1,0) [0|3] "" Vector__XXX
 SG_ OccpntClssficationSystem7Status : 16|2@1+ (1,0) [0|3] "" Vector__XXX
 SG_ OccpntClssficationSystem6Status : 14|2@1+ (1,0) [0|3] "" Vector__XXX
 SG_ OccpntClssficationSystem5Status : 12|2@1+ (1,0) [0|3] "" Vector__XXX
 SG_ OccpntClssficationSystem4Status : 10|2@1+ (1,0) [0|3] "" Vector__XXX
 SG_ OccpntClssficationSystem3Status : 8|2@1+ (1,0) [0|3] "" Vector__XXX
 SG_ PssngrOccpntClssfctnSystmStatus : 3|3@1+ (1,0) [0|7] "" Vector__XXX
 SG_ DrvrOccpntClssfctonSystemStatus : 0|3@1+ (1,0) [0|7] "" Vector__XXX
 SG_ BatteryCharger1OutputCurrent : 24|16@1+ (0.05,-1600) [-1600|1612.75] "A" Vector__XXX
 SG_ BatteryCharger1OutputVoltage : 8|16@1+ (0.05,0) [0|3212.75] "V" Vector__XXX
 SG_ BatteryCharger1PowerLineState : 4|2@1+ (1,0) [0|3] "" Vector__XXX
 SG_ BatteryCharger1State : 0|4@1+ (1,0) [0|15] "" Vector__XXX
 SG_ BatteryCharger2OutputCurrent : 24|16@1+ (0.05,-1600) [-1600|1612.75] "A" Vector__XXX
 SG_ BatteryCharger2OutputVoltage : 8|16@1+ (0.05,0) [0|3212.75] "V" Vector__XXX
 SG_ BatteryCharger2PowerLineState : 4|2@1+ (1,0) [0|3] "" Vector__XXX
 SG_ BatteryCharger2State : 0|4@1+ (1,0) [0|15] "" Vector__XXX
 SG_ MagnetRatedPower : 8|16@1+ (0.5,0) [0|32127.5] "kW" Vector__XXX
 SG_ MagnetBoostTime : 0|8@1+ (0.25,0) [0|62.5] "s" Vector__XXX
 SG_ GneratorDutyCycleExceededStatus : 20|2@1+ (1,0) [0|3] "" Vector__XXX
 SG_ VoltageMonitorActiveStatus : 18|2@1+ (1,0) [0|3] "" Vector__XXX
 SG_ GensetEnableActiveStatus : 16|2@1+ (1,0) [0|3] "" Vector__XXX
 SG_ ReverseCurrentRangeSetting : 8|5@1+ (1,0) [0|31] "" Vector__XXX
 SG_ GensetSoftstartActiveStatus : 6|2@1+ (1,0) [0|3] "" Vector__XXX
 SG_ Grapple_MagnetSelectionSwitch : 4|2@1+ (1,0) [0|3] "" Vector__XXX
 SG_ GnstSystmOtptVoltageRangeStatus : 2|2@1+ (1,0) [0|3] "" Vector__XXX
 SG_ GeneratorOverheatStatus : 0|2@1+ (1,0) [0|3] "" Vector__XXX
 SG_ Aftrtrtmnt1IntkGsNOxSnsrNwPrtDvt : 32|8@1+ (1,-125) [-125|125] "ppm" Vector__XXX
 SG_ Aftrtrtmnt1IntkGsNOxSnsrNwP_0000 : 16|16@1+ (0.1,-100) [-100|100] "%" Vector__XXX
 SG_ Aftrtrtmnt1IntkGsNOxSnsrHtrRtio : 0|16@1+ (0.001,0) [0|64.255] "" Vector__XXX
 SG_ Aftrtrtmnt1IntkGsNOxSnsrNH3Crrct : 24|8@1+ (0.5,0) [0|125] "%" Vector__XXX
 SG_ Aftrtrtmnt1IntkGsNOxSnsrNO2Crrct : 16|8@1+ (0.5,0) [0|125] "%" Vector__XXX
 SG_ Aftrtrtmnt1IntkGsNOxSnsrCrrctnOf : 8|8@1+ (0.5,0) [0|125] "%/bar" Vector__XXX
 SG_ Aftrtrtmnt1IntkGsNOxSnsrCrr_0000 : 0|8@1+ (0.5,0) [0|125] "%/bar" Vector__XXX
 SG_ Aftrtrtmnt1OtltGsNOxSnsrNwPrtDvt : 32|8@1+ (1,-125) [-125|125] "ppm" Vector__XXX
 SG_ Aftrtrtmnt1OtltGsNOxSnsrNwP_0000 : 16|16@1+ (0.1,-100) [-100|100] "%" Vector__XXX
 SG_ Aftrtrtmnt1OtltGsNOxSnsrHtrRtio : 0|16@1+ (0.001,0) [0|64.255] "" Vector__XXX
 SG_ Aftrtrtmnt1OtltGsNOxSnsrNH3Crrct : 24|8@1+ (0.5,0) [0|125] "%" Vector__XXX
 SG_ Aftrtrtmnt1OtltGsNOxSnsrNO2Crrct : 16|8@1+ (0.5,0) [0|125] "%" Vector__XXX
 SG_ Aftrtrtmnt1OtltGsNOxSnsrCrrctnOf : 8|8@1+ (0.5,0) [0|125] "%/bar" Vector__XXX
 SG_ Aftrtrtmnt1OtltGsNOxSnsrCrr_0000 : 0|8@1+ (0.5,0) [0|125] "%/bar" Vector__XXX
 SG_ Aftrtrtmnt2IntkGsNOxSnsrNwPrtDvt : 32|8@1+ (1,-125) [-125|125] "ppm" Vector__XXX
 SG_ Aftrtrtmnt2IntkGsNOxSnsrNwP_0000 : 16|16@1+ (0.1,-100) [-100|100] "%" Vector__XXX
 SG_ Aftrtrtmnt2IntkGsNOxSnsrHtrRtio : 0|16@1+ (0.001,0) [0|64.255] "" Vector__XXX
 SG_ Aftrtrtmnt2IntkGsNOxSnsrNH3Crrct : 24|8@1+ (0.5,0) [0|125] "%" Vector__XXX
 SG_ Aftrtrtmnt2IntkGsNOxSnsrNO2Crrct : 16|8@1+ (0.5,0) [0|125] "%" Vector__XXX
 SG_ Aftrtrtmnt2IntkGsNOxSnsrCrrctnOf : 8|8@1+ (0.5,0) [0|125] "%/bar" Vector__XXX
 SG_ Aftrtrtmnt2IntkGsNOxSnsrCrr_0000 : 0|8@1+ (0.5,0) [0|125] "%/bar" Vector__XXX
 SG_ Aftrtrtmnt2OtltGsNOxSnsrNwPrtDvt : 32|8@1+ (1,-125) [-125|125] "ppm" Vector__XXX
 SG_ Aftrtrtmnt2OtltGsNOxSnsrNwP_0000 : 16|16@1+ (0.1,-100) [-100|100] "%" Vector__XXX
 SG_ Aftrtrtmnt2OtltGsNOxSnsrHtrRtio : 0|16@1+ (0.001,0) [0|64.255] "" Vector__XXX
 SG_ Aftrtrtmnt2OtltGsNOxSnsrNH3Crrct : 24|8@1+ (0.5,0) [0|125] "%" Vector__XXX
 SG_ Aftrtrtmnt2OtltGsNOxSnsrNO2Crrct : 16|8@1+ (0.5,0) [0|125] "%" Vector__XXX
 SG_ Aftrtrtmnt2OtltGsNOxSnsrCrrctnOf : 8|8@1+ (0.5,0) [0|125] "%/bar" Vector__XXX
 SG_ Aftrtrtmnt2OtltGsNOxSnsrCrr_0000 : 0|8@1+ (0.5,0) [0|125] "%/bar" Vector__XXX
 SG_ HighResolutionEngTotalFuelUsed : 32|32@1+ (0.001,0) [0|4211081.215] "L" Vector__XXX
 SG_ HighResolutionEngTripFuel : 0|32@1+ (0.001,0) [0|4211081.215] "L" Vector__XXX
 SG_ EngOilRelativeDielectricity : 32|16@1+ (0.0001220703125,0) [0|7.844] "" Vector__XXX
 SG_ EngOilDensity : 16|16@1+ (3.052e-05,0) [0|1.961] "g/cc" Vector__XXX
 SG_ EngOilViscosity : 0|16@1+ (0.015625,0) [0|1003.984375] "Cp" Vector__XXX
 SG_ EngFuelFilterRestrictedLampCmd : 22|2@1+ (1,0) [0|3] "" Vector__XXX
 SG_ EngAirFilterRestrictionLampCmd : 20|2@1+ (1,0) [0|3] "" Vector__XXX
 SG_ EngIdleManagementActiveLampCmd : 18|2@1+ (1,0) [0|3] "" Vector__XXX
 SG_ EngCoolantLevelLowLampCmd : 16|2@1+ (1,0) [0|3] "" Vector__XXX
 SG_ EngCoolantTempHighLampCmd : 14|2@1+ (1,0) [0|3] "" Vector__XXX
 SG_ EngOilPressLowLampCmd : 12|2@1+ (1,0) [0|3] "" Vector__XXX
 SG_ CmprssnBrkEnblSwtchIndctrLmpCmd : 10|2@1+ (1,0) [0|3] "" Vector__XXX
 SG_ EngBrakeActiveLampCmd : 8|2@1+ (1,0) [0|3] "" Vector__XXX
 SG_ OBDMalfunctionIndicatorLampCmd : 6|2@1+ (1,0) [0|3] "" Vector__XXX
 SG_ EngRedStopLampCmd : 4|2@1+ (1,0) [0|3] "" Vector__XXX
 SG_ EngAmberWarningLampCmd : 2|2@1+ (1,0) [0|3] "" Vector__XXX
 SG_ EngProtectLampCmd : 0|2@1+ (1,0) [0|3] "" Vector__XXX
 SG_ VehicleBatteryChargingLampCmd : 8|2@1+ (1,0) [0|3] "" Vector__XXX
 SG_ VehicleHVACRecirculationLampCmd : 6|2@1+ (1,0) [0|3] "" Vector__XXX
 SG_ VehicleAirPressLowLampCmd : 4|2@1+ (1,0) [0|3] "" Vector__XXX
 SG_ VehicleFuelLevelLowLampCmd : 2|2@1+ (1,0) [0|3] "" Vector__XXX
 SG_ VehicleBatteryVoltageLowLampCmd : 0|2@1+ (1,0) [0|3] "" Vector__XXX
 SG_ EngWaitToStartLampData : 62|2@1+ (1,0) [0|3] "" Vector__XXX
 SG_ EngFuelFilterRestrictedLampData : 22|2@1+ (1,0) [0|3] "" Vector__XXX
 SG_ EngAirFilterRestrictionLampData : 20|2@1+ (1,0) [0|3] "" Vector__XXX
 SG_ EngIdleManagementActiveLampData : 18|2@1+ (1,0) [0|3] "" Vector__XXX
 SG_ EngCoolantLevelLowLampData : 16|2@1+ (1,0) [0|3] "" Vector__XXX
 SG_ EngCoolantTempHighLampData : 14|2@1+ (1,0) [0|3] "" Vector__XXX
 SG_ EngOilPressLowLampData : 12|2@1+ (1,0) [0|3] "" Vector__XXX
 SG_ CmprssnBrkEnblSwtchIndctrLmpDta : 10|2@1+ (1,0) [0|3] "" Vector__XXX
 SG_ EngBrakeActiveLampData : 8|2@1+ (1,0) [0|3] "" Vector__XXX
 SG_ OBDMalfunctionIndicatorLampData : 6|2@1+ (1,0) [0|3] "" Vector__XXX
 SG_ EngRedStopLampData : 4|2@1+ (1,0) [0|3] "" Vector__XXX
 SG_ EngAmberWarningLampData : 2|2@1+ (1,0) [0|3] "" Vector__XXX
 SG_ EngProtectLampData : 0|2@1+ (1,0) [0|3] "" Vector__XXX
 SG_ VehicleBatteryChargingLampData : 8|2@1+ (1,0) [0|3] "" Vector__XXX
 SG_ VhicleHVACRecirculationLampData : 6|2@1+ (1,0) [0|3] "" Vector__XXX
 SG_ VehicleAirPressLowLampData : 4|2@1+ (1,0) [0|3] "" Vector__XXX
 SG_ VehicleFuelLevelLowLampData : 2|2@1+ (1,0) [0|3] "" Vector__XXX
 SG_ VhicleBatteryVoltageLowLampData : 0|2@1+ (1,0) [0|3] "" Vector__XXX
 SG_ LowVoltageDisconnectTemp : 24|8@1+ (1,-40) [-40|210] "deg C" Vector__XXX
 SG_ LwVltgDisconnectVoutOutputState : 20|4@1+ (1,0) [0|15] "" Vector__XXX
 SG_ LwVoltageDisconnectOutput1State : 16|4@1+ (1,0) [0|15] "" Vector__XXX
 SG_ LwVoltageDisconnectOutput2State : 12|4@1+ (1,0) [0|15] "" Vector__XXX
 SG_ LwVoltageDisconnectOutput3State : 8|4@1+ (1,0) [0|15] "" Vector__XXX
 SG_ LwVltgDscnnctCrrntOperatingMode : 4|4@1+ (1,0) [0|15] "" Vector__XXX
 SG_ LwVltgDscnnctManualConnectState : 2|2@1+ (1,0) [0|3] "" Vector__XXX
 SG_ LwVltgDscnnctMnlDisconnectState : 0|2@1+ (1,0) [0|3] "" Vector__XXX
 SG_ EngExhstGsRcrcltn2IntkeAbsPress : 40|16@1+ (0.1,0) [0|6425.5] "kPa" Vector__XXX
 SG_ EngExhstGsRcrcltn2OtletAbsPress : 24|16@1+ (0.1,0) [0|6425.5] "kPa" Vector__XXX
 SG_ EngExhstGsRcrcltion2IntakePress : 16|8@1+ (2,0) [0|500] "kPa" Vector__XXX
 SG_ EngExhstGsRcrculation2DiffPress : 0|16@1+ (0.0078125,-250) [-250|251.99] "kPa" Vector__XXX
 SG_ EngExhstGsRcrcltn2MxrIntakeTemp : 16|16@1+ (0.03125,-273) [-273|1734.96875] "deg C" Vector__XXX
 SG_ EngExhaustGasRecirculation2Temp : 0|16@1+ (0.03125,-273) [-273|1734.96875] "deg C" Vector__XXX
 SG_ EGR2CoolerBypassActuatorPos : 40|8@1+ (0.4,0) [0|100] "%" Vector__XXX
 SG_ EngExhstGsRcrcltn2ClrEfficiency : 32|8@1+ (0.4,0) [0|100] "%" Vector__XXX
 SG_ EngExhstGsRcrcltn2ClrIntkGsAbsPr : 16|16@1+ (0.5,0) [0|32127.5] "kPa" Vector__XXX
 SG_ EngExhstGsRcrcltn2ClrIntakeTemp : 0|16@1+ (0.03125,-273) [-273|1734.96875] "deg C" Vector__XXX
 SG_ CmdedEngFuelInjectionCtrlPress : 48|16@1+ (0.00390625,0) [0|251] "MPa" Vector__XXX
 SG_ CmdedEngFuelRailPress : 32|16@1+ (0.00390625,0) [0|251] "MPa" Vector__XXX
 SG_ EngExhstGsRcrculation2Valve2Pos : 16|16@1+ (0.0025,0) [0|160.6375] "%" Vector__XXX
 SG_ EngExhstGsRcirculation2ValvePos : 0|16@1+ (0.0025,0) [0|160.6375] "%" Vector__XXX
 SG_ EngExhstMnfldBnk2FlwBlncVlv_0000 : 16|16@1+ (0.0025,0) [0|160.6375] "%" Vector__XXX
 SG_ EngExhstMnfldBnk1FlwBlncVlv_0000 : 0|16@1+ (0.0025,0) [0|160.6375] "%" Vector__XXX
 SG_ EngExhstMnfldBnk2FlwBlncVlvActtr : 16|16@1+ (0.0025,0) [0|160.6375] "%" Vector__XXX
 SG_ EngExhstMnfldBnk1FlwBlncVlvActtr : 0|16@1+ (0.0025,0) [0|160.6375] "%" Vector__XXX
 SG_ EngExhstGsRcrclation2Valve2Ctrl : 16|16@1+ (0.0025,0) [0|160.6375] "%" Vector__XXX
 SG_ EngExhstGsRcrculation2ValveCtrl : 0|16@1+ (0.0025,0) [0|160.6375] "%" Vector__XXX
 SG_ DslPrtclateFilter1SootSignalMin : 32|16@1+ (0.0025,0) [0|160.6375] "%" Vector__XXX
 SG_ DslPrtclateFilter1SootSignalMax : 16|16@1+ (0.0025,0) [0|160.6375] "%" Vector__XXX
 SG_ DslPrtcltFltr1StSgnlStndrdDvton : 0|16@1+ (0.0025,0) [0|160.6375] "%" Vector__XXX
 SG_ DslPrtclateFilter2SootSignalMin : 32|16@1+ (0.0025,0) [0|160.6375] "%" Vector__XXX
 SG_ DslPrtclateFilter2SootSignalMax : 16|16@1+ (0.0025,0) [0|160.6375] "%" Vector__XXX
 SG_ DslPrtcltFltr2StSgnlStndrdDvton : 0|16@1+ (0.0025,0) [0|160.6375] "%" Vector__XXX
 SG_ EngChrgArClr1PrcoolerEfficiency : 32|8@1+ (0.4,0) [0|100] "%" Vector__XXX
 SG_ EngChrgArClr1PrcoolerOutletTemp : 16|16@1+ (0.03125,-273) [-273|1734.96875] "deg C" Vector__XXX
 SG_ EngChrgArClr1PrcoolerIntakeTemp : 0|16@1+ (0.03125,-273) [-273|1734.96875] "deg C" Vector__XXX
 SG_ EngChargeAirCooler1Efficiency : 32|8@1+ (0.4,0) [0|100] "%" Vector__XXX
 SG_ EngChrgAirCooler1AmbientAirTemp : 16|16@1+ (0.03125,-273) [-273|1734.96875] "deg C" Vector__XXX
 SG_ EngChargeAirCooler1IntakeTemp : 0|16@1+ (0.03125,-273) [-273|1734.96875] "deg C" Vector__XXX
 SG_ EngChrgArClr2PrcoolerEfficiency : 32|8@1+ (0.4,0) [0|100] "%" Vector__XXX
 SG_ EngChrgArClr2PrcoolerOutletTemp : 16|16@1+ (0.03125,-273) [-273|1734.96875] "deg C" Vector__XXX
 SG_ EngChrgArClr2PrcoolerIntakeTemp : 0|16@1+ (0.03125,-273) [-273|1734.96875] "deg C" Vector__XXX
 SG_ EngChargeAirCooler2Efficiency : 48|8@1+ (0.4,0) [0|100] "%" Vector__XXX
 SG_ EngChrgAirCooler2AmbientAirTemp : 32|16@1+ (0.03125,-273) [-273|1734.96875] "deg C" Vector__XXX
 SG_ EngChargeAirCooler2OutletTemp : 16|16@1+ (0.03125,-273) [-273|1734.96875] "deg C" Vector__XXX
 SG_ EngChargeAirCooler2IntakeTemp : 0|16@1+ (0.03125,-273) [-273|1734.96875] "deg C" Vector__XXX
 SG_ EngTrbCmprssrBypssActtr2OprtnStt : 28|4@1+ (1,0) [0|15] "" Vector__XXX
 SG_ EngTrbCmprssrBypssActtr1OprtnStt : 24|4@1+ (1,0) [0|15] "" Vector__XXX
 SG_ EngTrbCmprssrBypssActtr2TmpStts : 21|3@1+ (1,0) [0|7] "" Vector__XXX
 SG_ EngTrbCmprssrBypssActtr2PrlmnryF : 16|5@1+ (1,0) [0|31] "" Vector__XXX
 SG_ EngDsrdTrbCmprssrBypssActtr2Pos : 8|8@1+ (0.4,0) [0|100] "%" Vector__XXX
 SG_ EngTrbCmprssrBypassActuator2Pos : 0|8@1+ (0.4,0) [0|100] "%" Vector__XXX
 SG_ EngFuelValve2OperationStatus : 60|4@1+ (1,0) [0|15] "" Vector__XXX
 SG_ EngFuelValve1OperationStatus : 56|4@1+ (1,0) [0|15] "" Vector__XXX
 SG_ EngThrttleValve2OperationStatus : 52|4@1+ (1,0) [0|15] "" Vector__XXX
 SG_ EngThrttleValve1OperationStatus : 48|4@1+ (1,0) [0|15] "" Vector__XXX
 SG_ EngFuelValve2TempStatus : 45|3@1+ (1,0) [0|7] "" Vector__XXX
 SG_ EngFuelValve2PreliminaryFMI : 40|5@1+ (1,0) [0|31] "" Vector__XXX
 SG_ EngFuelValve1TempStatus : 37|3@1+ (1,0) [0|7] "" Vector__XXX
 SG_ EngFuelValve1PreliminaryFMI : 32|5@1+ (1,0) [0|31] "" Vector__XXX
 SG_ EngThrottleValve2TempStatus : 29|3@1+ (1,0) [0|7] "" Vector__XXX
 SG_ EngThrottleValve2PreliminaryFMI : 24|5@1+ (1,0) [0|31] "" Vector__XXX
 SG_ EngDesiredThrottleValve2Pos : 16|8@1+ (0.4,0) [0|100] "%" Vector__XXX
 SG_ EngThrottleValve1TempStatus : 13|3@1+ (1,0) [0|7] "" Vector__XXX
 SG_ EngThrottleValve1PreliminaryFMI : 8|5@1+ (1,0) [0|31] "" Vector__XXX
 SG_ EngDesiredThrottleValve1Pos : 0|8@1+ (0.4,0) [0|100] "%" Vector__XXX
 SG_ EngTrbWstgtActtr2OprationStatus : 12|4@1+ (1,0) [0|15] "" Vector__XXX
 SG_ EngTrbWstgtActtr1OprationStatus : 8|4@1+ (1,0) [0|15] "" Vector__XXX
 SG_ EngTrbWstgteActuator2TempStatus : 5|3@1+ (1,0) [0|7] "" Vector__XXX
 SG_ EngTrbWstgtActtr2PreliminaryFMI : 0|5@1+ (1,0) [0|31] "" Vector__XXX
 SG_ EngFuelFilterIntakeAbsPress : 0|8@1+ (2,0) [0|500] "kPa" Vector__XXX
 SG_ EngExhstGsRcrcltn1IntkeAbsPress : 0|16@1+ (0.1,0) [0|6425.5] "kPa" Vector__XXX
 SG_ BldRferenceElevationOffsetRight : 48|16@1+ (1,-32000) [-32000|32255] "mm" Vector__XXX
 SG_ BldReferenceElevationOffsetLeft : 32|16@1+ (1,-32000) [-32000|32255] "mm" Vector__XXX
 SG_ BladeElevationDeviationRight : 16|16@1+ (1,-32000) [-32000|32255] "mm" Vector__XXX
 SG_ BladeElevationDeviationLeft : 0|16@1+ (1,-32000) [-32000|32255] "mm" Vector__XXX
 SG_ Aftrtrtmnt2WrmUpDslOxdtnCtlystOt : 16|16@1+ (0.03125,-273) [-273|1734.96875] "deg C" Vector__XXX
 SG_ Aftrtrtmnt2WrmUpDslOxdtnCtlystIn : 0|16@1+ (0.03125,-273) [-273|1734.96875] "deg C" Vector__XXX
 SG_ Aftrtrtmnt1NOxAdsrbrDSOxRgnrtnSt : 2|2@1+ (1,0) [0|3] "" Vector__XXX
 SG_ Aftrtrtmnt1NOxAdsrbrDNOxRgnrtnSt : 0|2@1+ (1,0) [0|3] "" Vector__XXX
 SG_ Aftrtrtmnt2NOxAdsrbrDSOxRgnrtnSt : 2|2@1+ (1,0) [0|3] "" Vector__XXX
 SG_ Aftrtrtmnt2NOxAdsrbrDNOxRgnrtnSt : 0|2@1+ (1,0) [0|3] "" Vector__XXX
 SG_ HybrdBatteryPackRemainingCharge : 0|16@1+ (0.0025,0) [0|160.6375] "%" Vector__XXX
 SG_ ArmrestSwitchMatrix2Switch2 : 6|2@1+ (1,0) [0|3] "" Vector__XXX
 SG_ ArmrestSwitchMatrix2Switch1 : 4|2@1+ (1,0) [0|3] "" Vector__XXX
 SG_ ArmrestSwitchMatrixSwitch2 : 2|2@1+ (1,0) [0|3] "" Vector__XXX
 SG_ ArmrestSwitchMatrixSwitch1 : 0|2@1+ (1,0) [0|3] "" Vector__XXX
 SG_ IntkVlvActtnSystmOlPrss2SlndCtrl : 2|2@1+ (1,0) [0|3] "" Vector__XXX
 SG_ IntkVlvActtnSystmOlPrss1SlndCtrl : 0|2@1+ (1,0) [0|3] "" Vector__XXX
 SG_ EngFrctnPrcntTorqueAtIdlePoint7 : 48|8@1+ (1,-125) [-125|125] "%" Vector__XXX
 SG_ EngFrctnPrcntTorqueAtIdlePoint6 : 40|8@1+ (1,-125) [-125|125] "%" Vector__XXX
 SG_ EngFrctnPrcntTorqueAtIdlePoint5 : 32|8@1+ (1,-125) [-125|125] "%" Vector__XXX
 SG_ EngFrctnPrcntTorqueAtIdlePoint4 : 24|8@1+ (1,-125) [-125|125] "%" Vector__XXX
 SG_ EngFrctnPrcntTorqueAtIdlePoint3 : 16|8@1+ (1,-125) [-125|125] "%" Vector__XXX
 SG_ EngFrctnPrcntTorqueAtIdlePoint2 : 8|8@1+ (1,-125) [-125|125] "%" Vector__XXX
 SG_ EngFrctnPrcntTorqueAtIdlePoint1 : 0|8@1+ (1,-125) [-125|125] "%" Vector__XXX
 SG_ AdvancedEmergencyBrakingState : 0|4@1+ (1,0) [0|0] "" Vector__XXX
 SG_ CollisionWarningLevel : 4|4@1+ (1,0) [0|0] "" Vector__XXX
 SG_ RelevantObjectDetectedForAEBS : 8|3@1+ (1,0) [0|0] "" Vector__XXX
 SG_ BendOffProbabilityOfRelevantObj : 11|3@1+ (1,0) [0|0] "" Vector__XXX
 SG_ TimeToCollisionWithRelevantObj : 16|8@1+ (1,0) [0|0] "" Vector__XXX
 SG_ EngTurboWastegateActuator2Cmd : 16|16@1+ (0.0025,0) [0|160.6375] "%" Vector__XXX
 SG_ EngTurboWastegateActuator1Cmd : 0|16@1+ (0.0025,0) [0|160.6375] "%" Vector__XXX
 SG_ SpprtVrblTrnsRpttnRtFrAcclrtnSns : 54|2@1+ (1,0) [0|3] "" Vector__XXX
 SG_ VrtclAcclrtnExRngeFigureOfMerit : 52|2@1+ (1,0) [0|3] "" Vector__XXX
 SG_ LngtdnlAcclrtnExRngFgureOfMerit : 50|2@1+ (1,0) [0|3] "" Vector__XXX
 SG_ LtrlAcclrtnExRangeFigureOfMerit : 48|2@1+ (1,0) [0|3] "" Vector__XXX
 SG_ VerticalAccelerationExRange : 32|16@1+ (0.01,-320) [-320|322.55] "m/s²" Vector__XXX
 SG_ LateralAccelerationExRange : 0|16@1+ (0.01,-320) [-320|322.55] "m/s²" Vector__XXX
 SG_ LongitudinalAccelerationExRange : 16|16@1+ (0.01,-320) [-320|322.55] "m/s²" Vector__XXX
 SG_ DropRelayCtrl : 36|2@1+ (1,0) [0|3] "" Vector__XXX
 SG_ LiftRelayCtrl : 34|2@1+ (1,0) [0|3] "" Vector__XXX
 SG_ MaterialDropActiveStatus : 32|2@1+ (1,0) [0|3] "" Vector__XXX
 SG_ MaterialLiftActiveStatus : 30|2@1+ (1,0) [0|3] "" Vector__XXX
 SG_ GnratorCurrentBoostActiveStatus : 28|2@1+ (1,0) [0|3] "" Vector__XXX
 SG_ MaterialDropSwitch : 26|2@1+ (1,0) [0|3] "" Vector__XXX
 SG_ MaterialLiftSwitch : 24|2@1+ (1,0) [0|3] "" Vector__XXX
 SG_ MagnetReverseCurrent : 16|8@1+ (1,0) [0|250] "A" Vector__XXX
 SG_ MagnetForwardCurrent : 0|16@1+ (1,0) [0|64255] "Amps" Vector__XXX
 SG_ CrashChecksum : 60|4@1+ (1,0) [0|15] "" Vector__XXX
 SG_ CrashCounter : 56|4@1+ (1,0) [0|15] "" Vector__XXX
 SG_ CrashType : 0|5@1+ (5,0) [0|0] "" Vector__XXX
 SG_ AngularRateMeasurementLatency : 56|8@1+ (0.5,0) [0|125] "ms" Vector__XXX
 SG_ YawRateExRangeFigureOfMerit : 52|2@1+ (1,0) [0|3] "" Vector__XXX
 SG_ RollRateExRangeFigureOfMerit : 50|2@1+ (1,0) [0|3] "" Vector__XXX
 SG_ PitchRateExRangeFigureOfMerit : 48|2@1+ (1,0) [0|3] "" Vector__XXX
 SG_ YawRateExRange : 32|16@1+ (0.0078125,-250) [-250|250.992] "deg/sec" Vector__XXX
 SG_ RollRateExRange : 16|16@1+ (0.0078125,-250) [-250|250.992] "deg/sec" Vector__XXX
 SG_ PitchRateExRange : 0|16@1+ (0.0078125,-250) [-250|250.992] "deg/sec" Vector__XXX
 SG_ RllAndPtchExRngMsurementLatency : 56|8@1+ (0.5,0) [0|125] "ms" Vector__XXX
 SG_ RollAngleExRangeFigureOfMerit : 54|2@1+ (1,0) [0|3] "" Vector__XXX
 SG_ RollAngleExRangeCompensation : 52|2@1+ (1,0) [0|3] "" Vector__XXX
 SG_ PitchAngleExRangeFigureOfMerit : 50|2@1+ (1,0) [0|3] "" Vector__XXX
 SG_ PitchAngleExRangeCompensation : 48|2@1+ (1,0) [0|3] "" Vector__XXX
 SG_ RollAngleExRange : 24|24@1+ (3.0517578125e-05,-250) [-250|250.9999] "deg" Vector__XXX
 SG_ PitchAngleExRange : 0|24@1+ (3.0517578125e-05,-250) [-250|250.9999] "deg" Vector__XXX
 SG_ Aftrtrtmnt2OtltNH3GsSnsrHtrCtrl : 40|2@1+ (1,0) [0|3] "" Vector__XXX
 SG_ Aftrtrtmnt2OtltNH3GsSnsrHtrPrlmn : 32|5@1+ (1,0) [0|31] "" Vector__XXX
 SG_ Aftrtrtmnt2OtltNH3GsSnsorAtTemp : 28|2@1+ (1,0) [0|3] "" Vector__XXX
 SG_ Aftrtrtmnt2OtltNH3GsSnsrPwrInRng : 26|2@1+ (1,0) [0|3] "" Vector__XXX
 SG_ Aftrtrtmnt2OtltNH3ReadingStable : 24|2@1+ (1,0) [0|3] "" Vector__XXX
 SG_ Aftrtrtmnt2OtltNH3SnsrPrlmnryFMI : 16|5@1+ (1,0) [0|31] "" Vector__XXX
 SG_ Aftertreatment2OutletNH3 : 0|16@1+ (0.3,0) [0|19276.5] "g/h" Vector__XXX
 SG_ Aftrtrtmnt2SCRRqdRgntQnttyFrIntg : 24|16@1+ (0.1,0) [0|6425.5] "g" Vector__XXX
 SG_ Aftrtratment2SCRSystemRqedState : 16|4@1+ (1,0) [0|15] "" Vector__XXX
 SG_ Aftrtrtmnt2SCRRqdDsngRgntQntity : 0|16@1+ (0.3,0) [0|19276.5] "g/h" Vector__XXX
 SG_ Aftrtrtmnt2SCRDsngRgentAbsPress : 40|8@1+ (8,0) [0|2000] "kPa" Vector__XXX
 SG_ Aftrtrtmnt2SCRActlRgntQnttyOfInt : 24|16@1+ (0.1,0) [0|6425.5] "g" Vector__XXX
 SG_ Aftertreatment2SCRSystemState : 16|4@1+ (1,0) [0|15] "" Vector__XXX
 SG_ Aftrtrtmnt2SCRActlDsngRgntQntty : 0|16@1+ (0.3,0) [0|19276.5] "g/h" Vector__XXX
 SG_ Aftrtrtmnt1OtltNH3GsSnsrHtrCtrl : 40|2@1+ (1,0) [0|3] "" Vector__XXX
 SG_ Aftrtrtmnt1OtltNH3GsSnsrHtrPrlmn : 32|5@1+ (1,0) [0|31] "" Vector__XXX
 SG_ Aftrtrtmnt1OtltNH3GsSnsorAtTemp : 28|2@1+ (1,0) [0|3] "" Vector__XXX
 SG_ Aftrtrtmnt1OtltNH3GsSnsrPwrInRng : 26|2@1+ (1,0) [0|3] "" Vector__XXX
 SG_ Aftrtrtmnt1OtltNH3ReadingStable : 24|2@1+ (1,0) [0|3] "" Vector__XXX
 SG_ Aftrtrtmnt1OtltNH3SnsrPrlmnryFMI : 16|5@1+ (1,0) [0|31] "" Vector__XXX
 SG_ Aftertreatment1OutletNH3 : 0|16@1+ (0.3,0) [0|19276.5] "g/h" Vector__XXX
 SG_ Aftrtrtmnt1SCRRqdRgntQnttyFrIntg : 24|16@1+ (0.1,0) [0|6425.5] "g" Vector__XXX
 SG_ Aftrtratment1SCRSystemRqedState : 16|4@1+ (1,0) [0|15] "" Vector__XXX
 SG_ Aftrtrtmnt1SCRRqdDsngRgntQntity : 0|16@1+ (0.3,0) [0|19276.5] "g/h" Vector__XXX
 SG_ Aftrtrtmnt1SCRDsngRgentAbsPress : 40|8@1+ (8,0) [0|2000] "kPa" Vector__XXX
 SG_ Aftrtrtmnt1SCRActlRgntQnttyOfInt : 24|16@1+ (0.1,0) [0|6425.5] "g" Vector__XXX
 SG_ Aftertreatment1SCRSystemState : 16|4@1+ (1,0) [0|15] "" Vector__XXX
 SG_ Aftrtrtmnt1SCRActlDsngRgntQntty : 0|16@1+ (0.3,0) [0|19276.5] "g/h" Vector__XXX
 SG_ EngSpdSnsor1TimingPatternStatus : 54|2@1+ (1,0) [0|3] "" Vector__XXX
 SG_ EngSpdSnsor2TimingPatternStatus : 52|2@1+ (1,0) [0|3] "" Vector__XXX
 SG_ EngSpdSnsor3TimingPatternStatus : 50|2@1+ (1,0) [0|3] "" Vector__XXX
 SG_ EngSpeed3 : 32|16@1+ (0.5,0) [0|32127.5] "rpm" Vector__XXX
 SG_ EngSpeed2 : 16|16@1+ (0.5,0) [0|32127.5] "rpm" Vector__XXX
 SG_ EngSpeed1 : 0|16@1+ (0.5,0) [0|32127.5] "rpm" Vector__XXX
 SG_ SteerAngleSensorCalibrated : 50|2@1+ (1,0) [0|3] "" Vector__XXX
 SG_ SteerAngleSensorActiveMode : 48|2@1+ (1,0) [0|3] "" Vector__XXX
 SG_ SteerWheelAngleRange : 32|16@1+ (0.0009765625,-31.374) [-31.374|31.374] "rad" Vector__XXX
 SG_ SteerWheelAngleRangeCounterType : 22|2@1+ (1,0) [0|3] "" Vector__XXX
 SG_ SteerWheelAngleRangeCounter : 16|6@1+ (1,-32) [-32|29] "ranges" Vector__XXX
 SG_ RqdGnrtrAvrgLneLineACRMSVoltage : 0|32@1+ (0.0078125,0) [0|32899071] "V" Vector__XXX
 SG_ EngThrottleActuator2CtrlCmd : 16|16@1+ (0.0025,0) [0|160.6375] "%" Vector__XXX
 SG_ EngThrottleActuator1CtrlCmd : 0|16@1+ (0.0025,0) [0|160.6375] "%" Vector__XXX
 SG_ EngFuelActuator2CtrlCmd : 48|16@1+ (0.0025,0) [0|160.6375] "%" Vector__XXX
 SG_ EngFuelActuator1CtrlCmd : 32|16@1+ (0.0025,0) [0|160.6375] "%" Vector__XXX
 SG_ EngCyl24KnockLevel : 56|8@1+ (1,0) [0|250] "%" Vector__XXX
 SG_ EngCyl23KnockLevel : 48|8@1+ (1,0) [0|250] "%" Vector__XXX
 SG_ EngCyl22KnockLevel : 40|8@1+ (1,0) [0|250] "%" Vector__XXX
 SG_ EngCyl21KnockLevel : 32|8@1+ (1,0) [0|250] "%" Vector__XXX
 SG_ EngCyl20KnockLevel : 24|8@1+ (1,0) [0|250] "%" Vector__XXX
 SG_ EngCyl19KnockLevel : 16|8@1+ (1,0) [0|250] "%" Vector__XXX
 SG_ EngCyl18KnockLevel : 8|8@1+ (1,0) [0|250] "%" Vector__XXX
 SG_ EngCyl17KnockLevel : 0|8@1+ (1,0) [0|250] "%" Vector__XXX
 SG_ EngCyl15KnockLevel : 48|8@1+ (1,0) [0|250] "%" Vector__XXX
 SG_ EngCyl14KnockLevel : 40|8@1+ (1,0) [0|250] "%" Vector__XXX
 SG_ EngCyl13KnockLevel : 32|8@1+ (1,0) [0|250] "%" Vector__XXX
 SG_ EngCyl12KnockLevel : 24|8@1+ (1,0) [0|250] "%" Vector__XXX
 SG_ EngCyl11KnockLevel : 16|8@1+ (1,0) [0|250] "%" Vector__XXX
 SG_ EngCyl10KnockLevel : 8|8@1+ (1,0) [0|250] "%" Vector__XXX
 SG_ EngCyl9KnockLevel : 0|8@1+ (1,0) [0|250] "%" Vector__XXX
 SG_ EngCyl16KnockLevel : 56|8@1+ (1,0) [0|250] "%" Vector__XXX
 SG_ EngCyl8KnockLevel : 56|8@1+ (1,0) [0|250] "%" Vector__XXX
 SG_ EngCyl7KnockLevel : 48|8@1+ (1,0) [0|250] "%" Vector__XXX
 SG_ EngCyl6KnockLevel : 40|8@1+ (1,0) [0|250] "%" Vector__XXX
 SG_ EngCyl5KnockLevel : 32|8@1+ (1,0) [0|250] "%" Vector__XXX
 SG_ EngCyl4KnockLevel : 24|8@1+ (1,0) [0|250] "%" Vector__XXX
 SG_ EngCyl3KnockLevel : 16|8@1+ (1,0) [0|250] "%" Vector__XXX
 SG_ EngCyl2KnockLevel : 8|8@1+ (1,0) [0|250] "%" Vector__XXX
 SG_ EngCyl1KnockLevel : 0|8@1+ (1,0) [0|250] "%" Vector__XXX
 SG_ EngCyl9CombustionStatus : 16|2@1+ (1,0) [0|3] "" Vector__XXX
 SG_ EngCyl8CombustionStatus : 14|2@1+ (1,0) [0|3] "" Vector__XXX
 SG_ EngCyl7CombustionStatus : 12|2@1+ (1,0) [0|3] "" Vector__XXX
 SG_ EngCyl6CombustionStatus : 10|2@1+ (1,0) [0|3] "" Vector__XXX
 SG_ EngCyl5CombustionStatus : 8|2@1+ (1,0) [0|3] "" Vector__XXX
 SG_ EngCyl4CombustionStatus : 6|2@1+ (1,0) [0|3] "" Vector__XXX
 SG_ EngCyl3CombustionStatus : 4|2@1+ (1,0) [0|3] "" Vector__XXX
 SG_ EngCyl2CombustionStatus : 2|2@1+ (1,0) [0|3] "" Vector__XXX
 SG_ EngCyl24CombustionStatus : 46|2@1+ (1,0) [0|3] "" Vector__XXX
 SG_ EngCyl23CombustionStatus : 44|2@1+ (1,0) [0|3] "" Vector__XXX
 SG_ EngCyl22CombustionStatus : 42|2@1+ (1,0) [0|3] "" Vector__XXX
 SG_ EngCyl21CombustionStatus : 40|2@1+ (1,0) [0|3] "" Vector__XXX
 SG_ EngCyl20CombustionStatus : 38|2@1+ (1,0) [0|3] "" Vector__XXX
 SG_ EngCyl1CombustionStatus : 0|2@1+ (1,0) [0|3] "" Vector__XXX
 SG_ EngCyl19CombustionStatus : 36|2@1+ (1,0) [0|3] "" Vector__XXX
 SG_ EngCyl18CombustionStatus : 34|2@1+ (1,0) [0|3] "" Vector__XXX
 SG_ EngCyl17CombustionStatus : 32|2@1+ (1,0) [0|3] "" Vector__XXX
 SG_ EngCyl16CombustionStatus : 30|2@1+ (1,0) [0|3] "" Vector__XXX
 SG_ EngCyl15CombustionStatus : 28|2@1+ (1,0) [0|3] "" Vector__XXX
 SG_ EngCyl14CombustionStatus : 26|2@1+ (1,0) [0|3] "" Vector__XXX
 SG_ EngCyl13CombustionStatus : 24|2@1+ (1,0) [0|3] "" Vector__XXX
 SG_ EngCyl12CombustionStatus : 22|2@1+ (1,0) [0|3] "" Vector__XXX
 SG_ EngCyl11CombustionStatus : 20|2@1+ (1,0) [0|3] "" Vector__XXX
 SG_ EngCyl10CombustionStatus : 18|2@1+ (1,0) [0|3] "" Vector__XXX
 SG_ RqGenOverallPowerFactorLagging : 48|2@1+ (1,0) [0|4] "" Vector__XXX
 SG_ RqGeneratorOverallPowerFactor : 32|16@1+ (6.103515625e-05,-1) [-1|2.921814] "" Vector__XXX
 SG_ RqGeneratorTotalACReactivePower : 0|32@1+ (1,-2000000000) [-2000000000|2000000000] "VA" Vector__XXX
 SG_ RltvBldHghtAndBldRttnAnglMsrmntL : 32|8@1+ (0.5,0) [0|125] "ms" Vector__XXX
 SG_ RlativeBladeHeightFigureOfMerit : 40|2@1+ (1,0) [0|3] "" Vector__XXX
 SG_ BladeRotationAngleFigureOfMerit : 42|2@1+ (1,0) [0|3] "" Vector__XXX
 SG_ BladeRotationAngle : 16|16@1+ (0.0078125,-200) [-200|301.99] "deg" Vector__XXX
 SG_ RelativeBladeHeight : 0|16@1+ (0.1,-3200) [-3200|3225.5] "mm" Vector__XXX
 SG_ RollAndPitchMeasurementLatency : 56|8@1+ (0.5,0) [0|125] "ms" Vector__XXX
 SG_ PitchAndRollCompensated : 54|2@1+ (1,0) [0|3] "" Vector__XXX
 SG_ PitchRateFigureOfMerit : 52|2@1+ (1,0) [0|3] "" Vector__XXX
 SG_ RollAngleFigureOfMerit : 50|2@1+ (1,0) [0|3] "" Vector__XXX
 SG_ PitchAngleFigureOfMerit : 48|2@1+ (1,0) [0|3] "" Vector__XXX
 SG_ PitchRate : 32|16@1+ (0.002,-64) [-64|64.51] "deg/sec" Vector__XXX
 SG_ RollAngle : 16|16@1+ (0.002,-64) [-64|64.51] "deg" Vector__XXX
 SG_ PitchAngle : 0|16@1+ (0.002,-64) [-64|64.51] "deg" Vector__XXX
 SG_ FifthWheelRollWarningIndicator : 48|2@1+ (1,0) [0|3] "" Vector__XXX
 SG_ FifthWheelRollMoment : 32|16@1+ (10,-320000) [-320000|322550] "N" Vector__XXX
 SG_ FifthWheelDrawbarForce : 16|16@1+ (10,-320000) [-320000|322550] "N" Vector__XXX
 SG_ FifthWheelVerticalForce : 0|16@1+ (5,0) [0|321275] "N" Vector__XXX
 SG_ Aftrtrtmnt2OtltOxygnSnsrPrlmnryF : 56|5@1+ (1,0) [0|31] "" Vector__XXX
 SG_ Aftrtrtmnt2OtltGsSnsrPwerStatus : 32|2@1+ (1,0) [0|3] "" Vector__XXX
 SG_ Aftrtrtmnt2OtltGsSnsrHtrPrlmnryF : 40|5@1+ (1,0) [0|31] "" Vector__XXX
 SG_ Aftrtrtmnt2OtltNOxSnsrPrlmnryFMI : 48|5@1+ (1,0) [0|31] "" Vector__XXX
 SG_ Aftrtrtmnt2OtltGsSnsrHeaterCtrl : 45|2@1+ (1,0) [0|3] "" Vector__XXX
 SG_ Aftrtrtmnt2OtltWdRngO2RdngStble : 38|2@1+ (1,0) [0|3] "" Vector__XXX
 SG_ Aftrtrtmnt2OtltNOxReadingStable : 36|2@1+ (1,0) [0|3] "" Vector__XXX
 SG_ Aftrtrtmnt2OtletGasSensorAtTemp : 34|2@1+ (1,0) [0|3] "" Vector__XXX
 SG_ Aftertreatment2OutletO2 : 16|16@1+ (0.000514,-12) [-12|21] "%" Vector__XXX
 SG_ Aftertreatment2OutletNOx : 0|16@1+ (0.05,-200) [-200|3012.75] "ppm" Vector__XXX
 SG_ Aftrtrtmnt2IntkOxygnSnsrPrlmnryF : 56|5@1+ (1,0) [0|31] "" Vector__XXX
 SG_ Aftrtrtmnt2IntkGsSnsrPwerStatus : 32|2@1+ (1,0) [0|3] "" Vector__XXX
 SG_ Aftrtrtmnt2IntkGsSnsrHtrPrlmnryF : 40|5@1+ (1,0) [0|31] "" Vector__XXX
 SG_ Aftrtrtmnt2IntkNOxSnsrPrlmnryFMI : 48|5@1+ (1,0) [0|31] "" Vector__XXX
 SG_ Aftrtrtmnt2IntkGsSnsrHeaterCtrl : 45|2@1+ (1,0) [0|3] "" Vector__XXX
 SG_ Aftrtrtmnt2IntkWdRngO2RdngStble : 38|2@1+ (1,0) [0|3] "" Vector__XXX
 SG_ Aftrtrtmnt2IntkNOxReadingStable : 36|2@1+ (1,0) [0|3] "" Vector__XXX
 SG_ Aftrtrtmnt2IntkeGasSensorAtTemp : 34|2@1+ (1,0) [0|3] "" Vector__XXX
 SG_ Aftertreatment2IntakeO2 : 16|16@1+ (0.000514,-12) [-12|21] "%" Vector__XXX
 SG_ Aftertreatment2IntakeNOx : 0|16@1+ (0.05,-200) [-200|3012.75] "ppm" Vector__XXX
 SG_ Aftrtrtmnt1OtltOxygnSnsrPrlmnryF : 56|5@1+ (1,0) [0|31] "" Vector__XXX
 SG_ Aftrtrtmnt1OtltGsSnsrPwerStatus : 32|2@1+ (1,0) [0|3] "" Vector__XXX
 SG_ Aftrtrtmnt1OtltGsSnsrHtrPrlmnryF : 40|5@1+ (1,0) [0|31] "" Vector__XXX
 SG_ Aftrtrtmnt1OtltNOxSnsrPrlmnryFMI : 48|5@1+ (1,0) [0|31] "" Vector__XXX
 SG_ Aftrtrtmnt1OtltGsSnsrHeaterCtrl : 45|2@1+ (1,0) [0|3] "" Vector__XXX
 SG_ Aftrtrtmnt1OtltWdRngO2RdngStble : 38|2@1+ (1,0) [0|3] "" Vector__XXX
 SG_ Aftrtrtmnt1OtltNOxReadingStable : 36|2@1+ (1,0) [0|3] "" Vector__XXX
 SG_ Aftrtrtmnt1OtletGasSensorAtTemp : 34|2@1+ (1,0) [0|3] "" Vector__XXX
 SG_ Aftertreatment1OutletO2 : 16|16@1+ (0.000514,-12) [-12|21] "%" Vector__XXX
 SG_ Aftertreatment1OutletNOx : 0|16@1+ (0.05,-200) [-200|3012.75] "ppm" Vector__XXX
 SG_ Aftrtrtmnt1IntkOxygnSnsrPrlmnryF : 56|5@1+ (1,0) [0|31] "" Vector__XXX
 SG_ Aftrtrtmnt1IntkGsSnsrPwerStatus : 32|2@1+ (1,0) [0|3] "" Vector__XXX
 SG_ Aftrtrtmnt1IntkGsSnsrHtrPrlmnryF : 40|5@1+ (1,0) [0|31] "" Vector__XXX
 SG_ Aftrtrtmnt1IntkNOxSnsrPrlmnryFMI : 48|5@1+ (1,0) [0|31] "" Vector__XXX
 SG_ Aftrtrtmnt1IntkGsSnsrHeaterCtrl : 45|2@1+ (1,0) [0|3] "" Vector__XXX
 SG_ Aftrtrtmnt1IntkWdRngO2RdngStble : 38|2@1+ (1,0) [0|3] "" Vector__XXX
 SG_ Aftrtrtmnt1IntkNOxReadingStable : 36|2@1+ (1,0) [0|3] "" Vector__XXX
 SG_ Aftrtrtmnt1IntkeGasSensorAtTemp : 34|2@1+ (1,0) [0|3] "" Vector__XXX
 SG_ Aftertreatment1IntakeO2 : 16|16@1+ (0.000514,-12) [-12|21] "%" Vector__XXX
 SG_ Aftertreatment1IntakeNOx : 0|16@1+ (0.05,-200) [-200|3012.75] "ppm" Vector__XXX
 SG_ SdshftDsrdBldOffsetOperatorCtrl : 32|4@1+ (1,0) [0|15] "" Vector__XXX
 SG_ SdshftBldCtrlMdeOperatorControl : 28|4@1+ (1,0) [0|15] "" Vector__XXX
 SG_ RghtDsrdBladeOffsetOperatorCtrl : 24|4@1+ (1,0) [0|15] "" Vector__XXX
 SG_ RghtBldeCtrlModeOperatorControl : 16|4@1+ (1,0) [0|15] "" Vector__XXX
 SG_ LftDsredBladeOffsetOperatorCtrl : 20|4@1+ (1,0) [0|15] "" Vector__XXX
 SG_ LftBladeCtrlModeOperatorControl : 12|4@1+ (1,0) [0|15] "" Vector__XXX
 SG_ BladeAutoModeCmd : 8|4@1+ (1,0) [0|15] "" Vector__XXX
 SG_ DesiredGradeOffsetSwitch : 4|4@1+ (1,0) [0|15] "" Vector__XXX
 SG_ BladeCtrlModeSwitch : 0|4@1+ (1,0) [0|15] "" Vector__XXX
 SG_ StElvtnSnsor2ReferenceElevation : 38|2@1+ (1,0) [0|3] "" Vector__XXX
 SG_ StElvtnSnsor1ReferenceElevation : 36|2@1+ (1,0) [0|3] "" Vector__XXX
 SG_ TransClutch_ConverterInputSpeed : 16|16@1+ (0.125,0) [0|8031.875] "rpm" Vector__XXX
 SG_ TransTorqueConverterRatio : 0|16@1+ (0.001,0) [0|64.255] "" Vector__XXX
 SG_ SterableLiftAxleLoweringInhibit : 28|2@1+ (1,0) [0|3] "" Vector__XXX
 SG_ AxleLocation : 16|8@1+ (1,0) [0|255] "" Vector__XXX
 SG_ TypeOfSteerTrans : 40|4@1+ (1,0) [0|15] "" Vector__XXX
 SG_ TypeOfSteerForces : 36|4@1+ (1,0) [0|15] "" Vector__XXX
 SG_ SteerType : 32|4@1+ (1,0) [0|15] "" Vector__XXX
 SG_ StatusOfSteerAxle : 24|4@1+ (1,0) [0|15] "" Vector__XXX
 SG_ ActualInnerWheelSteerAngle : 0|16@1+ (0.00390625,-125) [-125|125] "deg" Vector__XXX
 SG_ Aftrtrtmnt2DslPrtcltFltrIntkGsTm : 40|5@1+ (1,0) [0|31] "" Vector__XXX
 SG_ Aftrtrtmnt2ExhstGsTmp1PrlmnryFMI : 32|5@1+ (1,0) [0|31] "" Vector__XXX
 SG_ Aftertreatment2ExhaustGasTemp1 : 0|16@1+ (0.03125,-273) [-273|1734.96875] "deg C" Vector__XXX
 SG_ AxleLocation M : 0|8@1+ (1,0) [0|255] "" Vector__XXX

CM_ SG_ 3221225472 Aftrtrtmnt2FlFlwDvrterValveCtrl "Indicates how the device is controlling the aftertreatment 2 fuel flow diverter valve.";
CM_ SG_ 3221225472 Aftrtreatment2FuelPumpRelayCtrl "Indicates how the device is controlling the aftertreatment 2 fuel pump relay.";
CM_ SG_ 3221225472 Aftertreatment2FuelPress2 "Second fuel pressure measurement for the aftertreatment 2 system.";
CM_ SG_ 3221225472 Aftrtrtmnt1SCRCtlystRgntLnHtr4Pr "Used to identify the applicable J1939-73 FMI detected in the SCR catalyst reagent line heater 4, by the manufacturer's";
CM_ SG_ 3221225472 Aftrtrtmnt1SCRCtlystRgntLnHtr4St "The SCR catalyst reagent line heater 4 state for aftertreatment system 1 (exhaust bank 1).";
CM_ SG_ 3221225472 Aftrtrtmnt1SCRCtlystRgntLnHtr3Pr "Used to identify the applicable J1939-73 FMI detected in the SCR catalyst reagent line heater 3, by the manufacturer's";
CM_ SG_ 3221225472 Aftrtrtmnt1SCRCtlystRgntLnHtr3St "The SCR catalyst reagent line heater 3 state for aftertreatment system 1 (exhaust bank 1).";
CM_ SG_ 3221225472 Aftrtrtmnt1SCRCtlystRgntLnHtr2Pr "Used to identify the applicable J1939-73 FMI detected in the SCR catalyst reagent line heater 2, by the manufacturer's";
CM_ SG_ 3221225472 Aftrtrtmnt1SCRCtlystRgntLnHtr2St "The SCR catalyst reagent line heater 2 state for aftertreatment system 1 (exhaust bank 1).";
CM_ SG_ 3221225472 Aftrtrtmnt1SCRCtlystRgntLnHtr1Pr "Used to identify the applicable J1939-73 FMI detected in the SCR catalyst reagent line heater 1, by the manufacturer's";
CM_ SG_ 3221225472 Aftrtrtmnt1SCRCtlystRgntLnHtr1St "The SCR catalyst reagent line heater 1 state for aftertreatment system 1 (exhaust bank 1).";
CM_ SG_ 3221225472 Aftrtrtmnt1SCRFedbackCtrlStatus "The SCR feedback control status (open/closed loop) for aftertreatment system 1 (exhaust bank 1).";
CM_ SG_ 3221225472 Aftrtrtmnt1SCRDsngVlvExhstTmpRdc "Protection request for the dosing valve of the SCR-system to prevent overheating";
CM_ SG_ 3221225472 Aftrtrtmnt1SCRDosingReagentTemp "The SCR dosing reagent temperature (measured closest to dosing valve) for aftertreatment system 1 (exhaust bank 1).";
CM_ SG_ 3221225472 Aftrtrtmnt1SCRDsngArAssistValve "The position of the valve used to regulate the air supply of an air assist SCR dosing system for an engine.";
CM_ SG_ 3221225472 Aftrtrtmnt1SCRDsngArAssstAbsPrss "The SCR dosing system air assist absolute pressure for aftertreatment system 1 (exhaust bank 1).";
CM_ SG_ 3221225472 Aftrtrtmnt1SCRCtlystTnk2HterCmd "This is the command for the Aftertreatment 1 SCR Catalyst Tank 2 Heater.";
CM_ SG_ 3221225472 Aftrtrtmnt1SCRCtlystTnkHaterCmd "Command for the Aftertreatment 1 SCR Catalyst Tank Heater.";
CM_ SG_ 3221225472 Aftrtrtmnt1SCRCtlystRgntLnHter4 "The SCR catalyst reagent line heater 4 request for aftertreatment system 1 (exhaust bank 1).";
CM_ SG_ 3221225472 Aftrtrtmnt1SCRCtlystRgntLnHter3 "The SCR catalyst reagent line heater 3 request for aftertreatment system 1 (exhaust bank 1).";
CM_ SG_ 3221225472 Aftrtrtmnt1SCRCtlystRgntLnHter2 "The SCR catalyst reagent line heater 2 request for aftertreatment system 1 (exhaust bank 1).";
CM_ SG_ 3221225472 Aftrtrtmnt1SCRCtlystRgntLnHter1 "The SCR catalyst reagent line heater 1 request for aftertreatment system 1 (exhaust bank 1).";
CM_ SG_ 3221225472 Aftrtrtmnt1SCRDserHeatingModeRq "Used if multiple heater modes are available in the Doser.";
CM_ SG_ 3221225472 Aftrtrtmnt1SCRDsrFltSpprssionRq "Used if external devices can warn of conditions that require suppression of potential faults in the doser due to";
CM_ SG_ 3221225472 Aftrtrtmnt1SCRCtlystExhstGsDffPr "Used to identify the applicable J1939-73 FMI detected in the SCR catalyst differential pressure sensor by the";
CM_ SG_ 3221225472 Aftrtrtmnt1SCRCtlystExhstGs_0000 "Exhaust differential pressure measured between the intake and exhaust of a SCR catalyst in exhaust bank 1.";
CM_ SG_ 3221225472 Aftrtrtmnt1SCRCtlystOtltGsTmpPrl "Used to identify the applicable J1939-73 FMI detected in the SCR catalyst outlet gas temperature sensor by the";
CM_ SG_ 3221225472 Aftrtrtmnt1SCRCtlystOtltGasTemp "Temperature of engine combustion byproducts leaving the SCR catalyst exhaust in exhaust bank 1.";
CM_ SG_ 3221225472 Aftrtrtmnt1SCRCtlystIntkGsTmpPrl "Used to identify the applicable J1939-73 FMI detected in the SCR catalyst intake gas temperature sensor by the";
CM_ SG_ 3221225472 Aftrtrtmnt1SCRCtlystIntkGasTemp "Temperature of engine combustion byproducts entering the SCR catalyst in exhaust bank 1.";
CM_ SG_ 3221225472 Aftrtrtmnt1SCRCtlystRgntTnk2HtrP "Used to identify the applicable J1939-73 FMI detected in the SCR catalyst reagent tank 2 heater, by the manufacturer's";
CM_ SG_ 3221225472 Aftrtrtmnt1SCRCtlystRgntTnk2Htr "The SCR catalyst reagent tank 2 heater percentage for aftertreatment system 1 (exhaust bank 1).";
CM_ SG_ 3221225472 Aftrtrtmnt1SCRRgntTnk2TmpPrlmnry "Used to identify the applicable J1939-73 FMI detected in the SCR catalyst reagent tank 2 temperature, by the";
CM_ SG_ 3221225472 Aftrtrtmnt1SCRCtlystRgntTnk2LvlP "Used to identify the applicable J1939-73 FMI detected in the SCR catalyst reagent tank 2 level, by the manufacturer's";
CM_ SG_ 3221225472 Aftrtrtmnt1SCRCtlystRgntTnk2Lvl2 "The SCR catalyst reagent tank 2 level height in mm for aftertreatment system 1 (exhaust bank 1).";
CM_ SG_ 3221225472 Aftrtrtmnt1SCRCtlystRgntTnk2Tmp "The SCR catalyst reagent tank 2 temperature for aftertreatment system 1 (exhaust bank 1).";
CM_ SG_ 3221225472 Aftrtrtmnt1SCRCtlystRgntTnk2Lvl "The SCR catalyst reagent tank 2 level percentage for aftertreatment system 1 (exhaust bank 1).";
CM_ SG_ 3221225472 Aftrtrtmnt1SCRCtlystRgntTnkDrnVl "Commanded percentage of maximum Aftertreatment 1 SCR Catalyst Reagent Tank Drain Valve opening.";
CM_ SG_ 3221225472 Aftrtrtmnt1SCRCtlystRgntPmpStte "State of aftertreatment 1 SCR Catalyst Reagent dosing pump.";
CM_ SG_ 3221225472 Aftrtrtmnt1SCRCtlystRgntTnkFllVl "Commanded percentage of maximum Aftertreatment 1 SCR Catalyst Reagent Tank Fill Valve opening.";
CM_ SG_ 3221225472 Aftrtrtmnt1SCRCtlystRgntRtrnVlv "Command to the valve which determines whether the reagent is delivered to the injector or is routed back to the reagent";
CM_ SG_ 3221225472 Aftrtrtmnt1SCRCtlystRgntPmpDrvPr "The percent (command) sent to the motor to control the speed of the reagent pump.";
CM_ SG_ 3221225472 Aftrtrtmnt1SCRCtlystRgntPmpMtrSp "Rotational speed of the motor driving a pump for reagent used in an aftertreatment system.";
CM_ SG_ 3221225472 Aftrtrtmnt2SCRCtlystRgntLnHtr4Pr "Used to identify the applicable J1939-73 FMI detected in the SCR catalyst reagent line heater 4, by the manufacturer's";
CM_ SG_ 3221225472 Aftrtrtmnt2SCRCtlystRgntLnHtr4St "The SCR catalyst reagent line heater 4 state for aftertreatment system 2 (exhaust bank 2).";
CM_ SG_ 3221225472 Aftrtrtmnt2SCRCtlystRgntLnHtr3Pr "Used to identify the applicable J1939-73 FMI detected in the SCR catalyst reagent line heater 3, by the manufacturer's";
CM_ SG_ 3221225472 Aftrtrtmnt2SCRCtlystRgntLnHtr3St "The SCR catalyst reagent line heater 3 state for aftertreatment system 2 (exhaust bank 2).";
CM_ SG_ 3221225472 Aftrtrtmnt2SCRCtlystRgntLnHtr2Pr "Used to identify the applicable J1939-73 FMI detected in the SCR catalyst reagent line heater 2, by the manufacturer's";
CM_ SG_ 3221225472 Aftrtrtmnt2SCRCtlystRgntLnHtr2St "The SCR catalyst reagent line heater 2 state for aftertreatment system 2 (exhaust bank 2).";
CM_ SG_ 3221225472 Aftrtrtmnt2SCRCtlystRgntLnHtr1Pr "Used to identify the applicable J1939-73 FMI detected in the SCR catalyst reagent line heater 1, by the manufacturer's";
CM_ SG_ 3221225472 Aftrtrtmnt2SCRCtlystRgntLnHtr1St "The SCR catalyst reagent line heater 1 state for aftertreatment system 2 (exhaust bank 2).";
CM_ SG_ 3221225472 Aftrtrtmnt2SCRFedbackCtrlStatus "The SCR feedback control status (open/closed loop) for aftertreatment system 2 (exhaust bank 2).";
CM_ SG_ 3221225472 Aftrtrtmnt2SCRDsngVlvExhstTmpRdc "Protection request for the dosing valve of the SCR-system to prevent overheating";
CM_ SG_ 3221225472 Aftrtrtmnt2SCRDosingReagentTemp "The SCR dosing reagent temperature (measured closest to dosing valve) for aftertreatment system 2 (exhaust bank 2).";
CM_ SG_ 3221225472 Aftrtrtmnt2SCRDsngArAssistValve "The position of the valve used to regulate the air supply of an air assist SCR dosing system for an engine.";
CM_ SG_ 3221225472 Aftrtrtmnt2SCRDsngArAssstAbsPrss "The SCR dosing system air assist absolute pressure for aftertreatment system 2 (exhaust bank 2).";
CM_ SG_ 3221225472 Aftrtrtmnt2SCRCtlystTnk2HterCmd "This is the command for the Aftertreatment 2 SCR Catalyst Tank 2 Heater.";
CM_ SG_ 3221225472 Aftrtrtmnt2SCRCtlystTnkHaterCmd "Command for the Aftertreatment 2 SCR Catalyst Tank Heater.";
CM_ SG_ 3221225472 Aftrtrtmnt2SCRCtlystRgntLnHter4 "The SCR catalyst reagent line heater 4 request for aftertreatment system 2 (exhaust bank 2).";
CM_ SG_ 3221225472 Aftrtrtmnt2SCRCtlystRgntLnHter3 "The SCR catalyst reagent line heater 3 request for aftertreatment system 2 (exhaust bank 2).";
CM_ SG_ 3221225472 Aftrtrtmnt2SCRCtlystRgntLnHter2 "The SCR catalyst reagent line heater 2 request for aftertreatment system 2 (exhaust bank 2).";
CM_ SG_ 3221225472 Aftrtrtmnt2SCRCtlystRgntLnHter1 "The SCR catalyst reagent line heater 1 request for aftertreatment system 2 (exhaust bank 2).";
CM_ SG_ 3221225472 Aftrtrtmnt2SCRDserHeatingModeRq "Used if multiple heater modes are available in the Doser.";
CM_ SG_ 3221225472 Aftrtrtmnt2SCRDsrFltSpprssionRq "Used if external devices can warn of conditions that require suppression of potential faults in the doser due to";
CM_ SG_ 3221225472 Aftrtrtmnt2SCRCtlystExhstGsDffPr "Used to identify the applicable J1939-73 FMI detected in the SCR catalyst differential pressure sensor by the";
CM_ SG_ 3221225472 Aftrtrtmnt2SCRCtlystExhstGs_0000 "Exhaust differential pressure measured between the intake and exhaust of a SCR catalyst in exhaust bank 2.";
CM_ SG_ 3221225472 Aftrtrtmnt2SCRCtlystOtltGsTmpPrl "Used to identify the applicable J1939-73 FMI detected in the SCR catalyst outlet gas temperature sensor by the";
CM_ SG_ 3221225472 Aftrtrtmnt2SCRCtlystOtltGasTemp "Temperature of engine combustion byproducts leaving the SCR catalyst exhaust in exhaust bank 2.";
CM_ SG_ 3221225472 Aftrtrtmnt2SCRCtlystIntkGsTmpPrl "Used to identify the applicable J1939-73 FMI detected in the SCR catalyst intake gas temperature sensor by the";
CM_ SG_ 3221225472 Aftrtrtmnt2SCRCtlystIntkGasTemp "Temperature of engine combustion byproducts entering the SCR catalyst in exhaust bank 2.";
CM_ SG_ 3221225472 Aftrtrtmnt2SCRCtlystCnvrsnEffcnc "The SCR catalyst conversion efficiency percentage.";
CM_ SG_ 3221225472 Aftrtrtmnt2SCRCmddCtlystRgntCnsm "This parameter transmits the amount of reagent that the emissions control system has requested to be used, averaged";
CM_ SG_ 3221225472 Aftrtrtmnt2SCRAvrgCtlystRgntCnsm "Measured use of reagent by a Selective Catalytic Reduction system for exhaust emission control, averaged over the";
CM_ SG_ 3221225472 Aftrtrtmnt2SCRCtlystReagentType "This parameter indicates what reagent is in the tank.";
CM_ SG_ 3221225472 Aftrtrtmnt2SCRCtlystRgntPrprtsPr "Used to identify the applicable J1939-73 FMI that applies to the most significant failure of the catalyst reagent properties";
CM_ SG_ 3221225472 Aftrtrtmnt2SCRCtlystRgntTmp2Prlm "Used to identify the applicable J1939-73 FMI that applies to the most significant failure of the catalyst temperature sensor.";
CM_ SG_ 3221225472 Aftrtrtmnt2SCRCtlystRgntCndctvty "A measure of the conductivity of the reagent or fluid at the sensor.";
CM_ SG_ 3221225472 Aftrtrtmnt2SCRCtlystRgntCncntrtn "A measure of the concentration of urea in water.";
CM_ SG_ 3221225472 Aftrtrtmnt2SCRCtlystRagentTemp2 "Temperature of the catalyst reagent at the device measuring reagent quality";
CM_ SG_ 3221225472 Aftrtrtmnt2SCRCtlystRgntTnk1HtrP "Used to identify the applicable J1939-73 FMI detected in the SCR catalyst reagent tank 1 heater, by the manufacturer's";
CM_ SG_ 3221225472 Aftrtrtmnt2SCRCtalystTankHeater "Percentage of heating applied to the aftertreatment 2 catalyst tank heater.";
CM_ SG_ 3221225472 Aftrtrtmnt2SCRCtlystRgntTnk1TmpP "Used to identify the applicable J1939-73 FMI detected in the SCR catalyst reagent tank 1 temperature, by the";
CM_ SG_ 3221225472 Aftrtrtmnt2SCRCtlystTnkLvlPrlmnr "Used to identify the applicable J1939-73 FMI that applies to the most significant failure of the catalyst tank level sensor.";
CM_ SG_ 3221225472 Aftrtrtmnt2SCRCtalystTankLevel2 "The measure of the reagent level in the catalyst tank.";
CM_ SG_ 3221225472 Aftrtrtment2SCRCatalystTankTemp "Temperature of the reagent in the storage tank.";
CM_ SG_ 3221225472 Aftrtrtmnt2SCRCatalystTankLevel "A special catalyst uses chemical substance to reach legal requirement for NOX emissions.";
CM_ SG_ 3221225472 Aftrtrtmnt2SCRCtlystRgntTnk2HtrP "Used to identify the applicable J1939-73 FMI detected in the SCR catalyst reagent tank 2 heater, by the manufacturer's";
CM_ SG_ 3221225472 Aftrtrtmnt2SCRCtlystRgntTnk2Htr "The SCR catalyst reagent tank 2 heater percentage for aftertreatment system 1 (exhaust bank 1).";
CM_ SG_ 3221225472 Aftrtrtmnt2SCRRgntTnk2TmpPrlmnry "Used to identify the applicable J1939-73 FMI detected in the SCR catalyst reagent tank 2 temperature, by the";
CM_ SG_ 3221225472 Aftrtrtmnt2SCRCtlystRgntTnk2LvlP "Used to identify the applicable J1939-73 FMI detected in the SCR catalyst reagent tank 2 level, by the manufacturer's";
CM_ SG_ 3221225472 Aftrtrtmnt2SCRCtlystRgntTnk2Lvl2 "The SCR catalyst reagent tank 2 level height in mm for aftertreatment system 2 (exhaust bank 2).";
CM_ SG_ 3221225472 Aftrtrtmnt2SCRCtlystRgntTnk2Tmp "The SCR catalyst reagent tank 2 temperature for aftertreatment system 2 (exhaust bank 2).";
CM_ SG_ 3221225472 Aftrtrtmnt2SCRCtlystRgntTnk2Lvl "The SCR catalyst reagent tank 2 level percentage for aftertreatment system 2 (exhaust bank 2).";
CM_ SG_ 3221225472 Aftrtrtmnt2SCRCtlystRgntTnkDrnVl "Commanded percentage of maximum Aftertreatment 2 SCR Catalyst Reagent Tank Drain Valve opening.";
CM_ SG_ 3221225472 Aftrtrtmnt2SCRCtlystRgntPmpStte "State of aftertreatment 2 SCR Catalyst Reagent dosing pump.";
CM_ SG_ 3221225472 Aftrtrtmnt2SCRCtlystRgntTnkFllVl "Commanded percentage of maximum Aftertreatment 2 SCR Catalyst Reagent Tank Fill Valve opening.";
CM_ SG_ 3221225472 Aftrtrtmnt2SCRCtlystRgntRtrnVlv "Command to the valve which determines whether the reagent is delivered to the injector or is routed back to the reagent";
CM_ SG_ 3221225472 Aftrtrtmnt2SCRCtlystRgntPmpDrvPr "The percent (command) sent to the motor to control the speed of the reagent pump.";
CM_ SG_ 3221225472 Aftrtrtmnt2SCRCtlystRgntPmpMtrSp "Rotational speed of the motor driving a pump for reagent used in an aftertreatment system.";
CM_ SG_ 3221225472 Joystick4Button9PressedStatus "Reports when the joystick button has been pressed.";
CM_ SG_ 3221225472 Joystick4Button10PressedStatus "Reports when the joystick button has been pressed.";
CM_ SG_ 3221225472 Joystick4Button11PressedStatus "Reports when the joystick button has been pressed.";
CM_ SG_ 3221225472 Joystick4Button12PressedStatus "Reports when the joystick button has been pressed.";
CM_ SG_ 3221225472 Joystick4Button5PressedStatus "Reports when the joystick button has been pressed.";
CM_ SG_ 3221225472 Joystick4Button6PressedStatus "Reports when the joystick button has been pressed.";
CM_ SG_ 3221225472 Joystick4Button7PressedStatus "Reports when the joystick button has been pressed.";
CM_ SG_ 3221225472 Joystick4Button8PressedStatus "Reports when the joystick button has been pressed.";
CM_ SG_ 3221225472 Joystick4Button1PressedStatus "Reports when the joystick button has been pressed.";
CM_ SG_ 3221225472 Joystick4Button2PressedStatus "Reports when the joystick button has been pressed.";
CM_ SG_ 3221225472 Joystick4Button3PressedStatus "Reports when the joystick button has been pressed.";
CM_ SG_ 3221225472 Joystick4Button4PressedStatus "Reports when the joystick button has been pressed.";
CM_ SG_ 3221225472 Joystick4XAxisDetentPosStatus "Reports when the current joystick position is in the detent position for that axis of travel.";
CM_ SG_ 3221225472 Joystick4YAxisDetentPosStatus "Reports when the current joystick position is in the detent position for that axis of travel.";
CM_ SG_ 3221225472 Joystick4YAxisPos "The position of the joystick in the relative motion of travel from the neutral position.";
CM_ SG_ 3221225472 Jystck4YAxsLvrFrwrdPstvPsStatus "Reports when the current joystick position is on the positive travel side (forward, right, clockwise, up) relative to the";
CM_ SG_ 3221225472 Jystck4YAxsLvrBckNgtvePosStatus "Reports when the current joystick position is on the negative travel side (back, left, counterclockwise, down) relative to the";
CM_ SG_ 3221225472 Joystick4YAxisNeutralPosStatus "Reports when the current joystick position is in the neutral position for that axis of travel.";
CM_ SG_ 3221225472 Joystick4XAxisPos "The position of the joystick in the relative motion of travel from the neutral position.";
CM_ SG_ 3221225472 Jystck4XAxsLvrRghtPstvPosStatus "Reports when the current joystick position is on the positive travel side (forward, right, clockwise, up) relative to the";
CM_ SG_ 3221225472 Jystck4XAxsLvrLftNgtvePosStatus "Reports when the current joystick position is on the negative travel side (back, left, counterclockwise, down) relative to the";
CM_ SG_ 3221225472 Joystick4XAxisNeutralPosStatus "Reports when the current joystick position is in the neutral position for that axis of travel.";
CM_ SG_ 3221225472 Jystck4GripXAxisDetentPosStatus "Reports when the current joystick grip position is in the detent position for that axis of travel.";
CM_ SG_ 3221225472 Jystck4GripYAxisDetentPosStatus "Reports when the current joystick grip position is in the detent position for that axis of travel.";
CM_ SG_ 3221225472 Jystck4ThetaAxisDetentPosStatus "Reports when the current joystick position is in the detent position for that axis of travel.";
CM_ SG_ 3221225472 Joystick4ThetaAxisPos "The position of the joystick in the relative motion of travel from the neutral position.";
CM_ SG_ 3221225472 Jystck4ThtAxsClckwsPstvPsStatus "Reports when the current joystick position is on the positive travel side (forward, right, clockwise, up) relative to the";
CM_ SG_ 3221225472 Jystck4ThtAxsCntrClckwsNgtvPsStt "Reports when the current joystick position is on the negative travel side (back, left, counterclockwise, down) relative to the";
CM_ SG_ 3221225472 Jystck4ThtaAxisNeutralPosStatus "Reports when the current joystick position is in the neutral position for that axis of travel.";
CM_ SG_ 3221225472 Joystick4GripYAxisPos "The position of the joystick grip in the relative motion of travel from the neutral position.";
CM_ SG_ 3221225472 Jystck4GrpYAxsLvrFrwrdPstvPsStts "Reports when the current joystick grip position is on the positive travel side (forward, right, clockwise, up) relative to the";
CM_ SG_ 3221225472 Jystck4GrpYAxsLvrBckNgtvPsSttus "Reports when the current joystick grip position is on the negative travel side (back, left, counterclockwise, down) relative";
CM_ SG_ 3221225472 Jystck4GrpYAxisNeutralPosStatus "Reports when the current joystick grip position is in the neutral position for that axis of travel.";
CM_ SG_ 3221225472 Joystick4GripXAxisPos "The position of the joystick grip in the relative motion of travel from the neutral position.";
CM_ SG_ 3221225472 Jystck4GrpXAxsLvrRghtPstvPsStts "Reports when the current joystick grip position is on the positive travel side (forward, right, clockwise, up) relative to the";
CM_ SG_ 3221225472 Jystck4GrpXAxsLvrLftNgtvPsSttus "Reports when the current joystick grip position is on the negative travel side (back, left, counterclockwise, down) relative";
CM_ SG_ 3221225472 Jystck4GrpXAxisNeutralPosStatus "Reports when the current joystick grip position is in the neutral position for that axis of travel.";
CM_ SG_ 3221225472 Joystick5Button9PressedStatus "Reports when the joystick button has been pressed.";
CM_ SG_ 3221225472 Joystick5Button10PressedStatus "Reports when the joystick button has been pressed.";
CM_ SG_ 3221225472 Joystick5Button11PressedStatus "Reports when the joystick button has been pressed.";
CM_ SG_ 3221225472 Joystick5Button12PressedStatus "Reports when the joystick button has been pressed.";
CM_ SG_ 3221225472 Joystick5Button5PressedStatus "Reports when the joystick button has been pressed.";
CM_ SG_ 3221225472 Joystick5Button6PressedStatus "Reports when the joystick button has been pressed.";
CM_ SG_ 3221225472 Joystick5Button7PressedStatus "Reports when the joystick button has been pressed.";
CM_ SG_ 3221225472 Joystick5Button8PressedStatus "Reports when the joystick button has been pressed.";
CM_ SG_ 3221225472 Joystick5Button1PressedStatus "Reports when the joystick button has been pressed.";
CM_ SG_ 3221225472 Joystick5Button2PressedStatus "Reports when the joystick button has been pressed.";
CM_ SG_ 3221225472 Joystick5Button3PressedStatus "Reports when the joystick button has been pressed.";
CM_ SG_ 3221225472 Joystick5Button4PressedStatus "Reports when the joystick button has been pressed.";
CM_ SG_ 3221225472 Joystick5XAxisDetentPosStatus "Reports when the current joystick position is in the detent position for that axis of travel.";
CM_ SG_ 3221225472 Joystick5YAxisDetentPosStatus "Reports when the current joystick position is in the detent position for that axis of travel.";
CM_ SG_ 3221225472 Joystick5YAxisPos "The position of the joystick in the relative motion of travel from the neutral position.";
CM_ SG_ 3221225472 Jystck5YAxsLvrFrwrdPstvPsStatus "Reports when the current joystick position is on the positive travel side (forward, right, clockwise, up) relative to the";
CM_ SG_ 3221225472 Jystck5YAxsLvrBckNgtvePosStatus "Reports when the current joystick position is on the negative travel side (back, left, counterclockwise, down) relative to the";
CM_ SG_ 3221225472 Joystick5YAxisNeutralPosStatus "Reports when the current joystick position is in the neutral position for that axis of travel.";
CM_ SG_ 3221225472 Joystick5XAxisPos "The position of the joystick in the relative motion of travel from the neutral position.";
CM_ SG_ 3221225472 Jystck5XAxsLvrRghtPstvPosStatus "Reports when the current joystick position is on the positive travel side (forward, right, clockwise, up) relative to the";
CM_ SG_ 3221225472 Jystck5XAxsLvrLftNgtvePosStatus "Reports when the current joystick position is on the negative travel side (back, left, counterclockwise, down) relative to the";
CM_ SG_ 3221225472 Joystick5XAxisNeutralPosStatus "Reports when the current joystick position is in the neutral position for that axis of travel.";
CM_ SG_ 3221225472 Jystck5GripXAxisDetentPosStatus "Reports when the current joystick grip position is in the detent position for that axis of travel.";
CM_ SG_ 3221225472 Jystck5GripYAxisDetentPosStatus "Reports when the current joystick grip position is in the detent position for that axis of travel.";
CM_ SG_ 3221225472 Jystck5ThetaAxisDetentPosStatus "Reports when the current joystick position is in the detent position for that axis of travel.";
CM_ SG_ 3221225472 Joystick5ThetaAxisPos "The position of the joystick in the relative motion of travel from the neutral position.";
CM_ SG_ 3221225472 Jystck5ThtAxsClckwsPstvPsStatus "Reports when the current joystick position is on the positive travel side (forward, right, clockwise, up) relative to the";
CM_ SG_ 3221225472 Jystck5ThtAxsCntrClckwsNgtvPsStt "Reports when the current joystick position is on the negative travel side (back, left, counterclockwise, down) relative to the";
CM_ SG_ 3221225472 Jystck5ThtaAxisNeutralPosStatus "Reports when the current joystick position is in the neutral position for that axis of travel.";
CM_ SG_ 3221225472 Joystick5GripYAxisPos "The position of the joystick grip in the relative motion of travel from the neutral position.";
CM_ SG_ 3221225472 Jystck5GrpYAxsLvrFrwrdPstvPsStts "Reports when the current joystick grip position is on the positive travel side (forward, right, clockwise, up) relative to the";
CM_ SG_ 3221225472 Jystck5GrpYAxsLvrBckNgtvPsSttus "Reports when the current joystick grip position is on the negative travel side (back, left, counterclockwise, down) relative";
CM_ SG_ 3221225472 Jystck5GrpYAxisNeutralPosStatus "Reports when the current joystick grip position is in the neutral position for that axis of travel.";
CM_ SG_ 3221225472 Joystick5GripXAxisPos "The position of the joystick grip in the relative motion of travel from the neutral position.";
CM_ SG_ 3221225472 Jystck5GrpXAxsLvrRghtPstvPsStts "Reports when the current joystick grip position is on the positive travel side (forward, right, clockwise, up) relative to the";
CM_ SG_ 3221225472 Jystck5GrpXAxsLvrLftNgtvPsSttus "Reports when the current joystick grip position is on the negative travel side (back, left, counterclockwise, down) relative";
CM_ SG_ 3221225472 Jystck5GrpXAxisNeutralPosStatus "Reports when the current joystick grip position is in the neutral position for that axis of travel.";
CM_ SG_ 3221225472 Joystick6Button9PressedStatus "Reports when the joystick button has been pressed.";
CM_ SG_ 3221225472 Joystick6Button10PressedStatus "Reports when the joystick button has been pressed.";
CM_ SG_ 3221225472 Joystick6Button11PressedStatus "Reports when the joystick button has been pressed.";
CM_ SG_ 3221225472 Joystick6Button12PressedStatus "Reports when the joystick button has been pressed.";
CM_ SG_ 3221225472 Joystick6Button5PressedStatus "Reports when the joystick button has been pressed.";
CM_ SG_ 3221225472 Joystick6Button6PressedStatus "Reports when the joystick button has been pressed.";
CM_ SG_ 3221225472 Joystick6Button7PressedStatus "Reports when the joystick button has been pressed.";
CM_ SG_ 3221225472 Joystick6Button8PressedStatus "Reports when the joystick button has been pressed.";
CM_ SG_ 3221225472 Joystick6Button1PressedStatus "Reports when the joystick button has been pressed.";
CM_ SG_ 3221225472 Joystick6Button2PressedStatus "Reports when the joystick button has been pressed.";
CM_ SG_ 3221225472 Joystick6Button3PressedStatus "Reports when the joystick button has been pressed.";
CM_ SG_ 3221225472 Joystick6Button4PressedStatus "Reports when the joystick button has been pressed.";
CM_ SG_ 3221225472 Joystick6XAxisDetentPosStatus "Reports when the current joystick position is in the detent position for that axis of travel.";
CM_ SG_ 3221225472 Joystick6YAxisDetentPosStatus "Reports when the current joystick position is in the detent position for that axis of travel.";
CM_ SG_ 3221225472 Joystick6YAxisPos "The position of the joystick in the relative motion of travel from the neutral position.";
CM_ SG_ 3221225472 Jystck6YAxsLvrFrwrdPstvPsStatus "Reports when the current joystick position is on the positive travel side (forward, right, clockwise, up) relative to the";
CM_ SG_ 3221225472 Jystck6YAxsLvrBckNgtvePosStatus "Reports when the current joystick position is on the negative travel side (back, left, counterclockwise, down) relative to the";
CM_ SG_ 3221225472 Joystick6YAxisNeutralPosStatus "Reports when the current joystick position is in the neutral position for that axis of travel.";
CM_ SG_ 3221225472 Joystick6XAxisPos "The position of the joystick in the relative motion of travel from the neutral position.";
CM_ SG_ 3221225472 Jystck6XAxsLvrRghtPstvPosStatus "Reports when the current joystick position is on the positive travel side (forward, right, clockwise, up) relative to the";
CM_ SG_ 3221225472 Jystck6XAxsLvrLftNgtvePosStatus "Reports when the current joystick position is on the negative travel side (back, left, counterclockwise, down) relative to the";
CM_ SG_ 3221225472 Joystick6XAxisNeutralPosStatus "Reports when the current joystick position is in the neutral position for that axis of travel.";
CM_ SG_ 3221225472 Jystck6GripXAxisDetentPosStatus "Reports when the current joystick grip position is in the detent position for that axis of travel.";
CM_ SG_ 3221225472 Jystck6GripYAxisDetentPosStatus "Reports when the current joystick grip position is in the detent position for that axis of travel.";
CM_ SG_ 3221225472 Jystck6ThetaAxisDetentPosStatus "Reports when the current joystick position is in the detent position for that axis of travel.";
CM_ SG_ 3221225472 Joystick6ThetaAxisPos "The position of the joystick in the relative motion of travel from the neutral position.";
CM_ SG_ 3221225472 Jystck6ThtAxsClckwsPstvPsStatus "Reports when the current joystick position is on the positive travel side (forward, right, clockwise, up) relative to the";
CM_ SG_ 3221225472 Jystck6ThtAxsCntrClckwsNgtvPsStt "Reports when the current joystick position is on the negative travel side (back, left, counterclockwise, down) relative to the";
CM_ SG_ 3221225472 Jystck6ThtaAxisNeutralPosStatus "Reports when the current joystick position is in the neutral position for that axis of travel.";
CM_ SG_ 3221225472 Joystick6GripYAxisPos "The position of the joystick grip in the relative motion of travel from the neutral position.";
CM_ SG_ 3221225472 Jystck6GrpYAxsLvrFrwrdPstvPsStts "Reports when the current joystick grip position is on the positive travel side (forward, right, clockwise, up) relative to the";
CM_ SG_ 3221225472 Jystck6GrpYAxsLvrBckNgtvPsSttus "Reports when the current joystick grip position is on the negative travel side (back, left, counterclockwise, down) relative";
CM_ SG_ 3221225472 Jystck6GrpYAxisNeutralPosStatus "Reports when the current joystick grip position is in the neutral position for that axis of travel.";
CM_ SG_ 3221225472 Joystick6GripXAxisPos "The position of the joystick grip in the relative motion of travel from the neutral position.";
CM_ SG_ 3221225472 Jystck6GrpXAxsLvrRghtPstvPsStts "Reports when the current joystick grip position is on the positive travel side (forward, right, clockwise, up) relative to the";
CM_ SG_ 3221225472 Jystck6GrpXAxsLvrLftNgtvPsSttus "Reports when the current joystick grip position is on the negative travel side (back, left, counterclockwise, down) relative";
CM_ SG_ 3221225472 Jystck6GrpXAxisNeutralPosStatus "Reports when the current joystick grip position is in the neutral position for that axis of travel.";
CM_ SG_ 3221225472 Joystick7Button9PressedStatus "Reports when the joystick button has been pressed.";
CM_ SG_ 3221225472 Joystick7Button10PressedStatus "Reports when the joystick button has been pressed.";
CM_ SG_ 3221225472 Joystick7Button11PressedStatus "Reports when the joystick button has been pressed.";
CM_ SG_ 3221225472 Joystick7Button12PressedStatus "Reports when the joystick button has been pressed.";
CM_ SG_ 3221225472 Joystick7Button5PressedStatus "Reports when the joystick button has been pressed.";
CM_ SG_ 3221225472 Joystick7Button6PressedStatus "Reports when the joystick button has been pressed.";
CM_ SG_ 3221225472 Joystick7Button7PressedStatus "Reports when the joystick button has been pressed.";
CM_ SG_ 3221225472 Joystick7Button8PressedStatus "Reports when the joystick button has been pressed.";
CM_ SG_ 3221225472 Joystick7Button1PressedStatus "Reports when the joystick button has been pressed.";
CM_ SG_ 3221225472 Joystick7Button2PressedStatus "Reports when the joystick button has been pressed.";
CM_ SG_ 3221225472 Joystick7Button3PressedStatus "Reports when the joystick button has been pressed.";
CM_ SG_ 3221225472 Joystick7Button4PressedStatus "Reports when the joystick button has been pressed.";
CM_ SG_ 3221225472 Joystick7XAxisDetentPosStatus "Reports when the current joystick position is in the detent position for that axis of travel.";
CM_ SG_ 3221225472 Joystick7YAxisDetentPosStatus "Reports when the current joystick position is in the detent position for that axis of travel.";
CM_ SG_ 3221225472 Joystick7YAxisPos "The position of the joystick in the relative motion of travel from the neutral position.";
CM_ SG_ 3221225472 Jystck7YAxsLvrFrwrdPstvPsStatus "Reports when the current joystick position is on the positive travel side (forward, right, clockwise, up) relative to the";
CM_ SG_ 3221225472 Jystck7YAxsLvrBckNgtvePosStatus "Reports when the current joystick position is on the negative travel side (back, left, counterclockwise, down) relative to the";
CM_ SG_ 3221225472 Joystick7YAxisNeutralPosStatus "Reports when the current joystick position is in the neutral position for that axis of travel.";
CM_ SG_ 3221225472 Joystick7XAxisPos "The position of the joystick in the relative motion of travel from the neutral position.";
CM_ SG_ 3221225472 Jystck7XAxsLvrRghtPstvPosStatus "Reports when the current joystick position is on the positive travel side (forward, right, clockwise, up) relative to the";
CM_ SG_ 3221225472 Jystck7XAxsLvrLftNgtvePosStatus "Reports when the current joystick position is on the negative travel side (back, left, counterclockwise, down) relative to the";
CM_ SG_ 3221225472 Joystick7XAxisNeutralPosStatus "Reports when the current joystick position is in the neutral position for that axis of travel.";
CM_ SG_ 3221225472 Jystck7GripXAxisDetentPosStatus "Reports when the current joystick grip position is in the detent position for that axis of travel.";
CM_ SG_ 3221225472 Jystck7GripYAxisDetentPosStatus "Reports when the current joystick grip position is in the detent position for that axis of travel.";
CM_ SG_ 3221225472 Jystck7ThetaAxisDetentPosStatus "Reports when the current joystick position is in the detent position for that axis of travel.";
CM_ SG_ 3221225472 Joystick7ThetaAxisPos "The position of the joystick in the relative motion of travel from the neutral position.";
CM_ SG_ 3221225472 Jystck7ThtAxsClckwsPstvPsStatus "Reports when the current joystick position is on the positive travel side (forward, right, clockwise, up) relative to the";
CM_ SG_ 3221225472 Jystck7ThtAxsCntrClckwsNgtvPsStt "Reports when the current joystick position is on the negative travel side (back, left, counterclockwise, down) relative to the";
CM_ SG_ 3221225472 Jystck7ThtaAxisNeutralPosStatus "Reports when the current joystick position is in the neutral position for that axis of travel.";
CM_ SG_ 3221225472 Joystick7GripYAxisPos "The position of the joystick grip in the relative motion of travel from the neutral position.";
CM_ SG_ 3221225472 Jystck7GrpYAxsLvrFrwrdPstvPsStts "Reports when the current joystick grip position is on the positive travel side (forward, right, clockwise, up) relative to the";
CM_ SG_ 3221225472 Jystck7GrpYAxsLvrBckNgtvPsSttus "Reports when the current joystick grip position is on the negative travel side (back, left, counterclockwise, down) relative";
CM_ SG_ 3221225472 Jystck7GrpYAxisNeutralPosStatus "Reports when the current joystick grip position is in the neutral position for that axis of travel.";
CM_ SG_ 3221225472 Joystick7GripXAxisPos "The position of the joystick grip in the relative motion of travel from the neutral position.";
CM_ SG_ 3221225472 Jystck7GrpXAxsLvrRghtPstvPsStts "Reports when the current joystick grip position is on the positive travel side (forward, right, clockwise, up) relative to the";
CM_ SG_ 3221225472 Jystck7GrpXAxsLvrLftNgtvPsSttus "Reports when the current joystick grip position is on the negative travel side (back, left, counterclockwise, down) relative";
CM_ SG_ 3221225472 Jystck7GrpXAxisNeutralPosStatus "Reports when the current joystick grip position is in the neutral position for that axis of travel.";
CM_ SG_ 3221225472 Joystick8Button9PressedStatus "Reports when the joystick button has been pressed.";
CM_ SG_ 3221225472 Joystick8Button10PressedStatus "Reports when the joystick button has been pressed.";
CM_ SG_ 3221225472 Joystick8Button11PressedStatus "Reports when the joystick button has been pressed.";
CM_ SG_ 3221225472 Joystick8Button12PressedStatus "Reports when the joystick button has been pressed.";
CM_ SG_ 3221225472 Joystick8Button5PressedStatus "Reports when the joystick button has been pressed.";
CM_ SG_ 3221225472 Joystick8Button6PressedStatus "Reports when the joystick button has been pressed.";
CM_ SG_ 3221225472 Joystick8Button7PressedStatus "Reports when the joystick button has been pressed.";
CM_ SG_ 3221225472 Joystick8Button8PressedStatus "Reports when the joystick button has been pressed.";
CM_ SG_ 3221225472 Joystick8Button1PressedStatus "Reports when the joystick button has been pressed.";
CM_ SG_ 3221225472 Joystick8Button2PressedStatus "Reports when the joystick button has been pressed.";
CM_ SG_ 3221225472 Joystick8Button3PressedStatus "Reports when the joystick button has been pressed.";
CM_ SG_ 3221225472 Joystick8Button4PressedStatus "Reports when the joystick button has been pressed.";
CM_ SG_ 3221225472 Joystick8XAxisDetentPosStatus "Reports when the current joystick position is in the detent position for that axis of travel.";
CM_ SG_ 3221225472 Joystick8YAxisDetentPosStatus "Reports when the current joystick position is in the detent position for that axis of travel.";
CM_ SG_ 3221225472 Joystick8YAxisPos "The position of the joystick in the relative motion of travel from the neutral position.";
CM_ SG_ 3221225472 Jystck8YAxsLvrFrwrdPstvPsStatus "Reports when the current joystick position is on the positive travel side (forward, right, clockwise, up) relative to the";
CM_ SG_ 3221225472 Jystck8YAxsLvrBckNgtvePosStatus "Reports when the current joystick position is on the negative travel side (back, left, counterclockwise, down) relative to the";
CM_ SG_ 3221225472 Joystick8YAxisNeutralPosStatus "Reports when the current joystick position is in the neutral position for that axis of travel.";
CM_ SG_ 3221225472 Joystick8XAxisPos "The position of the joystick in the relative motion of travel from the neutral position.";
CM_ SG_ 3221225472 Jystck8XAxsLvrRghtPstvPosStatus "Reports when the current joystick position is on the positive travel side (forward, right, clockwise, up) relative to the";
CM_ SG_ 3221225472 Jystck8XAxsLvrLftNgtvePosStatus "Reports when the current joystick position is on the negative travel side (back, left, counterclockwise, down) relative to the";
CM_ SG_ 3221225472 Joystick8XAxisNeutralPosStatus "Reports when the current joystick position is in the neutral position for that axis of travel.";
CM_ SG_ 3221225472 Jystck8GripXAxisDetentPosStatus "Reports when the current joystick grip position is in the detent position for that axis of travel.";
CM_ SG_ 3221225472 Jystck8GripYAxisDetentPosStatus "Reports when the current joystick grip position is in the detent position for that axis of travel.";
CM_ SG_ 3221225472 Jystck8ThetaAxisDetentPosStatus "Reports when the current joystick position is in the detent position for that axis of travel.";
CM_ SG_ 3221225472 Joystick8ThetaAxisPos "The position of the joystick in the relative motion of travel from the neutral position.";
CM_ SG_ 3221225472 Jystck8ThtAxsClckwsPstvPsStatus "Reports when the current joystick position is on the positive travel side (forward, right, clockwise, up) relative to the";
CM_ SG_ 3221225472 Jystck8ThtAxsCntrClckwsNgtvPsStt "Reports when the current joystick position is on the negative travel side (back, left, counterclockwise, down) relative to the";
CM_ SG_ 3221225472 Jystck8ThtaAxisNeutralPosStatus "Reports when the current joystick position is in the neutral position for that axis of travel.";
CM_ SG_ 3221225472 Joystick8GripYAxisPos "The position of the joystick grip in the relative motion of travel from the neutral position.";
CM_ SG_ 3221225472 Jystck8GrpYAxsLvrFrwrdPstvPsStts "Reports when the current joystick grip position is on the positive travel side (forward, right, clockwise, up) relative to the";
CM_ SG_ 3221225472 Jystck8GrpYAxsLvrBckNgtvPsSttus "Reports when the current joystick grip position is on the negative travel side (back, left, counterclockwise, down) relative";
CM_ SG_ 3221225472 Jystck8GrpYAxisNeutralPosStatus "Reports when the current joystick grip position is in the neutral position for that axis of travel.";
CM_ SG_ 3221225472 Joystick8GripXAxisPos "The position of the joystick grip in the relative motion of travel from the neutral position.";
CM_ SG_ 3221225472 Jystck8GrpXAxsLvrRghtPstvPsStts "Reports when the current joystick grip position is on the positive travel side (forward, right, clockwise, up) relative to the";
CM_ SG_ 3221225472 Jystck8GrpXAxsLvrLftNgtvPsSttus "Reports when the current joystick grip position is on the negative travel side (back, left, counterclockwise, down) relative";
CM_ SG_ 3221225472 Jystck8GrpXAxisNeutralPosStatus "Reports when the current joystick grip position is in the neutral position for that axis of travel.";
CM_ SG_ 3221225472 Joystick9Button9PressedStatus "Reports when the joystick button has been pressed.";
CM_ SG_ 3221225472 Joystick9Button10PressedStatus "Reports when the joystick button has been pressed.";
CM_ SG_ 3221225472 Joystick9Button11PressedStatus "Reports when the joystick button has been pressed.";
CM_ SG_ 3221225472 Joystick9Button12PressedStatus "Reports when the joystick button has been pressed.";
CM_ SG_ 3221225472 Joystick9Button5PressedStatus "Reports when the joystick button has been pressed.";
CM_ SG_ 3221225472 Joystick9Button6PressedStatus "Reports when the joystick button has been pressed.";
CM_ SG_ 3221225472 Joystick9Button7PressedStatus "Reports when the joystick button has been pressed.";
CM_ SG_ 3221225472 Joystick9Button8PressedStatus "Reports when the joystick button has been pressed.";
CM_ SG_ 3221225472 Joystick9Button1PressedStatus "Reports when the joystick button has been pressed.";
CM_ SG_ 3221225472 Joystick9Button2PressedStatus "Reports when the joystick button has been pressed.";
CM_ SG_ 3221225472 Joystick9Button3PressedStatus "Reports when the joystick button has been pressed.";
CM_ SG_ 3221225472 Joystick9Button4PressedStatus "Reports when the joystick button has been pressed.";
CM_ SG_ 3221225472 Joystick9XAxisDetentPosStatus "Reports when the current joystick position is in the detent position for that axis of travel.";
CM_ SG_ 3221225472 Joystick9YAxisDetentPosStatus "Reports when the current joystick position is in the detent position for that axis of travel.";
CM_ SG_ 3221225472 Joystick9YAxisPos "The position of the joystick in the relative motion of travel from the neutral position.";
CM_ SG_ 3221225472 Jystck9YAxsLvrFrwrdPstvPsStatus "Reports when the current joystick position is on the positive travel side (forward, right, clockwise, up) relative to the";
CM_ SG_ 3221225472 Jystck9YAxsLvrBckNgtvePosStatus "Reports when the current joystick position is on the negative travel side (back, left, counterclockwise, down) relative to the";
CM_ SG_ 3221225472 Joystick9YAxisNeutralPosStatus "Reports when the current joystick position is in the neutral position for that axis of travel.";
CM_ SG_ 3221225472 Joystick9XAxisPos "The position of the joystick in the relative motion of travel from the neutral position.";
CM_ SG_ 3221225472 Jystck9XAxsLvrRghtPstvPosStatus "Reports when the current joystick position is on the positive travel side (forward, right, clockwise, up) relative to the";
CM_ SG_ 3221225472 Jystck9XAxsLvrLftNgtvePosStatus "Reports when the current joystick position is on the negative travel side (back, left, counterclockwise, down) relative to the";
CM_ SG_ 3221225472 Joystick9XAxisNeutralPosStatus "Reports when the current joystick position is in the neutral position for that axis of travel.";
CM_ SG_ 3221225472 Jystck9GripXAxisDetentPosStatus "Reports when the current joystick grip position is in the detent position for that axis of travel.";
CM_ SG_ 3221225472 Jystck9GripYAxisDetentPosStatus "Reports when the current joystick grip position is in the detent position for that axis of travel.";
CM_ SG_ 3221225472 Jystck9ThetaAxisDetentPosStatus "Reports when the current joystick position is in the detent position for that axis of travel.";
CM_ SG_ 3221225472 Joystick9ThetaAxisPos "The position of the joystick in the relative motion of travel from the neutral position.";
CM_ SG_ 3221225472 Jystck9ThtAxsClckwsPstvPsStatus "Reports when the current joystick position is on the positive travel side (forward, right, clockwise, up) relative to the";
CM_ SG_ 3221225472 Jystck9ThtAxsCntrClckwsNgtvPsStt "Reports when the current joystick position is on the negative travel side (back, left, counterclockwise, down) relative to the";
CM_ SG_ 3221225472 Jystck9ThtaAxisNeutralPosStatus "Reports when the current joystick position is in the neutral position for that axis of travel.";
CM_ SG_ 3221225472 Joystick9GripYAxisPos "The position of the joystick grip in the relative motion of travel from the neutral position.";
CM_ SG_ 3221225472 Jystck9GrpYAxsLvrFrwrdPstvPsStts "Reports when the current joystick grip position is on the positive travel side (forward, right, clockwise, up) relative to the";
CM_ SG_ 3221225472 Jystck9GrpYAxsLvrBckNgtvPsSttus "Reports when the current joystick grip position is on the negative travel side (back, left, counterclockwise, down) relative";
CM_ SG_ 3221225472 Jystck9GrpYAxisNeutralPosStatus "Reports when the current joystick grip position is in the neutral position for that axis of travel.";
CM_ SG_ 3221225472 Joystick9GripXAxisPos "The position of the joystick grip in the relative motion of travel from the neutral position.";
CM_ SG_ 3221225472 Jystck9GrpXAxsLvrRghtPstvPsStts "Reports when the current joystick grip position is on the positive travel side (forward, right, clockwise, up) relative to the";
CM_ SG_ 3221225472 Jystck9GrpXAxsLvrLftNgtvPsSttus "Reports when the current joystick grip position is on the negative travel side (back, left, counterclockwise, down) relative";
CM_ SG_ 3221225472 Jystck9GrpXAxisNeutralPosStatus "Reports when the current joystick grip position is in the neutral position for that axis of travel.";
CM_ SG_ 3221225472 Joystick10Button9PressedStatus "Reports when the joystick button has been pressed.";
CM_ SG_ 3221225472 Joystick10Button10PressedStatus "Reports when the joystick button has been pressed.";
CM_ SG_ 3221225472 Joystick10Button11PressedStatus "Reports when the joystick button has been pressed.";
CM_ SG_ 3221225472 Joystick10Button12PressedStatus "Reports when the joystick button has been pressed.";
CM_ SG_ 3221225472 Joystick10Button5PressedStatus "Reports when the joystick button has been pressed.";
CM_ SG_ 3221225472 Joystick10Button6PressedStatus "Reports when the joystick button has been pressed.";
CM_ SG_ 3221225472 Joystick10Button7PressedStatus "Reports when the joystick button has been pressed.";
CM_ SG_ 3221225472 Joystick10Button8PressedStatus "Reports when the joystick button has been pressed.";
CM_ SG_ 3221225472 Joystick10Button1PressedStatus "Reports when the joystick button has been pressed.";
CM_ SG_ 3221225472 Joystick10Button2PressedStatus "Reports when the joystick button has been pressed.";
CM_ SG_ 3221225472 Joystick10Button3PressedStatus "Reports when the joystick button has been pressed.";
CM_ SG_ 3221225472 Joystick10Button4PressedStatus "Reports when the joystick button has been pressed.";
CM_ SG_ 3221225472 Joystick10XAxisDetentPosStatus "Reports when the current joystick position is in the detent position for that axis of travel.";
CM_ SG_ 3221225472 Joystick10YAxisDetentPosStatus "Reports when the current joystick position is in the detent position for that axis of travel.";
CM_ SG_ 3221225472 Joystick10YAxisPos "The position of the joystick in the relative motion of travel from the neutral position.";
CM_ SG_ 3221225472 Jystck10YAxsLvrFrwrdPstvPsSttus "Reports when the current joystick position is on the positive travel side (forward, right, clockwise, up) relative to the";
CM_ SG_ 3221225472 Jystck10YAxsLvrBckNgtvPosStatus "Reports when the current joystick position is on the negative travel side (back, left, counterclockwise, down) relative to the";
CM_ SG_ 3221225472 Joystick10YAxisNeutralPosStatus "Reports when the current joystick position is in the neutral position for that axis of travel.";
CM_ SG_ 3221225472 Joystick10XAxisPos "The position of the joystick in the relative motion of travel from the neutral position.";
CM_ SG_ 3221225472 Jystck10XAxsLvrRghtPstvPsStatus "Reports when the current joystick position is on the positive travel side (forward, right, clockwise, up) relative to the";
CM_ SG_ 3221225472 Jystck10XAxsLvrLftNgtvPosStatus "Reports when the current joystick position is on the negative travel side (back, left, counterclockwise, down) relative to the";
CM_ SG_ 3221225472 Joystick10XAxisNeutralPosStatus "Reports when the current joystick position is in the neutral position for that axis of travel.";
CM_ SG_ 3221225472 Jystck10GrpXAxisDetentPosStatus "Reports when the current joystick grip position is in the detent position for that axis of travel.";
CM_ SG_ 3221225472 Jystck10GrpYAxisDetentPosStatus "Reports when the current joystick grip position is in the detent position for that axis of travel.";
CM_ SG_ 3221225472 Jystck10ThtaAxisDetentPosStatus "Reports when the current joystick position is in the detent position for that axis of travel.";
CM_ SG_ 3221225472 Joystick10ThetaAxisPos "The position of the joystick in the relative motion of travel from the neutral position.";
CM_ SG_ 3221225472 Jystck10ThtAxsClckwsPstvPsSttus "Reports when the current joystick position is on the positive travel side (forward, right, clockwise, up) relative to the";
CM_ SG_ 3221225472 Jystck10ThtAxsCntrClckwsNgtvPsSt "Reports when the current joystick position is on the negative travel side (back, left, counterclockwise, down) relative to the";
CM_ SG_ 3221225472 Jystck10ThtAxisNeutralPosStatus "Reports when the current joystick position is in the neutral position for that axis of travel.";
CM_ SG_ 3221225472 Joystick10GripYAxisPos "The position of the joystick grip in the relative motion of travel from the neutral position.";
CM_ SG_ 3221225472 Jystck10GrpYAxsLvrFrwrdPstvPsStt "Reports when the current joystick grip position is on the positive travel side (forward, right, clockwise, up) relative to the";
CM_ SG_ 3221225472 Jystck10GrpYAxsLvrBckNgtvPsStts "Reports when the current joystick grip position is on the negative travel side (back, left, counterclockwise, down) relative";
CM_ SG_ 3221225472 Jystck10GrpYAxsNeutralPosStatus "Reports when the current joystick grip position is in the neutral position for that axis of travel.";
CM_ SG_ 3221225472 Joystick10GripXAxisPos "The position of the joystick grip in the relative motion of travel from the neutral position.";
CM_ SG_ 3221225472 Jystck10GrpXAxsLvrRghtPstvPsStts "Reports when the current joystick grip position is on the positive travel side (forward, right, clockwise, up) relative to the";
CM_ SG_ 3221225472 Jystck10GrpXAxsLvrLftNgtvPsStts "Reports when the current joystick grip position is on the negative travel side (back, left, counterclockwise, down) relative";
CM_ SG_ 3221225472 Jystck10GrpXAxsNeutralPosStatus "Reports when the current joystick grip position is in the neutral position for that axis of travel.";
CM_ SG_ 3221225472 Aftrtrtmnt1GsOxdtnCtlystDffPrssP "Used to identify the applicable J1939-73 FMI detected in the gas oxidation catalyst differential pressure sensor by the";
CM_ SG_ 3221225472 Aftrtrtmnt1GsOxdtnCtlystOtltGsTm "Used to identify the applicable J1939-73 FMI detected in the gas oxidation catalyst outlet gas temperature sensor by the";
CM_ SG_ 3221225472 Aftrtrtmnt1GsOxdtnCtlystIntkGsTm "Used to identify the applicable J1939-73 FMI detected in the gas oxidation catalyst intake gas temperature sensor by the";
CM_ SG_ 3221225472 Aftrtrtmnt1GsOxdtnCtlystDffPrss "Exhaust differential pressure measured between the intake and exhaust of the gas oxidation catalyst in exhaust bank 1.";
CM_ SG_ 3221225472 Aftrtrtmnt1GsOxdtnCtlystOtl_0000 "Temperature of engine combustion byproducts leaving the gas oxidation catalyst in exhaust bank 1.";
CM_ SG_ 3221225472 Aftrtrtmnt1GsOxdtnCtlystInt_0000 "Temperature of engine combustion byproducts entering the gas oxidation catalyst in exhaust bank 1.";
CM_ SG_ 3221225472 Aftrtrtmnt2GsOxdtnCtlystDffPrssP "Used to identify the applicable J1939-73 FMI detected in the gas oxidation catalyst differential pressure sensor by the";
CM_ SG_ 3221225472 Aftrtrtmnt2GsOxdtnCtlystOtltGsTm "Used to identify the applicable J1939-73 FMI detected in the gas oxidation catalyst outlet gas temperature sensor by the";
CM_ SG_ 3221225472 Aftrtrtmnt2GsOxdtnCtlystIntkGsTm "Used to identify the applicable J1939-73 FMI detected in the gas oxidation catalyst intake gas temperature sensor by the";
CM_ SG_ 3221225472 Aftrtrtmnt2GsOxdtnCtlystDffPrss "Exhaust differential pressure measured between the intake and exhaust of the gas oxidation catalyst in exhaust bank 2.";
CM_ SG_ 3221225472 Aftrtrtmnt2GsOxdtnCtlystOtl_0000 "Temperature of engine combustion byproducts leaving the gas oxidation catalyst in exhaust bank 2.";
CM_ SG_ 3221225472 Aftrtrtmnt2GsOxdtnCtlystInt_0000 "Temperature of engine combustion byproducts entering the gas oxidation catalyst in exhaust bank 2.";
CM_ SG_ 3221225472 Aftrtrtmnt1DslOxdtnCtlystDf_0000 "Used to identify the applicable J1939-73 FMI detected in the diesel oxidation catalyst differential pressure sensor by the";
CM_ SG_ 3221225472 Aftrtrtmnt1DslOxdtnCtlystOtltGsT "Used to identify the applicable J1939-73 FMI detected in the diesel oxidation catalyst outlet gas temperature sensor by";
CM_ SG_ 3221225472 Aftrtrtmnt1DslOxdtnCtlystIntkGsT "Used to identify the applicable J1939-73 FMI detected in the diesel oxidation catalyst intake gas temperature sensor by";
CM_ SG_ 3221225472 Aftrtrtmnt1DslOxdtnCtlystDffPrss "Exhaust differential pressure measured between the intake and exhaust of a diesel oxidation catalyst in exhaust bank 1.";
CM_ SG_ 3221225472 Aftrtrtmnt1DslOxdtnCtlystOt_0000 "Temperature of engine combustion byproducts leaving the diesel oxidation catalyst exhaust in exhaust bank 1.";
CM_ SG_ 3221225472 Aftrtrtmnt1DslOxdtnCtlystIn_0000 "Temperature of engine combustion byproducts entering the diesel oxidation catalyst in exhaust bank 1.";
CM_ SG_ 3221225472 Aftrtrtmnt2DslOxdtnCtlystOtltGsT "Used to identify the applicable J1939-73 FMI detected in the diesel oxidation catalyst outlet gas temperature sensor by";
CM_ SG_ 3221225472 Aftrtrtmnt2DslOxdtnCtlystIntkGsT "Used to identify the applicable J1939-73 FMI detected in the diesel oxidation catalyst intake gas temperature sensor by";
CM_ SG_ 3221225472 Aftrtrtmnt2DslOxdtnCtlystDffPrss "Exhaust differential pressure measured between the intake and exhaust of a diesel oxidation catalyst in exhaust bank 2.";
CM_ SG_ 3221225472 Aftrtrtmnt2DslOxdtnCtlystOt_0000 "Temperature of engine combustion byproducts leaving the diesel oxidation catalyst exhaust in exhaust bank 2.";
CM_ SG_ 3221225472 Aftrtrtmnt2DslOxdtnCtlystIn_0000 "Temperature of engine combustion byproducts entering the diesel oxidation catalyst in exhaust bank 2.";
CM_ SG_ 3221225472 Aftrtrtmnt2DslOxdtnCtlystDf_0000 "Used to identify the applicable J1939-73 FMI detected in the diesel oxidation catalyst differential pressure sensor by the";
CM_ SG_ 3221225472 Aftrtrtmnt2GsOxdtnCtlystDffGsTmp "The differential engine combustion byproducts gas temperature measured between the intake and outlet of the gas";
CM_ SG_ 3221225472 Aftrtrtmnt1GsOxdtnCtlystDffGsTmp "The differential engine combustion byproducts gas temperature measured between the intake and outlet of the gas";
CM_ SG_ 3221225472 Aftrtrtmnt2ThrWyCtlystDffGsTemp "The differential engine combustion byproducts gas temperature measured between the intake and outlet of the three way";
CM_ SG_ 3221225472 Aftrtrtmnt1ThrWyCtlystDffGsTemp "The differential engine combustion byproducts gas temperature measured between the intake and outlet of the three way";
CM_ SG_ 3221225472 DslPrtcltFltr1StSnsrPrlmnaryFMI "Used to identify the applicable J1939-73 FMI detected in the soot sensor signal by the manufacturer's sensor control";
CM_ SG_ 3221225472 DslPrtcltFlter1MedianSootSignal "Median output signal level from diesel particulate filter 1 soot sensor.";
CM_ SG_ 3221225472 DslPrtclteFilter1MeanSootSignal "Mean output signal level from diesel particulate filter 1 soot sensor.";
CM_ SG_ 3221225472 DslPrticulateFilter1SootDensity "Soot density in diesel particulate filter 1.";
CM_ SG_ 3221225472 DeselParticulateFilter1SootMass "Soot mass in diesel particulate filter 1.";
CM_ SG_ 3221225472 DslPrtcltFltr2StSnsrPrlmnaryFMI "Used to identify the applicable J1939-73 FMI detected in the soot sensor signal by the manufacturer's sensor control";
CM_ SG_ 3221225472 DslPrtcltFlter2MedianSootSignal "Median output signal level from diesel particulate filter 2 soot sensor.";
CM_ SG_ 3221225472 DslPrtclteFilter2MeanSootSignal "Mean output signal level from diesel particulate filter 2 soot sensor.";
CM_ SG_ 3221225472 DslPrticulateFilter2SootDensity "Soot density in diesel particulate filter 2.";
CM_ SG_ 3221225472 DeselParticulateFilter2SootMass "Soot mass in diesel particulate filter 2.";
CM_ SG_ 3221225472 Aftrtrtmnt1WrmUpDslOxdtnCtlystOt "This is the temperature measured at the outlet of the warm up oxidation catalytic converter in exhaust bank 1.";
CM_ SG_ 3221225472 Aftrtrtmnt1WrmUpDslOxdtnCtlystIn "This is the temperature measured at the intake of the warm up oxidation catalytic converter in exhaust bank 1.";
CM_ SG_ 3221225472 SpecialIgnitorLoop90Resistance "Resistance of Special Ignitor Loop 90.";
CM_ SG_ 3221225472 SpecialIgnitorLoop89Resistance "Resistance of Special Ignitor Loop 89.";
CM_ SG_ 3221225472 SpecialIgnitorLoop88Resistance "Resistance of Special Ignitor Loop 88.";
CM_ SG_ 3221225472 SpecialIgnitorLoop87Resistance "Resistance of Special Ignitor Loop 87.";
CM_ SG_ 3221225472 SpecialIgnitorLoop86Resistance "Resistance of Special Ignitor Loop 86.";
CM_ SG_ 3221225472 SpecialIgnitorLoop85Resistance "Resistance of Special Ignitor Loop 85.";
CM_ SG_ 3221225472 SpecialIgnitorLoop84Resistance "Resistance of Special Ignitor Loop 84.";
CM_ SG_ 3221225472 SpecialIgnitorLoop83Resistance "Resistance of Special Ignitor Loop 83.";
CM_ SG_ 3221225472 SpecialIgnitorLoop82Resistance "Resistance of Special Ignitor Loop 82.";
CM_ SG_ 3221225472 SpecialIgnitorLoop81Resistance "Resistance of Special Ignitor Loop 81.";
CM_ SG_ 3221225472 SpecialIgnitorLoop80Resistance "Resistance of Special Ignitor Loop 80.";
CM_ SG_ 3221225472 SpecialIgnitorLoop79Resistance "Resistance of Special Ignitor Loop 79.";
CM_ SG_ 3221225472 SpecialIgnitorLoop78Resistance "Resistance of Special Ignitor Loop 78.";
CM_ SG_ 3221225472 SpecialIgnitorLoop77Resistance "Resistance of Special Ignitor Loop 77.";
CM_ SG_ 3221225472 SpecialIgnitorLoop76Resistance "Resistance of Special Ignitor Loop 76.";
CM_ SG_ 3221225472 SpecialIgnitorLoop75Resistance "Resistance of Special Ignitor Loop 75.";
CM_ SG_ 3221225472 SpecialIgnitorLoop74Resistance "Resistance of Special Ignitor Loop 74.";
CM_ SG_ 3221225472 SpecialIgnitorLoop73Resistance "Resistance of Special Ignitor Loop 73.";
CM_ SG_ 3221225472 SpecialIgnitorLoop72Resistance "Resistance of Special Ignitor Loop 72.";
CM_ SG_ 3221225472 SpecialIgnitorLoop71Resistance "Resistance of Special Ignitor Loop 71.";
CM_ SG_ 3221225472 SpecialIgnitorLoop70Resistance "Resistance of Special Ignitor Loop 70.";
CM_ SG_ 3221225472 SpecialIgnitorLoop69Resistance "Resistance of Special Ignitor Loop 69.";
CM_ SG_ 3221225472 SpecialIgnitorLoop68Resistance "Resistance of Special Ignitor Loop 68.";
CM_ SG_ 3221225472 SpecialIgnitorLoop67Resistance "Resistance of Special Ignitor Loop 67.";
CM_ SG_ 3221225472 SpecialIgnitorLoop66Resistance "Resistance of Special Ignitor Loop 66.";
CM_ SG_ 3221225472 SpecialIgnitorLoop65Resistance "Resistance of Special Ignitor Loop 65.";
CM_ SG_ 3221225472 SpecialIgnitorLoop64Resistance "Resistance of Special Ignitor Loop 64.";
CM_ SG_ 3221225472 SpecialIgnitorLoop63Resistance "Resistance of Special Ignitor Loop 63.";
CM_ SG_ 3221225472 SpecialIgnitorLoop61Resistance "Resistance of Special Ignitor Loop 61.";
CM_ SG_ 3221225472 SpecialIgnitorLoop60Resistance "Resistance of Special Ignitor Loop 60.";
CM_ SG_ 3221225472 SpecialIgnitorLoop59Resistance "Resistance of Special Ignitor Loop 59.";
CM_ SG_ 3221225472 SpecialIgnitorLoop58Resistance "Resistance of Special Ignitor Loop 58.";
CM_ SG_ 3221225472 SpecialIgnitorLoop57Resistance "Resistance of Special Ignitor Loop 57.";
CM_ SG_ 3221225472 SpecialIgnitorLoop56Resistance "Resistance of Special Ignitor Loop 56.";
CM_ SG_ 3221225472 SpecialIgnitorLoop55Resistance "Resistance of Special Ignitor Loop 55.";
CM_ SG_ 3221225472 SpecialIgnitorLoop54Resistance "Resistance of Special Ignitor Loop 54.";
CM_ SG_ 3221225472 SpecialIgnitorLoop53Resistance "Resistance of Special Ignitor Loop 53.";
CM_ SG_ 3221225472 SpecialIgnitorLoop52Resistance "Resistance of Special Ignitor Loop 52.";
CM_ SG_ 3221225472 SpecialIgnitorLoop51Resistance "Resistance of Special Ignitor Loop 51.";
CM_ SG_ 3221225472 SpecialIgnitorLoop50Resistance "Resistance of Special Ignitor Loop 50.";
CM_ SG_ 3221225472 SpecialIgnitorLoop49Resistance "Resistance of Special Ignitor Loop 49.";
CM_ SG_ 3221225472 SpecialIgnitorLoop48Resistance "Resistance of Special Ignitor Loop 48.";
CM_ SG_ 3221225472 SpecialIgnitorLoop47Resistance "Resistance of Special Ignitor Loop 47.";
CM_ SG_ 3221225472 SpecialIgnitorLoop46Resistance "Resistance of Special Ignitor Loop 46.";
CM_ SG_ 3221225472 SpecialIgnitorLoop45Resistance "Resistance of Special Ignitor Loop 45.";
CM_ SG_ 3221225472 SpecialIgnitorLoop44Resistance "Resistance of Special Ignitor Loop 44.";
CM_ SG_ 3221225472 SpecialIgnitorLoop43Resistance "Resistance of Special Ignitor Loop 43.";
CM_ SG_ 3221225472 SpecialIgnitorLoop42Resistance "Resistance of Special Ignitor Loop 42.";
CM_ SG_ 3221225472 SpecialIgnitorLoop41Resistance "Resistance of Special Ignitor Loop 41.";
CM_ SG_ 3221225472 SpecialIgnitorLoop40Resistance "Resistance of Special Ignitor Loop 40.";
CM_ SG_ 3221225472 SpecialIgnitorLoop39Resistance "Resistance of Special Ignitor Loop 39.";
CM_ SG_ 3221225472 SpecialIgnitorLoop38Resistance "Resistance of Special Ignitor Loop 38.";
CM_ SG_ 3221225472 SpecialIgnitorLoop37Resistance "Resistance of Special Ignitor Loop 37.";
CM_ SG_ 3221225472 SpecialIgnitorLoop36Resistance "Resistance of Special Ignitor Loop 36.";
CM_ SG_ 3221225472 SpecialIgnitorLoop35Resistance "Resistance of Special Ignitor Loop 35.";
CM_ SG_ 3221225472 SpecialIgnitorLoop34Resistance "Resistance of Special Ignitor Loop 34.";
CM_ SG_ 3221225472 SpecialIgnitorLoop33Resistance "Resistance of Special Ignitor Loop 33.";
CM_ SG_ 3221225472 SpecialIgnitorLoop32Resistance "Resistance of Special Ignitor Loop 32.";
CM_ SG_ 3221225472 SpecialIgnitorLoop31Resistance "Resistance of Special Ignitor Loop 31.";
CM_ SG_ 3221225472 SpecialIgnitorLoop30Resistance "Resistance of Special Ignitor Loop 30.";
CM_ SG_ 3221225472 SpecialIgnitorLoop29Resistance "Resistance of Special Ignitor Loop 29.";
CM_ SG_ 3221225472 SpecialIgnitorLoop28Resistance "Resistance of Special Ignitor Loop 28.";
CM_ SG_ 3221225472 SpecialIgnitorLoop27Resistance "Resistance of Special Ignitor Loop 27.";
CM_ SG_ 3221225472 SpecialIgnitorLoop26Resistance "Resistance of Special Ignitor Loop 26.";
CM_ SG_ 3221225472 SpecialIgnitorLoop25Resistance "Resistance of Special Ignitor Loop 25.";
CM_ SG_ 3221225472 SpecialIgnitorLoop24Resistance "Resistance of Special Ignitor Loop 24.";
CM_ SG_ 3221225472 SpecialIgnitorLoop23Resistance "Resistance of Special Ignitor Loop 23.";
CM_ SG_ 3221225472 SpecialIgnitorLoop22Resistance "Resistance of Special Ignitor Loop 22.";
CM_ SG_ 3221225472 SpecialIgnitorLoop21Resistance "Resistance of Special Ignitor Loop 21.";
CM_ SG_ 3221225472 SpecialIgnitorLoop20Resistance "Resistance of Special Ignitor Loop 20.";
CM_ SG_ 3221225472 SpecialIgnitorLoop19Resistance "Resistance of Special Ignitor Loop 19.";
CM_ SG_ 3221225472 SpecialIgnitorLoop18Resistance "Resistance of Special Ignitor Loop 18.";
CM_ SG_ 3221225472 SpecialIgnitorLoop17Resistance "Resistance of Special Ignitor Loop 17.";
CM_ SG_ 3221225472 SpecialIgnitorLoop16Resistance "Resistance of Special Ignitor Loop 16.";
CM_ SG_ 3221225472 SpecialIgnitorLoop15Resistance "Resistance of Special Ignitor Loop 15.";
CM_ SG_ 3221225472 SpecialIgnitorLoop14Resistance "Resistance of Special Ignitor Loop 14.";
CM_ SG_ 3221225472 SpecialIgnitorLoop13Resistance "Resistance of Special Ignitor Loop 13.";
CM_ SG_ 3221225472 SpecialIgnitorLoop12Resistance "Resistance of Special Ignitor Loop 12.";
CM_ SG_ 3221225472 SpecialIgnitorLoop11Resistance "Resistance of Special Ignitor Loop 11.";
CM_ SG_ 3221225472 SpecialIgnitorLoop10Resistance "Resistance of Special Ignitor Loop 10.";
CM_ SG_ 3221225472 SpecialIgnitorLoop9Resistance "Resistance of Special Ignitor Loop 9.";
CM_ SG_ 3221225472 SpecialIgnitorLoop8Resistance "Resistance of Special Ignitor Loop 8.";
CM_ SG_ 3221225472 SpecialIgnitorLoop7Resistance "Resistance of Special Ignitor Loop 7.";
CM_ SG_ 3221225472 SpecialIgnitorLoop6Resistance "Resistance of Special Ignitor Loop 6.";
CM_ SG_ 3221225472 SpecialIgnitorLoop5Resistance "Resistance of Special Ignitor Loop 5.";
CM_ SG_ 3221225472 SpecialIgnitorLoop4Resistance "Resistance of Special Ignitor Loop 4.";
CM_ SG_ 3221225472 SpecialIgnitorLoop3Resistance "Resistance of Special Ignitor Loop 3.";
CM_ SG_ 3221225472 SpecialIgnitorLoop2Resistance "Resistance of Special Ignitor Loop 2.";
CM_ SG_ 3221225472 SpecialIgnitorLoop1Resistance "Resistance of Special Ignitor Loop 1.";
CM_ SG_ 3221225472 SdBgIgnitorLoop2RightResistance "Resistance of Side Bag Ignitor Loop 2 - Right.";
CM_ SG_ 3221225472 SdBgIgnitorLoop1RightResistance "Resistance of Side Bag Ignitor Loop 1 - Right.";
CM_ SG_ 3221225472 SdBagIgnitorLoop2LeftResistance "Resistance of Side Bag Ignitor Loop 2 - Left.";
CM_ SG_ 3221225472 SdBagIgnitorLoop1LeftResistance "Resistance of Side Bag Ignitor Loop 1 - Left.";
CM_ SG_ 3221225472 PssngrBltTnsnrIgntrLpResistance "Resistance of Passenger Belt Tensioner Ignitor Loop 1st Stage.";
CM_ SG_ 3221225472 DrvrBltTnsnrIgntrLoopResistance "Resistance of Driver Belt Tensioner Ignitor Loop 1st Stage.";
CM_ SG_ 3221225472 PssngrArbgIgntrLp2ndStgRsstance "Resistance of Passenger Airbag Ignitor Loop 2nd Stage.";
CM_ SG_ 3221225472 DrvrArbgIgntrLp2ndStgResistance "Resistance of Driver Airbag Ignitor Loop 2nd Stage.";
CM_ SG_ 3221225472 PssngrArbgIgntrLp1stStgRsstance "Resistance of Passenger Airbag Ignitor Loop 1st Stage.";
CM_ SG_ 3221225472 DrvrArbgIgntrLp1stStgResistance "Resistance of Driver Airbag Ignitor Loop 1st Stage.";
CM_ SG_ 3221225472 RearCollisionSensor4Type "Type of Rear Collision Sensor 4.";
CM_ SG_ 3221225472 RearCollisionSensor3Type "Type of Rear Collision Sensor 3.";
CM_ SG_ 3221225472 RearCollisionSensor2Type "Type of Rear Collision Sensor 2.";
CM_ SG_ 3221225472 RearCollisionSensor1Type "Type of Rear Collision Sensor 1.";
CM_ SG_ 3221225472 SdeCollisionSensorRearRightType "Type of Side Collision Sensor Rear - Right.";
CM_ SG_ 3221225472 SdCllsionSensorMidRearRightType "Type of Side Collision Sensor Mid Rear - Right.";
CM_ SG_ 3221225472 SdCllsonSensorMidFrontRightType "Type of Side Collision Sensor Mid Front - Right.";
CM_ SG_ 3221225472 SdCollisionSensorFrontRightType "Type of Side Collision Sensor Front - Right.";
CM_ SG_ 3221225472 SideCollisionSensorRearLeftType "Type of Side Collision Sensor Rear - Left.";
CM_ SG_ 3221225472 SdCllisionSensorMidRearLeftType "Type of Side Collision Sensor Mid Rear - Left.";
CM_ SG_ 3221225472 SdCllsionSensorMidFrontLeftType "Type of Side Collision Sensor Mid Front - Left.";
CM_ SG_ 3221225472 SdeCollisionSensorFrontLeftType "Type of Side Collision Sensor Front - Left.";
CM_ SG_ 3221225472 FrontalCollisionSensor4Type "Type of Frontal Collision Sensor 4.";
CM_ SG_ 3221225472 FrontalCollisionSensor3Type "Type of Frontal Collision Sensor 3.";
CM_ SG_ 3221225472 FrontalCollisionSensor2Type "Type of Frontal Collision Sensor 2.";
CM_ SG_ 3221225472 FrontalCollisionSensor1Type "Type of Frontal Collision Sensor 1.";
CM_ SG_ 3221225472 PssngrArbgDctvationSwitchStatus "State of switch used to deactivate Passenger Airbag manually.";
CM_ SG_ 3221225472 Beltlock10Status "State of switch used to determine if Beltlock 10 is buckled.";
CM_ SG_ 3221225472 Beltlock9Status "State of switch used to determine if Beltlock 9 is buckled.";
CM_ SG_ 3221225472 Beltlock8Status "State of switch used to determine if Beltlock 8 is buckled.";
CM_ SG_ 3221225472 Beltlock7Status "State of switch used to determine if Beltlock 7 is buckled.";
CM_ SG_ 3221225472 Beltlock6Status "State of switch used to determine if Beltlock 6 is buckled.";
CM_ SG_ 3221225472 Beltlock5Status "State of switch used to determine if Beltlock 5 is buckled.";
CM_ SG_ 3221225472 Beltlock4Status "State of switch used to determine if Beltlock 4 is buckled.";
CM_ SG_ 3221225472 Beltlock3Status "State of switch used to determine if Beltlock 3 is buckled.";
CM_ SG_ 3221225472 PassengerBeltlockStatus "State of switch used to determine if Passenger Beltlock is buckled.";
CM_ SG_ 3221225472 DriverBeltlockStatus "State of switch used to determine if Driver Beltlock is buckled.";
CM_ SG_ 3221225472 OccpntClssfcationSystem10Status "State of Occupant Classification System for seat position 10.";
CM_ SG_ 3221225472 OccpntClssficationSystem9Status "State of Occupant Classification System for seat position 9.";
CM_ SG_ 3221225472 OccpntClssficationSystem8Status "State of Occupant Classification System for seat position 8.";
CM_ SG_ 3221225472 OccpntClssficationSystem7Status "State of Occupant Classification System for seat position 7.";
CM_ SG_ 3221225472 OccpntClssficationSystem6Status "State of Occupant Classification System for seat position 6.";
CM_ SG_ 3221225472 OccpntClssficationSystem5Status "State of Occupant Classification System for seat position 5.";
CM_ SG_ 3221225472 OccpntClssficationSystem4Status "State of Occupant Classification System for seat position 4.";
CM_ SG_ 3221225472 OccpntClssficationSystem3Status "State of Occupant Classification System for seat position 3.";
CM_ SG_ 3221225472 PssngrOccpntClssfctnSystmStatus "State of Occupant Classification System for passenger.";
CM_ SG_ 3221225472 DrvrOccpntClssfctonSystemStatus "State of Occupant Classification System for driver.";
CM_ SG_ 3221225472 BatteryCharger1OutputCurrent "Output current of the battery charger connected to the main battery.";
CM_ SG_ 3221225472 BatteryCharger1OutputVoltage "Output voltage measured on the battery terminals of the battery charger connected to the main battery.";
CM_ SG_ 3221225472 BatteryCharger1PowerLineState "A state of the battery charger connection to the power line for the charger connected to the main battery.";
CM_ SG_ 3221225472 BatteryCharger1State "A state of the battery charger connected to the main battery.";
CM_ SG_ 3221225472 BatteryCharger2OutputCurrent "Output current of the battery charger connected to the main battery.";
CM_ SG_ 3221225472 BatteryCharger2OutputVoltage "Output voltage measured on the battery terminals of the offline battery charger connected to the auxiliary battery.";
CM_ SG_ 3221225472 BatteryCharger2PowerLineState "A state of the battery charger connection to the power line for the charger connected to the auxiliary battery.";
CM_ SG_ 3221225472 BatteryCharger2State "A state of the offline battery charger connected to the auxiliary battery.";
CM_ SG_ 3221225472 MagnetRatedPower "The rated power that the magnet can accept during material holding operations.";
CM_ SG_ 3221225472 MagnetBoostTime "The duration of time after the activation of the magnet circuit that a relatively high current is sent to the magnet for";
CM_ SG_ 3221225472 GneratorDutyCycleExceededStatus "The status of the duty cycle of the generator usage, indicating if the generator has been on for too much time within a";
CM_ SG_ 3221225472 VoltageMonitorActiveStatus "Status of Voltage Monitor Relay.";
CM_ SG_ 3221225472 GensetEnableActiveStatus "Status of the Genset Enable Relay that enables or disables the Genset.";
CM_ SG_ 3221225472 ReverseCurrentRangeSetting "The operator setting for the Reverse Current.";
CM_ SG_ 3221225472 GensetSoftstartActiveStatus "The Genset Softstart Active Status refers to the status of the genset softstart relay.";
CM_ SG_ 3221225472 Grapple_MagnetSelectionSwitch "This is a switch that can be used to select either the Grapple or Magnet function of the material handler machine.";
CM_ SG_ 3221225472 GnstSystmOtptVoltageRangeStatus "Status of generator voltage in or out of desired operating range.";
CM_ SG_ 3221225472 GeneratorOverheatStatus "The Status of Generator being Overheated.";
CM_ SG_ 3221225472 Aftrtrtmnt1IntkGsNOxSnsrNwPrtDvt "New part deviation NOx_Offset to correct (recalculate) sensor signal on the Engine ECU side.";
CM_ SG_ 3221225472 Aftrtrtmnt1IntkGsNOxSnsrNwP_0000 "New part deviation NOx_Gain to correct (recalculate) sensor signal on the Engine ECU side.";
CM_ SG_ 3221225472 Aftrtrtmnt1IntkGsNOxSnsrHtrRtio "Heater ratio to determine temperature at sensor tip.";
CM_ SG_ 3221225472 Aftrtrtmnt1IntkGsNOxSnsrNH3Crrct "Correction of NH3 at the NOx-signal to correct (recalculate) sensor signal on the Engine ECU side.";
CM_ SG_ 3221225472 Aftrtrtmnt1IntkGsNOxSnsrNO2Crrct "Correction of NO2 at the NOx-signal to correct (recalculate) sensor signal on the Engine ECU side.";
CM_ SG_ 3221225472 Aftrtrtmnt1IntkGsNOxSnsrCrrctnOf "Correction of pressure NOx-signal to correct (recalculate) sensor signal on the Engine ECU side.";
CM_ SG_ 3221225472 Aftrtrtmnt1IntkGsNOxSnsrCrr_0000 "Correction of pressure Lambda-signal to correct (recalculate) sensor signal on the Engine ECU side.";
CM_ SG_ 3221225472 Aftrtrtmnt1OtltGsNOxSnsrNwPrtDvt "New part deviation NOx_Offset to correct (recalculate) sensor signal on the Engine ECU side.";
CM_ SG_ 3221225472 Aftrtrtmnt1OtltGsNOxSnsrNwP_0000 "New part deviation NOx_Gain to correct (recalculate) sensor signal on the Engine ECU side.";
CM_ SG_ 3221225472 Aftrtrtmnt1OtltGsNOxSnsrHtrRtio "Heater ratio to determine temperature at sensor tip.";
CM_ SG_ 3221225472 Aftrtrtmnt1OtltGsNOxSnsrNH3Crrct "Correction of NH3 at the NOx-signal to correct (recalculate) sensor signal on the Engine ECU side.";
CM_ SG_ 3221225472 Aftrtrtmnt1OtltGsNOxSnsrNO2Crrct "Correction of NO2 at the NOx-signal to correct (recalculate) sensor signal on the Engine ECU side.";
CM_ SG_ 3221225472 Aftrtrtmnt1OtltGsNOxSnsrCrrctnOf "Correction of pressure NOx-signal to correct (recalculate) sensor signal on the Engine ECU side.";
CM_ SG_ 3221225472 Aftrtrtmnt1OtltGsNOxSnsrCrr_0000 "Correction of pressure Lambda-signal to correct (recalculate) sensor signal on the Engine ECU side.";
CM_ SG_ 3221225472 Aftrtrtmnt2IntkGsNOxSnsrNwPrtDvt "New part deviation NOx_Offset to correct (recalculate) sensor signal on the Engine ECU side.";
CM_ SG_ 3221225472 Aftrtrtmnt2IntkGsNOxSnsrNwP_0000 "New part deviation NOx_Gain to correct (recalculate) sensor signal on the Engine ECU side.";
CM_ SG_ 3221225472 Aftrtrtmnt2IntkGsNOxSnsrHtrRtio "Heater ratio to determine temperature at sensor tip.";
CM_ SG_ 3221225472 Aftrtrtmnt2IntkGsNOxSnsrNH3Crrct "Correction of NH3 at the NOx-signal to correct (recalculate) sensor signal on the Engine ECU side.";
CM_ SG_ 3221225472 Aftrtrtmnt2IntkGsNOxSnsrNO2Crrct "Correction of NO2 at the NOx-signal to correct (recalculate) sensor signal on the Engine ECU side.";
CM_ SG_ 3221225472 Aftrtrtmnt2IntkGsNOxSnsrCrrctnOf "Correction of pressure NOx-signal to correct (recalculate) sensor signal on the Engine ECU side.";
CM_ SG_ 3221225472 Aftrtrtmnt2IntkGsNOxSnsrCrr_0000 "Correction of pressure Lambda-signal to correct (recalculate) sensor signal on the Engine ECU side.";
CM_ SG_ 3221225472 Aftrtrtmnt2OtltGsNOxSnsrNwPrtDvt "New part deviation NOx_Offset to correct (recalculate) sensor signal on the Engine ECU side.";
CM_ SG_ 3221225472 Aftrtrtmnt2OtltGsNOxSnsrNwP_0000 "New part deviation NOx_Gain to correct (recalculate) sensor signal on the Engine ECU side.";
CM_ SG_ 3221225472 Aftrtrtmnt2OtltGsNOxSnsrHtrRtio "Heater ratio to determine temperature at sensor tip.";
CM_ SG_ 3221225472 Aftrtrtmnt2OtltGsNOxSnsrNH3Crrct "Correction of NH3 at the NOx-signal to correct (recalculate) sensor signal on the Engine ECU side.";
CM_ SG_ 3221225472 Aftrtrtmnt2OtltGsNOxSnsrNO2Crrct "Correction of NO2 at the NOx-signal to correct (recalculate) sensor signal on the Engine ECU side.";
CM_ SG_ 3221225472 Aftrtrtmnt2OtltGsNOxSnsrCrrctnOf "Correction of pressure NOx-signal to correct (recalculate) sensor signal on the Engine ECU side.";
CM_ SG_ 3221225472 Aftrtrtmnt2OtltGsNOxSnsrCrr_0000 "Correction of pressure Lambda-signal to correct (recalculate) sensor signal on the Engine ECU side.";
CM_ SG_ 3221225472 HighResolutionEngTotalFuelUsed "Accumulated amount of fuel used during vehicle operation.";
CM_ SG_ 3221225472 HighResolutionEngTripFuel "Fuel consumed during all or part of a journey.";
CM_ SG_ 3221225472 EngOilRelativeDielectricity "Engine oil relative dielectricity used to describe the engine oil quality.";
CM_ SG_ 3221225472 EngOilDensity "Density of the engine oil";
CM_ SG_ 3221225472 EngOilViscosity "Dynamic viscosity of the engine oil";
CM_ SG_ 3221225472 EngFuelFilterRestrictedLampCmd "Command signal directly controlling the Vehicle Fuel Filter Restricted Lamp.";
CM_ SG_ 3221225472 EngAirFilterRestrictionLampCmd "Command signal directly controlling the Engine Air Filter Restriction Lamp.";
CM_ SG_ 3221225472 EngIdleManagementActiveLampCmd "Command signal directly controlling the Engine Idle Management Active Lamp";
CM_ SG_ 3221225472 EngCoolantLevelLowLampCmd "Command signal directly controlling the Engine Coolant Level Low Lamp";
CM_ SG_ 3221225472 EngCoolantTempHighLampCmd "Command signal directly controlling the Engine Coolant Temperature High Lamp";
CM_ SG_ 3221225472 EngOilPressLowLampCmd "Command signal directly controlling the Engine Oil Pressure Low Lamp";
CM_ SG_ 3221225472 CmprssnBrkEnblSwtchIndctrLmpCmd "Command signal directly controlling Compression Brake Enable Switch Indicator Lamp.";
CM_ SG_ 3221225472 EngBrakeActiveLampCmd "Command signal directly controlling the Engine Brake Active Lamp";
CM_ SG_ 3221225472 OBDMalfunctionIndicatorLampCmd "Command signal directly controlling the OBD Malfunction Indicator Lamp";
CM_ SG_ 3221225472 EngRedStopLampCmd "Command signal directly controlling the Engine Red Stop Lamp";
CM_ SG_ 3221225472 EngAmberWarningLampCmd "Command signal directly controlling the Engine Amber Warning Lamp";
CM_ SG_ 3221225472 EngProtectLampCmd "Command signal directly controlling the Engine Protect Lamp";
CM_ SG_ 3221225472 VehicleBatteryChargingLampCmd "Command signal directly controlling the Vehicle Battery Charging Lamp.";
CM_ SG_ 3221225472 VehicleHVACRecirculationLampCmd "Command signal directly controlling the Vehicle HVAC Recirculation Lamp.";
CM_ SG_ 3221225472 VehicleAirPressLowLampCmd "Command signal directly controlling the Vehicle Air Pressure Low Lamp.";
CM_ SG_ 3221225472 VehicleFuelLevelLowLampCmd "Command signal directly controlling the Vehicle Fuel Level Low Lamp.";
CM_ SG_ 3221225472 VehicleBatteryVoltageLowLampCmd "Command signal directly controlling the Vehicle Battery Voltage Low Lamp.";
CM_ SG_ 3221225472 EngWaitToStartLampData "This parameter provides measured data from the Engine Wait To Start Lamp.";
CM_ SG_ 3221225472 EngFuelFilterRestrictedLampData "Command signal directly controlling the Vehicle Fuel Filter Restricted Lamp.";
CM_ SG_ 3221225472 EngAirFilterRestrictionLampData "This parameter provides measured data from the Engine Air Filter Restriction Lamp.";
CM_ SG_ 3221225472 EngIdleManagementActiveLampData "This parameter provides measured data from the Engine Idle Management Active Lamp.";
CM_ SG_ 3221225472 EngCoolantLevelLowLampData "This parameter provides measured data from the Engine Coolant Level Low Lamp.";
CM_ SG_ 3221225472 EngCoolantTempHighLampData "This parameter provides measured data from the Engine Coolant Temperature High Lamp.";
CM_ SG_ 3221225472 EngOilPressLowLampData "This parameter provides measured data from the Engine Oil Pressure Low Lamp.";
CM_ SG_ 3221225472 CmprssnBrkEnblSwtchIndctrLmpDta "This parameter provides measured data from the Compression Brake Enable Switch Indicator Lamp.";
CM_ SG_ 3221225472 EngBrakeActiveLampData "This parameter provides measured data from the Engine Brake Active Lamp.";
CM_ SG_ 3221225472 OBDMalfunctionIndicatorLampData "This parameter provides measured data from the OBD Malfunction Indicator Lamp.";
CM_ SG_ 3221225472 EngRedStopLampData "This parameter provides measured data from the Engine Red Stop Lamp.";
CM_ SG_ 3221225472 EngAmberWarningLampData "This parameter provides measured data from the Engine Amber Warning Lamp.";
CM_ SG_ 3221225472 EngProtectLampData "This parameter provides measured data from the Engine Protect Lamp.";
CM_ SG_ 3221225472 VehicleBatteryChargingLampData "This parameter provides measured data from the Vehicle Battery Charging Lamp.";
CM_ SG_ 3221225472 VhicleHVACRecirculationLampData "This parameter provides measured data from the Vehicle HVAC Recirculation Lamp.";
CM_ SG_ 3221225472 VehicleAirPressLowLampData "This parameter provides measured data from the Vehicle Air Pressure Low Lamp.";
CM_ SG_ 3221225472 VehicleFuelLevelLowLampData "This parameter provides measured data from theVehicle Fuel Level Low Lamp.";
CM_ SG_ 3221225472 VhicleBatteryVoltageLowLampData "This parameter provides measured data from the Vehicle Battery Voltage Low Lamp.";
CM_ SG_ 3221225472 LowVoltageDisconnectTemp "Internal temperature of the LVD.";
CM_ SG_ 3221225472 LwVltgDisconnectVoutOutputState "State of the Vout Output from the LVD.";
CM_ SG_ 3221225472 LwVoltageDisconnectOutput1State "State of the Output #1 from the LVD.";
CM_ SG_ 3221225472 LwVoltageDisconnectOutput2State "State of the Output #2 from the LVD.";
CM_ SG_ 3221225472 LwVoltageDisconnectOutput3State "State of the Output #3 from the LVD.";
CM_ SG_ 3221225472 LwVltgDscnnctCrrntOperatingMode "Current operating mode of the LVD.";
CM_ SG_ 3221225472 LwVltgDscnnctManualConnectState "State of the Manual Connect hardwired input to the LVD.";
CM_ SG_ 3221225472 LwVltgDscnnctMnlDisconnectState "State of the Manual Disconnect hardwired input to the LVD.";
CM_ SG_ 3221225472 EngExhstGsRcrcltn2IntkeAbsPress "EGR intake absolute pressure measured before the EGR 2 valve.";
CM_ SG_ 3221225472 EngExhstGsRcrcltn2OtletAbsPress "Absolute Pressure immediately after the EGR2 valve";
CM_ SG_ 3221225472 EngExhstGsRcrcltion2IntakePress "EGR2 intake gauge pressure is measured after EGR2 cooler and before EGR2 valve";
CM_ SG_ 3221225472 EngExhstGsRcrculation2DiffPress "Differential Pressure across the Exhaust Gas Recirculation 2 (EGR2) system.";
CM_ SG_ 3221225472 EngExhstGsRcrcltn2MxrIntakeTemp "The temperature of the EGR gas entering the intake of EGR2 system mixer.";
CM_ SG_ 3221225472 EngExhaustGasRecirculation2Temp "Temperature of Recirculated Exhaust Gas of EGR2";
CM_ SG_ 3221225472 EGR2CoolerBypassActuatorPos "EGR2 Cooler Bypass Actuator position, where 0% = Fully Closed (no gas flowing through the bypass), and 100% = Fully";
CM_ SG_ 3221225472 EngExhstGsRcrcltn2ClrEfficiency "Exhaust Gas Recirculation 2 cooler efficiency is an indication of the cooler's ability to reduce the temperature of the";
CM_ SG_ 3221225472 EngExhstGsRcrcltn2ClrIntkGsAbsPr "Exhaust Gas Recirculation 2 gas absolute pressure is measured at EGR2 cooler intake.";
CM_ SG_ 3221225472 EngExhstGsRcrcltn2ClrIntakeTemp "Exhaust Gas Recirculation 2 (EGR2) Temperature measured at EGR2 cooler intake.";
CM_ SG_ 3221225472 CmdedEngFuelInjectionCtrlPress "Provides the commanded set point value for the engine fuel injection control pressure.";
CM_ SG_ 3221225472 CmdedEngFuelRailPress "Provides the commanded set point value for the engine fuel rail pressure";
CM_ SG_ 3221225472 EngExhstGsRcrculation2Valve2Pos "The position of the second exhaust gas recirculation valve of EGR 2 expressed as a percentage of full travel.";
CM_ SG_ 3221225472 EngExhstGsRcirculation2ValvePos "Position of EGR2 valve expressed as a percentage of full travel.";
CM_ SG_ 3221225472 EngExhstMnfldBnk2FlwBlncVlv_0000 "Commanded percentage of maximum Engine Ehaust Manifold Bank 2 Balance valve opening.";
CM_ SG_ 3221225472 EngExhstMnfldBnk1FlwBlncVlv_0000 "Commanded percentage of maximum Engine Exhaust Manifold Bank 1 Balance valve opening.";
CM_ SG_ 3221225472 EngExhstMnfldBnk2FlwBlncVlvActtr "Actual percentage of maximum Engine Manifold Bank 2 Balance valve opening.";
CM_ SG_ 3221225472 EngExhstMnfldBnk1FlwBlncVlvActtr "Actual percentage of maximum Engine Exhaust Manifold Bank 1 Balance valve opening.";
CM_ SG_ 3221225472 EngExhstGsRcrclation2Valve2Ctrl "Desired percentage of maximum Exhaust Gas Recirculation 2 (EGR2) valve 2 opening.";
CM_ SG_ 3221225472 EngExhstGsRcrculation2ValveCtrl "Desired percentage of maximum Exhaust Gas Recirculation 2 (EGR2) valve opening.";
CM_ SG_ 3221225472 DslPrtclateFilter1SootSignalMin "Minimum output signal level of the current soot measurement from diesel particulate filter 1 soot sensor.";
CM_ SG_ 3221225472 DslPrtclateFilter1SootSignalMax "Maximum output signal level of the current soot measurement from diesel particulate filter 1 soot sensor.";
CM_ SG_ 3221225472 DslPrtcltFltr1StSgnlStndrdDvton "Standard deviation of the soot measurement from diesel particulate filter 1 soot sensor.";
CM_ SG_ 3221225472 DslPrtclateFilter2SootSignalMin "Minimum output signal level of the current soot measurement from diesel particulate filter 2 soot sensor.";
CM_ SG_ 3221225472 DslPrtclateFilter2SootSignalMax "Maximum output signal level of the current soot measurement from diesel particulate filter 2 soot sensor.";
CM_ SG_ 3221225472 DslPrtcltFltr2StSgnlStndrdDvton "Standard deviation of the soot measurement from diesel particulate filter 2 soot sensor.";
CM_ SG_ 3221225472 EngChrgArClr1PrcoolerEfficiency "Engine charge air cooler 1 (CAC1) precooler efficiency is an indication of the precooler's ability to reduce the temperature";
CM_ SG_ 3221225472 EngChrgArClr1PrcoolerOutletTemp "Temperature of the combustion air measured at the charge air cooler 1 precooler outlet.";
CM_ SG_ 3221225472 EngChrgArClr1PrcoolerIntakeTemp "Temperature of the combustion air measured at the charge air cooler 1 precooler intake.";
CM_ SG_ 3221225472 EngChargeAirCooler1Efficiency "Engine charge air cooler 1(CAC1) efficiency is an indication of the CAC's ability to reduce the temperature of the";
CM_ SG_ 3221225472 EngChrgAirCooler1AmbientAirTemp "Temperature of the air surrounding charge air cooler 1.";
CM_ SG_ 3221225472 EngChargeAirCooler1IntakeTemp "Temperature of the combustion air measured at the CAC 1 Intake.";
CM_ SG_ 3221225472 EngChrgArClr2PrcoolerEfficiency "Engine charge air cooler 2 (CAC2) precooler efficiency is an indication of the precooler's ability to reduce the temperature";
CM_ SG_ 3221225472 EngChrgArClr2PrcoolerOutletTemp "Temperature of the combustion air measured at the charge air cooler 2 precooler outlet.";
CM_ SG_ 3221225472 EngChrgArClr2PrcoolerIntakeTemp "Temperature of the combustion air measured at the charge air cooler 2 precooler Intake.";
CM_ SG_ 3221225472 EngChargeAirCooler2Efficiency "Engine charge air cooler 2 (CAC2) is an indication of the CAC's ability to reduce the temperature of the combustion air";
CM_ SG_ 3221225472 EngChrgAirCooler2AmbientAirTemp "Temperature of the air surrounding charge air cooler 2.";
CM_ SG_ 3221225472 EngChargeAirCooler2OutletTemp "Temperature of combustion air after it exits from the Charge Air Cooler 2 but before any mixing of recirculated exhaust";
CM_ SG_ 3221225472 EngChargeAirCooler2IntakeTemp "Temperature of the combustion air measured at the charge air cooler 2 Intake.";
CM_ SG_ 3221225472 EngTrbCmprssrBypssActtr2OprtnStt "Used to identify the status of Engine Turbocharger Compressor Bypass Actuator 2";
CM_ SG_ 3221225472 EngTrbCmprssrBypssActtr1OprtnStt "Used to identify the status of Engine Turbocharger Compressor Bypass Actuator 1";
CM_ SG_ 3221225472 EngTrbCmprssrBypssActtr2TmpStts "Used to identify the status of the Engine Turbocharger Compresssor Bypass Actuator 2 drive circuitry temperature.";
CM_ SG_ 3221225472 EngTrbCmprssrBypssActtr2PrlmnryF "Used to identify the applicable J1939-73 FMI detected in the Engine Turbocharger Compressor Bypass Actuator 1 by the";
CM_ SG_ 3221225472 EngDsrdTrbCmprssrBypssActtr2Pos "The desired position of the Engine Turbocharger Compressor Bypass actuator 2 by the engine ECM, where 0%";
CM_ SG_ 3221225472 EngTrbCmprssrBypassActuator2Pos "Measures the position of the turbocharger compressor bypass actuator 2, where 0% represents bypass fully closed and";
CM_ SG_ 3221225472 EngFuelValve2OperationStatus "Used to identify the status of Engine Fuel Valve 2";
CM_ SG_ 3221225472 EngFuelValve1OperationStatus "Used to identify the status of Engine Fuel Valve 1";
CM_ SG_ 3221225472 EngThrttleValve2OperationStatus "Used to identify the status of Engine Throttle Valve 2";
CM_ SG_ 3221225472 EngThrttleValve1OperationStatus "Used to identify the status of Engine Throttle Valve 1";
CM_ SG_ 3221225472 EngFuelValve2TempStatus "Used to identify the status of the Engine Fuel valve 2 drive circuitry temperature.";
CM_ SG_ 3221225472 EngFuelValve2PreliminaryFMI "Used to identify the applicable J1939-73 FMI detected in the Engine Fuel Valve 2 by the manufacturers software.";
CM_ SG_ 3221225472 EngFuelValve1TempStatus "Used to identify the status of the Engine Fuel valve 1 drive circuitry temperature.";
CM_ SG_ 3221225472 EngFuelValve1PreliminaryFMI "Used to identify the applicable J1939-73 FMI detected in the Engine Fuel Valve 1 by the manufacturers software.";
CM_ SG_ 3221225472 EngThrottleValve2TempStatus "Used to identify the status of the Engine Throttle Valve 2 drive circuitry temperature.";
CM_ SG_ 3221225472 EngThrottleValve2PreliminaryFMI "Used to identify the applicable J1939-73 FMI detected in the Engine Throttle Valve 2 by the manufacturers software.";
CM_ SG_ 3221225472 EngDesiredThrottleValve2Pos "The desired position of the Throttle valve 2 that is regulating the fluid, usually air/fuel mixture to the engine as";
CM_ SG_ 3221225472 EngThrottleValve1TempStatus "Used to identify the status of the Engine Throttle Valve 1 drive circuitry temperature.";
CM_ SG_ 3221225472 EngThrottleValve1PreliminaryFMI "Used to identify the appplicable J1939-73 FMI detected in the Engine Throttle Valve 1 by the manufacturers software.";
CM_ SG_ 3221225472 EngDesiredThrottleValve1Pos "The desired position of the Throttle valve 1 that is regulating the fluid, usually air/fuel mixture to the engine as";
CM_ SG_ 3221225472 EngTrbWstgtActtr2OprationStatus "Used to identify the status of Engine Turbocharger Wastegate Actuator 2";
CM_ SG_ 3221225472 EngTrbWstgtActtr1OprationStatus "Used to identify the status of Engine Turbocharger Wastegate Actuator 1";
CM_ SG_ 3221225472 EngTrbWstgteActuator2TempStatus "Used to identify the status of the Engine Turbocharger Wastegate Actuator 2 drive circuitry temperature.";
CM_ SG_ 3221225472 EngTrbWstgtActtr2PreliminaryFMI "Used to identify the applicable J1939-73 FMI detected in the Engine Turbocharger Wastegate Actuator 2 by the";
CM_ SG_ 3221225472 EngFuelFilterIntakeAbsPress "Absolute pressure of fuel at the intake of the fuel filter (suction side) located between the fuel tank and the fuel supply";
CM_ SG_ 3221225472 EngExhstGsRcrcltn1IntkeAbsPress "EGR intake absolute pressure measured before the EGR 1 valve.";
CM_ SG_ 3221225472 BldRferenceElevationOffsetRight "Indicates the blade's right elevation offset with respect to the reference elevation.";
CM_ SG_ 3221225472 BldReferenceElevationOffsetLeft "Indicates the blade's left elevation offset with respect to the reference elevation.";
CM_ SG_ 3221225472 BladeElevationDeviationRight "Indicate the blade's right elevation deviation with respect to the reference elevation.";
CM_ SG_ 3221225472 BladeElevationDeviationLeft "Indicate the blade's left elevation deviation with respect to the reference elevation.";
CM_ SG_ 3221225472 Aftrtrtmnt2WrmUpDslOxdtnCtlystOt "Temperature of engine combustion byproducts leaving the warm up Diesel Oxidation Catalyst in exhaust bank 2.";
CM_ SG_ 3221225472 Aftrtrtmnt2WrmUpDslOxdtnCtlystIn "Temperature of engine combustion byproducts entering the warm up Diesel Oxidation Catalyst in exhaust bank 2.";
CM_ SG_ 3221225472 Aftrtrtmnt1NOxAdsrbrDSOxRgnrtnSt "Indicates whether the NOx adsorber deSOx regeneration in the first aftertreatment system is active or inactive";
CM_ SG_ 3221225472 Aftrtrtmnt1NOxAdsrbrDNOxRgnrtnSt "Indicates whether the NOx adsorber deNOx regeneration in the first aftertreatment system is active or inactive";
CM_ SG_ 3221225472 Aftrtrtmnt2NOxAdsrbrDSOxRgnrtnSt "Indicates whether the NOx adsorber deSOx regeneration in the second aftertreatment system is active or inactive";
CM_ SG_ 3221225472 Aftrtrtmnt2NOxAdsrbrDNOxRgnrtnSt "Indicates whether the NOx adsorber deNOx regeneration in the second aftertreatment system is active or inactive";
CM_ SG_ 3221225472 HybrdBatteryPackRemainingCharge "Indicates the hybrid battery pack remaining charge.";
CM_ SG_ 3221225472 ArmrestSwitchMatrix2Switch2 "Second switch input matrix for the second module located in the armrest";
CM_ SG_ 3221225472 ArmrestSwitchMatrix2Switch1 "Switch input matrix for the second module located in the armrest";
CM_ SG_ 3221225472 ArmrestSwitchMatrixSwitch2 "Second switch input matrix for the module located in the armrest";
CM_ SG_ 3221225472 ArmrestSwitchMatrixSwitch1 "Switch input matrix for the module located in the armrest";
CM_ SG_ 3221225472 IntkVlvActtnSystmOlPrss2SlndCtrl "Indicates the current command to the solenoid that controls the intake valve actuation system oil pressure 2 valve.";
CM_ SG_ 3221225472 IntkVlvActtnSystmOlPrss1SlndCtrl "Indicates the current command to the solenoid that controls the intake valve actuation system oil pressure 1 valve.";
CM_ SG_ 3221225472 EngFrctnPrcntTorqueAtIdlePoint7 "The static portion of the friction torque at speed point 7 (SPN 533) of the engine torque map in the engine configuration";
CM_ SG_ 3221225472 EngFrctnPrcntTorqueAtIdlePoint6 "For engine configuration map modes 1 and 2, this is the static portion of the friction torque at speed point 6 (SPN 532) of";
CM_ SG_ 3221225472 EngFrctnPrcntTorqueAtIdlePoint5 "The static portion of the friction torque at speed point 5 (SPN 531) of the engine torque map in the engine configuration";
CM_ SG_ 3221225472 EngFrctnPrcntTorqueAtIdlePoint4 "The static portion of the friction torque at speed point 4 (SPN 530) of the engine torque map in the engine configuration";
CM_ SG_ 3221225472 EngFrctnPrcntTorqueAtIdlePoint3 "The static portion of the friction torque at speed point 3 (SPN 529) of the engine torque map in the engine configuration";
CM_ SG_ 3221225472 EngFrctnPrcntTorqueAtIdlePoint2 "The static portion of the friction torque at speed point 2 (SPN 528) of the engine torque map in the engine configuration";
CM_ SG_ 3221225472 EngFrctnPrcntTorqueAtIdlePoint1 "The static portion of the friction torque at speed point 1 (SPN 188) of the engine torque map in the engine configuration";
CM_ SG_ 3221225472 EngTurboWastegateActuator2Cmd "The command to a Turbocharger Wastegate actuator 2, normalized to percent, where 0% nominally represents fully";
CM_ SG_ 3221225472 EngTurboWastegateActuator1Cmd "The ccommand to a Turbocharger Wastegate actuator 1, normalized to percent, where 0% nominally represents fully";
CM_ SG_ 3221225472 SpprtVrblTrnsRpttnRtFrAcclrtnSns "Indicates which acceleration transmission rate are supported by the ECU in addition to the required 10 ms transmission";
CM_ SG_ 3221225472 VrtclAcclrtnExRngeFigureOfMerit "Figure of merit for vertical acceleration measurement.";
CM_ SG_ 3221225472 LngtdnlAcclrtnExRngFgureOfMerit "Figure of merit for longitudinal acceleration measurement.";
CM_ SG_ 3221225472 LtrlAcclrtnExRangeFigureOfMerit "Figure of merit for lateral acceleration measurement.";
CM_ SG_ 3221225472 VerticalAccelerationExRange "Indicates vertical acceleration of the vehicle and the effect of gravity.";
CM_ SG_ 3221225472 LateralAccelerationExRange "Indicates lateral acceleration of the vehicle.";
CM_ SG_ 3221225472 LongitudinalAccelerationExRange "Indicates longitudinal acceleration of the vehicle.";
CM_ SG_ 3221225472 DropRelayCtrl "Command signal used to Engage and Disengage the Drop Relay controlling a Steady-State Magnet.";
CM_ SG_ 3221225472 LiftRelayCtrl "Command signal used to Engage and Disengage the Lift Relay controlling a Steady-State Magnet.";
CM_ SG_ 3221225472 MaterialDropActiveStatus "The status of Material Drop Relay.";
CM_ SG_ 3221225472 MaterialLiftActiveStatus "The status of Material Lift Relay.";
CM_ SG_ 3221225472 GnratorCurrentBoostActiveStatus "Status of generator current boost relay that can boost the generator output current for picking-up material operations.";
CM_ SG_ 3221225472 MaterialDropSwitch "This is a switch that can be used to enable the drop functionality of the Material Handler machine.";
CM_ SG_ 3221225472 MaterialLiftSwitch "This is a switch that can be used to enable the lift functionality of the Material Handler machine.";
CM_ SG_ 3221225472 MagnetReverseCurrent "A reverse current being supplied to the electric magnet to reduce the forward current generated magnet field as quick as";
CM_ SG_ 3221225472 MagnetForwardCurrent "The forward current being supplied by the generator to the electric magnet to create a magnet field to lift material.";
CM_ SG_ 3221225472 CrashChecksum "The Crash Checksum is used to verify the signal path from the airbag ECU to other devices in case of a crash.";
CM_ SG_ 3221225472 CrashCounter "The Crash Counter prevents other ECUs from reacting to a faulty transmission of the Crash Notification PGN and serves";
CM_ SG_ 3221225472 CrashType "Type of crash event.";
CM_ SG_ 3221225472 AngularRateMeasurementLatency "The estimated measurement latency of the measurement.";
CM_ SG_ 3221225472 YawRateExRangeFigureOfMerit "Figure of merit for yaw angle measurement.";
CM_ SG_ 3221225472 RollRateExRangeFigureOfMerit "Figure of merit for roll angle measurement.";
CM_ SG_ 3221225472 PitchRateExRangeFigureOfMerit "Figure of merit for pitch angle measurement.";
CM_ SG_ 3221225472 YawRateExRange "Yaw rate is the rate-of-change of the yaw angle over time.";
CM_ SG_ 3221225472 RollRateExRange "Roll rate is the rate-of-change of the roll angle over time.";
CM_ SG_ 3221225472 PitchRateExRange "Pitch rate is the rate-of-change of the pitch angle over time, where the pitch angle vector is in the direction of travel of the";
CM_ SG_ 3221225472 RllAndPtchExRngMsurementLatency "Time between start of sensor processing and CAN transmission";
CM_ SG_ 3221225472 RollAngleExRangeFigureOfMerit "Figure of merit for roll angle measurement.";
CM_ SG_ 3221225472 RollAngleExRangeCompensation "Compensated mode for the roll measurement.";
CM_ SG_ 3221225472 PitchAngleExRangeFigureOfMerit "Figure of merit for pitch angle measurement.";
CM_ SG_ 3221225472 PitchAngleExRangeCompensation "Compensated mode for the pitch measurement.";
CM_ SG_ 3221225472 RollAngleExRange "The angle between the vehicle y-axis and the ground plane.";
CM_ SG_ 3221225472 PitchAngleExRange "The angle between the vehicle x-axis and the ground plane.";
CM_ SG_ 3221225472 Aftrtrtmnt2OtltNH3GsSnsrHtrCtrl "Indicates the heater status in the warm-up process.";
CM_ SG_ 3221225472 Aftrtrtmnt2OtltNH3GsSnsrHtrPrlmn "Used to identify the applicable J1939-73 FMI detected in the heater of the outlet NH3 exhaust gas sensor by the";
CM_ SG_ 3221225472 Aftrtrtmnt2OtltNH3GsSnsorAtTemp "Indicates that the heater element of the aftertreatment outlet NH3 gas sensor is within the manufacturer's specified range";
CM_ SG_ 3221225472 Aftrtrtmnt2OtltNH3GsSnsrPwrInRng "Indicates that the power supplied to the aftertreatment outlet NH3 gas sensor is within the manufacturer's specification in";
CM_ SG_ 3221225472 Aftrtrtmnt2OtltNH3ReadingStable "Indicates that the NH3 reading of the aftertreatment outlet NH3 sensor is stable as determined by the manufacturer's";
CM_ SG_ 3221225472 Aftrtrtmnt2OtltNH3SnsrPrlmnryFMI "Used to identify the applicable J1939-73 FMI detected in the aftertreatment outlet NH3 sensor by the manufacturer's";
CM_ SG_ 3221225472 Aftertreatment2OutletNH3 "The amount of NH3 in the exhaust exiting the aftertreatment system measured by a NH3 sensor at the aftertreatment";
CM_ SG_ 3221225472 Aftrtrtmnt2SCRRqdRgntQnttyFrIntg "Represents the command for the reducing agent quantity integrator in the dosing control unit";
CM_ SG_ 3221225472 Aftrtratment2SCRSystemRqedState "Requested state of SCR system for aftertreatment system 2 (exhaust bank 2).";
CM_ SG_ 3221225472 Aftrtrtmnt2SCRRqdDsngRgntQntity "Actual requested dosing quantity of catalyst reagent";
CM_ SG_ 3221225472 Aftrtrtmnt2SCRDsngRgentAbsPress "The SCR dosing reagent absolute pressure (measured closest to dosing valve) for aftertreatment system 2 (exhaust bank";
CM_ SG_ 3221225472 Aftrtrtmnt2SCRActlRgntQnttyOfInt "The SCR requested reagent integrator total quantity for aftertreatment system 2 (exhaust bank 2).";
CM_ SG_ 3221225472 Aftertreatment2SCRSystemState "Actual state of SCR system";
CM_ SG_ 3221225472 Aftrtrtmnt2SCRActlDsngRgntQntty "Actual reducing agent quantity of SCR system.";
CM_ SG_ 3221225472 Aftrtrtmnt1OtltNH3GsSnsrHtrCtrl "Indicates the heater status in the warm-up process.";
CM_ SG_ 3221225472 Aftrtrtmnt1OtltNH3GsSnsrHtrPrlmn "Used to identify the applicable J1939-73 FMI detected in the heater of the outlet NH3 exhaust gas sensor by the";
CM_ SG_ 3221225472 Aftrtrtmnt1OtltNH3GsSnsorAtTemp "Indicates that the heater element of the aftertreatment outlet NH3 gas sensor is within the manufacturer's specified range";
CM_ SG_ 3221225472 Aftrtrtmnt1OtltNH3GsSnsrPwrInRng "Indicates that the power supplied to the aftertreatment outlet NH3 gas sensor is within the manufacturer's specification in";
CM_ SG_ 3221225472 Aftrtrtmnt1OtltNH3ReadingStable "Indicates that the NH3 reading of the aftertreatment outlet NH3 sensor is stable as determined by the manufacturer's";
CM_ SG_ 3221225472 Aftrtrtmnt1OtltNH3SnsrPrlmnryFMI "Used to identify the applicable J1939-73 FMI detected in the aftertreatment outlet NH3 sensor by the manufacturer's";
CM_ SG_ 3221225472 Aftertreatment1OutletNH3 "The amount of NH3 in the exhaust exiting the aftertreatment system measured by a NH3 sensor at the aftertreatment";
CM_ SG_ 3221225472 Aftrtrtmnt1SCRRqdRgntQnttyFrIntg "Represents the command for the reducing agent quantity integrator in the dosing control unit";
CM_ SG_ 3221225472 Aftrtratment1SCRSystemRqedState "Requested state of SCR system for aftertreatment system 1 (exhaust bank 1).";
CM_ SG_ 3221225472 Aftrtrtmnt1SCRRqdDsngRgntQntity "Actual requested dosing quantity of catalyst reagent";
CM_ SG_ 3221225472 Aftrtrtmnt1SCRDsngRgentAbsPress "The SCR dosing reagent absolute pressure (measured closest to dosing valve) for aftertreatment system 1 (exhaust bank";
CM_ SG_ 3221225472 Aftrtrtmnt1SCRActlRgntQnttyOfInt "The SCR requested reagent integrator total quantity for aftertreatment system 1 (exhaust bank 1).";
CM_ SG_ 3221225472 Aftertreatment1SCRSystemState "Actual state of SCR system";
CM_ SG_ 3221225472 Aftrtrtmnt1SCRActlDsngRgntQntty "Actual reducing agent quantity of SCR-system";
CM_ SG_ 3221225472 EngSpdSnsor1TimingPatternStatus "This is the timing pattern status of the engine speed sensor signal for sensor 1.";
CM_ SG_ 3221225472 EngSpdSnsor2TimingPatternStatus "This is the timing pattern status of the engine speed sensor signal for sensor 2.";
CM_ SG_ 3221225472 EngSpdSnsor3TimingPatternStatus "This is the timing pattern status of the engine speed sensor signal for sensor 3.";
CM_ SG_ 3221225472 EngSpeed3 "The engine speed as measured by speed sensor 3.";
CM_ SG_ 3221225472 EngSpeed2 "The engine speed as measured by speed sensor 2";
CM_ SG_ 3221225472 EngSpeed1 "The engine speed as measured by speed sensor 1.";
CM_ SG_ 3221225472 SteerAngleSensorCalibrated "This signal indicates the calibration status of the steering angle sensor.";
CM_ SG_ 3221225472 SteerAngleSensorActiveMode "This signal indicates the operational mode of the steering angle sensor.";
CM_ SG_ 3221225472 SteerWheelAngleRange "The signal indicates the range of the steering wheel angle the sensor element is capable to measure.";
CM_ SG_ 3221225472 SteerWheelAngleRangeCounterType "The signal indicates whether the steering wheel angle sensor is capable of absolute measuring of the number of steering";
CM_ SG_ 3221225472 SteerWheelAngleRangeCounter "The signal indicates the number of steering wheel angle range overflows if the operating range of steering wheel is";
CM_ SG_ 3221225472 RqdGnrtrAvrgLneLineACRMSVoltage "The requested average AC RMS voltage to be delivered by the generator.";
CM_ SG_ 3221225472 EngThrottleActuator2CtrlCmd "The control command to throttle actuator 2, normalized to percent, where 0% represents fully closed and 100%";
CM_ SG_ 3221225472 EngThrottleActuator1CtrlCmd "The control command to throttle actuator 1, normalized to percent, where 0% represents fully closed and 100%";
CM_ SG_ 3221225472 EngFuelActuator2CtrlCmd "The control command to fuel actuator 2, normalized to percent, where 0% represents fully closed and 100% represents";
CM_ SG_ 3221225472 EngFuelActuator1CtrlCmd "The control command to fuel actuator 1, normalized to percent, where 0% represents fully closed and 100% represents";
CM_ SG_ 3221225472 EngCyl24KnockLevel "Used to indicate the level of knock for engine cylinder 24.";
CM_ SG_ 3221225472 EngCyl23KnockLevel "Used to indicate the level of knock for engine cylinder 23.";
CM_ SG_ 3221225472 EngCyl22KnockLevel "Used to indicate the level of knock for engine cylinder 22.";
CM_ SG_ 3221225472 EngCyl21KnockLevel "Used to indicate the level of knock for engine cylinder 21.";
CM_ SG_ 3221225472 EngCyl20KnockLevel "Used to indicate the level of knock for engine cylinder 20.";
CM_ SG_ 3221225472 EngCyl19KnockLevel "Used to indicate the level of knock for engine cylinder 19.";
CM_ SG_ 3221225472 EngCyl18KnockLevel "Used to indicate the level of knock for engine cylinder 18.";
CM_ SG_ 3221225472 EngCyl17KnockLevel "Used to indicate the level of knock for engine cylinder 17.";
CM_ SG_ 3221225472 EngCyl15KnockLevel "Used to indicate the level of knock for engine cylinder 15.";
CM_ SG_ 3221225472 EngCyl14KnockLevel "Used to indicate the level of knock for engine cylinder 14.";
CM_ SG_ 3221225472 EngCyl13KnockLevel "Used to indicate the level of knock for engine cylinder 13.";
CM_ SG_ 3221225472 EngCyl12KnockLevel "Used to indicate the level of knock for engine cylinder 12.";
CM_ SG_ 3221225472 EngCyl11KnockLevel "Used to indicate the level of knock for engine cylinder 11.";
CM_ SG_ 3221225472 EngCyl10KnockLevel "Used to indicate the level of knock for engine cylinder 10.";
CM_ SG_ 3221225472 EngCyl9KnockLevel "Used to indicate the level of knock for engine cylinder 9.";
CM_ SG_ 3221225472 EngCyl16KnockLevel "Used to indicate the level of knock for engine cylinder 16.";
CM_ SG_ 3221225472 EngCyl8KnockLevel "Used to indicate the level of knock for engine cylinder 8.";
CM_ SG_ 3221225472 EngCyl7KnockLevel "Used to indicate the level of knock for engine cylinder 7.";
CM_ SG_ 3221225472 EngCyl6KnockLevel "Used to indicate the level of knock for engine cylinder 6.";
CM_ SG_ 3221225472 EngCyl5KnockLevel "Used to indicate the level of knock for engine cylinder 5.";
CM_ SG_ 3221225472 EngCyl4KnockLevel "Used to indicate the level of knock for engine cylinder 4.";
CM_ SG_ 3221225472 EngCyl3KnockLevel "Used to indicate the level of knock for engine cylinder 3.";
CM_ SG_ 3221225472 EngCyl2KnockLevel "Used to indicate the level of knock for engine cylinder 2.";
CM_ SG_ 3221225472 EngCyl1KnockLevel "Used to indicate the level of knock for engine cylinder 1.";
CM_ SG_ 3221225472 EngCyl9CombustionStatus "This parameter is used to indicate state of combustion in engine cylinder #9";
CM_ SG_ 3221225472 EngCyl8CombustionStatus "This parameter is used to indicate state of combustion in engine cylinder #8";
CM_ SG_ 3221225472 EngCyl7CombustionStatus "This parameter is used to indicate state of combustion in engine cylinder #7";
CM_ SG_ 3221225472 EngCyl6CombustionStatus "This parameter is used to indicate state of combustion in engine cylinder #6";
CM_ SG_ 3221225472 EngCyl5CombustionStatus "This parameter is used to indicate state of combustion in engine cylinder #5";
CM_ SG_ 3221225472 EngCyl4CombustionStatus "This parameter is used to indicate state of combustion in engine cylinder #4";
CM_ SG_ 3221225472 EngCyl3CombustionStatus "This parameter is used to indicate state of combustion in engine cylinder #3";
CM_ SG_ 3221225472 EngCyl2CombustionStatus "This parameter is used to indicate state of combustion in engine cylinder #2";
CM_ SG_ 3221225472 EngCyl24CombustionStatus "This parameter is used to indicate state of combustion in engine cylinder #24";
CM_ SG_ 3221225472 EngCyl23CombustionStatus "This parameter is used to indicate state of combustion in engine cylinder #23";
CM_ SG_ 3221225472 EngCyl22CombustionStatus "This parameter is used to indicate state of combustion in engine cylinder #22";
CM_ SG_ 3221225472 EngCyl21CombustionStatus "This parameter is used to indicate state of combustion in engine cylinder #21";
CM_ SG_ 3221225472 EngCyl20CombustionStatus "This parameter is used to indicate state of combustion in engine cylinder #20";
CM_ SG_ 3221225472 EngCyl1CombustionStatus "This parameter is used to indicate state of combustion in engine cylinder #1";
CM_ SG_ 3221225472 EngCyl19CombustionStatus "This parameter is used to indicate state of combustion in engine cylinder #19";
CM_ SG_ 3221225472 EngCyl18CombustionStatus "This parameter is used to indicate state of combustion in engine cylinder #18";
CM_ SG_ 3221225472 EngCyl17CombustionStatus "This parameter is used to indicate state of combustion in engine cylinder #17";
CM_ SG_ 3221225472 EngCyl16CombustionStatus "This parameter is used to indicate state of combustion in engine cylinder #16";
CM_ SG_ 3221225472 EngCyl15CombustionStatus "This parameter is used to indicate state of combustion in engine cylinder #15";
CM_ SG_ 3221225472 EngCyl14CombustionStatus "This parameter is used to indicate state of combustion in engine cylinder #14";
CM_ SG_ 3221225472 EngCyl13CombustionStatus "This parameter is used to indicate state of combustion in engine cylinder #13";
CM_ SG_ 3221225472 EngCyl12CombustionStatus "This parameter is used to indicate state of combustion in engine cylinder #12";
CM_ SG_ 3221225472 EngCyl11CombustionStatus "This parameter is used to indicate state of combustion in engine cylinder #11";
CM_ SG_ 3221225472 EngCyl10CombustionStatus "This parameter is used to indicate state of combustion in engine cylinder #10";
CM_ SG_ 3221225472 RqGenOverallPowerFactorLagging "The requested lead/lag status for the generator average AC power factor";
CM_ SG_ 3221225472 RqGeneratorOverallPowerFactor "The requested average power factor of the generator.";
CM_ SG_ 3221225472 RqGeneratorTotalACReactivePower "The total reactive power requested to be delivered by the generator";
CM_ SG_ 3221225472 RltvBldHghtAndBldRttnAnglMsrmntL "The estimated measurement latency of the measurement.";
CM_ SG_ 3221225472 RlativeBladeHeightFigureOfMerit "Figure of merit for blade height measurement.";
CM_ SG_ 3221225472 BladeRotationAngleFigureOfMerit "Figure of merit for blade rotation measurement.";
CM_ SG_ 3221225472 BladeRotationAngle "The blade rotation angle measurement around the yaw (z-axis).";
CM_ SG_ 3221225472 RelativeBladeHeight "The measured vertical distance from a fixed location on the machine blade to a ground-based reference.";
CM_ SG_ 3221225472 RollAndPitchMeasurementLatency "The estimated measurement latency of the measurement.";
CM_ SG_ 3221225472 PitchAndRollCompensated "Compensated mode for the pitch and roll measurements.";
CM_ SG_ 3221225472 PitchRateFigureOfMerit "Figure of merit for the pitch rate measurement.";
CM_ SG_ 3221225472 RollAngleFigureOfMerit "Figure of merit for roll angle measurement.";
CM_ SG_ 3221225472 PitchAngleFigureOfMerit "Figure of merit for pitch angle measurement.";
CM_ SG_ 3221225472 PitchRate "Pitch rate is the rate-of-change of the pitch angle over time, where the pitch angle vector is in the direction of travel of the";
CM_ SG_ 3221225472 RollAngle "The angle between the vehicle y-axis and the ground plane.";
CM_ SG_ 3221225472 PitchAngle "The angle between the vehicle x-axis and the ground plane.";
CM_ SG_ 3221225472 FifthWheelRollWarningIndicator "Indicates to the vehicle operator that the roll moment has exceeded a preset limit.";
CM_ SG_ 3221225472 FifthWheelRollMoment "Fifth wheel roll moment force - If the moment is positive, the trailer is rolling clockwise relative to the normal vehicle";
CM_ SG_ 3221225472 FifthWheelDrawbarForce "Fifth wheel drawbar force, with the trailer held stationary a positive force is generated by the vehicle pulling forward.";
CM_ SG_ 3221225472 FifthWheelVerticalForce "The amount of load being applied to the fifth wheel by the trailer.";
CM_ SG_ 3221225472 Aftrtrtmnt2OtltOxygnSnsrPrlmnryF "Used to identify the applicable J1939-73 FMI detected in the aftertreatment outlet oxygen sensor by the manufacturer's";
CM_ SG_ 3221225472 Aftrtrtmnt2OtltGsSnsrPwerStatus "Indicates that the power supplied to the aftertreatment outlet gas sensor, either NOx or O2, is within the manufacturer's";
CM_ SG_ 3221225472 Aftrtrtmnt2OtltGsSnsrHtrPrlmnryF "Used to identify the applicable J1939-73 FMI detected in the heater of the outlet exhaust gas sensor, either NOx or O2, by";
CM_ SG_ 3221225472 Aftrtrtmnt2OtltNOxSnsrPrlmnryFMI "Used to identify the applicable J1939-73 FMI detected in the aftertreatment outlet NOx sensor by the manufacturer's";
CM_ SG_ 3221225472 Aftrtrtmnt2OtltGsSnsrHeaterCtrl "Indicates the heater status in the warm-up process.";
CM_ SG_ 3221225472 Aftrtrtmnt2OtltWdRngO2RdngStble "Indicates that the %O2 reading of the aftertreatment outlet gas sensor, either NOx or O2, is stable as determined by the";
CM_ SG_ 3221225472 Aftrtrtmnt2OtltNOxReadingStable "Indicates that the NOx reading of the aftertreatment outlet NOx sensor is stable as determined by the manufacturer's";
CM_ SG_ 3221225472 Aftrtrtmnt2OtletGasSensorAtTemp "Indicates that the heater element of the aftertreatment outlet gas sensor, either NOx or O2, is within the manufacturer's";
CM_ SG_ 3221225472 Aftertreatment2OutletO2 "The actual oxidation factor (%O2) of the gas within the exhaust stream.";
CM_ SG_ 3221225472 Aftertreatment2OutletNOx "The amount of combined NO and NO2 in the exhaust entering the aftertreatment system measured by a NOx sensor at";
CM_ SG_ 3221225472 Aftrtrtmnt2IntkOxygnSnsrPrlmnryF "Used to identify the applicable J1939-73 FMI detected in the aftertreatment intake oxygen sensor by the manufacturer's";
CM_ SG_ 3221225472 Aftrtrtmnt2IntkGsSnsrPwerStatus "Indicates that the power supplied to the aftertreatment intake gas sensor, either NOx or O2, is within the manufacturer's";
CM_ SG_ 3221225472 Aftrtrtmnt2IntkGsSnsrHtrPrlmnryF "Used to identify the applicable J1939-73 FMI detected in the heater of the intake exhaust gas sensor, either NOx or O2,";
CM_ SG_ 3221225472 Aftrtrtmnt2IntkNOxSnsrPrlmnryFMI "Used to identify the applicable J1939-73 FMI detected in the aftertreatment intake NOx sensor by the manufacturer's";
CM_ SG_ 3221225472 Aftrtrtmnt2IntkGsSnsrHeaterCtrl "Indicates the heater status in the warm-up process.";
CM_ SG_ 3221225472 Aftrtrtmnt2IntkWdRngO2RdngStble "Indicates that the %O2 reading of the aftertreatment intake gas sensor, either NOx or O2, is stable as determined by the";
CM_ SG_ 3221225472 Aftrtrtmnt2IntkNOxReadingStable "Indicates that the NOx reading of the aftertreatment intake NOx sensor is stable as determined by the manufacturer's";
CM_ SG_ 3221225472 Aftrtrtmnt2IntkeGasSensorAtTemp "Indicates that the heater element of the aftertreatment intake gas sensor, either NOx or O2, is within the manufacturer's";
CM_ SG_ 3221225472 Aftertreatment2IntakeO2 "The actual oxidation factor (%O2) of the gas within the exhaust stream.";
CM_ SG_ 3221225472 Aftertreatment2IntakeNOx "The amount of combined NO and NO2 in the exhaust entering the aftertreatment system measured by a NOx sensor at";
CM_ SG_ 3221225472 Aftrtrtmnt1OtltOxygnSnsrPrlmnryF "Used to identify the applicable J1939-73 FMI detected in the aftertreatment outlet oxygen sensor by the manufacturer's";
CM_ SG_ 3221225472 Aftrtrtmnt1OtltGsSnsrPwerStatus "Indicates that the power supplied to the aftertreatment outlet gas sensor, either NOx or O2, is within the manufacturer's";
CM_ SG_ 3221225472 Aftrtrtmnt1OtltGsSnsrHtrPrlmnryF "Used to identify the applicable J1939-73 FMI detected in the heater of the outlet exhaust gas sensor, either NOx or O2, by";
CM_ SG_ 3221225472 Aftrtrtmnt1OtltNOxSnsrPrlmnryFMI "Used to identify the applicable J1939-73 FMI detected in the aftertreatment outlet NOx sensor by the manufacturer's";
CM_ SG_ 3221225472 Aftrtrtmnt1OtltGsSnsrHeaterCtrl "Indicates the heater status in the warm-up process.";
CM_ SG_ 3221225472 Aftrtrtmnt1OtltWdRngO2RdngStble "Indicates that the %O2 reading of the aftertreatment outlet gas sensor, either NOx or O2, is stable as determined by the";
CM_ SG_ 3221225472 Aftrtrtmnt1OtltNOxReadingStable "Indicates that the NOx reading of the aftertreatment outlet NOx sensor is stable as determined by the manufacturer's";
CM_ SG_ 3221225472 Aftrtrtmnt1OtletGasSensorAtTemp "Indicates that the heater element of the aftertreatment outlet gas sensor, either NOx or O2, is within the manufacturer's";
CM_ SG_ 3221225472 Aftertreatment1OutletO2 "The actual oxidation factor (%O2) of the gas within the exhaust stream.";
CM_ SG_ 3221225472 Aftertreatment1OutletNOx "The amount of combined NO and NO2 in the exhaust entering the aftertreatment system measured by a NOx sensor at";
CM_ SG_ 3221225472 Aftrtrtmnt1IntkOxygnSnsrPrlmnryF "Used to identify the applicable J1939-73 FMI detected in the aftertreatment intake oxygen sensor by the manufacturer's";
CM_ SG_ 3221225472 Aftrtrtmnt1IntkGsSnsrPwerStatus "Indicates that the power supplied to the aftertreatment intake gas sensor, either NOx or O2, is within the manufacturer's";
CM_ SG_ 3221225472 Aftrtrtmnt1IntkGsSnsrHtrPrlmnryF "Used to identify the applicable J1939-73 FMI detected in the heater of the intake exhaust gas sensor, either NOx or O2,";
CM_ SG_ 3221225472 Aftrtrtmnt1IntkNOxSnsrPrlmnryFMI "Used to identify the applicable J1939-73 FMI detected in the aftertreatment intake NOx sensor by the manufacturer's";
CM_ SG_ 3221225472 Aftrtrtmnt1IntkGsSnsrHeaterCtrl "Indicates the heater status in the warm-up process.";
CM_ SG_ 3221225472 Aftrtrtmnt1IntkWdRngO2RdngStble "Indicates that the %O2 reading of the aftertreatment intake gas sensor, either NOx or O2, is stable as determined by the";
CM_ SG_ 3221225472 Aftrtrtmnt1IntkNOxReadingStable "Indicates that the NOx reading of the aftertreatment intake NOx sensor is stable as determined by the manufacturer's";
CM_ SG_ 3221225472 Aftrtrtmnt1IntkeGasSensorAtTemp "Indicates that the heater element of the aftertreatment intake gas sensor, either NOx or O2, is within the manufacturer's";
CM_ SG_ 3221225472 Aftertreatment1IntakeO2 "The actual oxidation factor (%O2) of the gas within the exhaust stream.";
CM_ SG_ 3221225472 Aftertreatment1IntakeNOx "The amount of combined NO and NO2 in the exhaust entering the aftertreatment system measured by a NOx sensor at";
CM_ SG_ 3221225472 SdshftDsrdBldOffsetOperatorCtrl "This parameter indicates the side-shift blade control mode operator control state the user has set for the land leveling system.";
CM_ SG_ 3221225472 SdshftBldCtrlMdeOperatorControl "This parameter indicates the side-shift offset operator control state the user has set for the land leveling system.";
CM_ SG_ 3221225472 RghtDsrdBladeOffsetOperatorCtrl "This parameter indicates the right blade offset operator control state the user has set for the land leveling system.";
CM_ SG_ 3221225472 RghtBldeCtrlModeOperatorControl "This parameter indicates the right blade control mode operator control state the user has set for the land leveling system.";
CM_ SG_ 3221225472 LftDsredBladeOffsetOperatorCtrl "This parameter indicates the left blade offset operator control state the user has set for the land leveling system.";
CM_ SG_ 3221225472 LftBladeCtrlModeOperatorControl "This parameter indicates the left blade control mode operator control state the user has set for the land leveling system.";
CM_ SG_ 3221225472 BladeAutoModeCmd "Allows other controllers to command to the primary control system what they think is the appropriate auto control mode to";
CM_ SG_ 3221225472 DesiredGradeOffsetSwitch "This parameter indicates the grade offset switch state the user has set for the land leveling system.";
CM_ SG_ 3221225472 BladeCtrlModeSwitch "This parameter indicates the blade control mode switch state the user has set for the land leveling system.";
CM_ SG_ 3221225472 StElvtnSnsor2ReferenceElevation "Command from a display or other external device (i.";
CM_ SG_ 3221225472 StElvtnSnsor1ReferenceElevation "Command from a display or other external device (i.";
CM_ SG_ 3221225472 TransClutch_ConverterInputSpeed "Rotational velocity of the input to a transmission's master clutch or torque converter.";
CM_ SG_ 3221225472 TransTorqueConverterRatio "Ratio of the transmissions torque converter output torque to torque converter input torque at current speed.";
CM_ SG_ 3221225472 SterableLiftAxleLoweringInhibit "A signal which indicates if lowering of lifted axle is allowed or inhibited.";
CM_ SG_ 3221225472 AxleLocation "To identify to which of several similar devices (such as tires or fuel tanks) the information applies.";
CM_ SG_ 3221225472 TypeOfSteerTrans "Type of Steering Transmission (Ref.";
CM_ SG_ 3221225472 TypeOfSteerForces "Type of Steering Forces (Ref.";
CM_ SG_ 3221225472 SteerType "Indicates the different types of steering systems (ref.";
CM_ SG_ 3221225472 StatusOfSteerAxle "A signal which indicates different states of the steering axle";
CM_ SG_ 3221225472 ActualInnerWheelSteerAngle "Signal which indicates the actual inner wheel steering angle.";
CM_ SG_ 3221225472 Aftrtrtmnt2DslPrtcltFltrIntkGsTm "Used to identify the applicable J1939-73 FMI detected in the diesel particulate filter intake gas temperature sensor by the";
CM_ SG_ 3221225472 Aftrtrtmnt2ExhstGsTmp1PrlmnryFMI "Used to identify the applicable J1939-73 FMI detected in the exhaust gas temperature 1 sensor by the manufacturer's";
CM_ SG_ 3221225472 Aftertreatment2ExhaustGasTemp1 "The reading from the exhaust gas temperature sensor located farthest upstream in the aftertreatment system in exhaust bank 2.";
CM_ SG_ 3221225472 AxleLocation "To identify to which of several similar devices (such as tires or fuel tanks) the information applies.";
BA_DEF_ SG_  "SigType" ENUM  "Default","Range","RangeSigned","ASCII","Discrete","Control","ReferencePGN","DTC","StringDelimiter","StringLength","StringLengthControl";
BA_DEF_ SG_  "GenSigSendType" ENUM  "Cyclic","OnWrite","reserved","OnChange","reserved","reserved","reserved","NoSigSendType";
BA_DEF_ SG_  "GenSigILSupport" ENUM  "Yes","No";
BA_DEF_ SG_  "GenSigEVName" STRING ;
BA_DEF_ SG_  "SPN" INT 0 524287;
BA_DEF_ BO_  "GenMsgILSupport" ENUM  "Yes","No";
BA_DEF_ BO_  "GenMsgRequestable" INT 0 1;
BA_DEF_ BO_  "GenMsgSendType" ENUM  "cyclic","reserved","cyclicIfActive","reserved","reserved","reserved","reserved","reserved","noMsgSendType";
BA_DEF_ BO_  "VFrameFormat" ENUM  "StandardCAN","ExtendedCAN","reserved","J1939PG";
BA_DEF_ BO_  "GenMsgCycleTime" INT 0 3600000;
BA_DEF_ SG_  "SystemSignalLongSymbol" STRING ;
BA_DEF_DEF_  "SigType" "Default";
BA_DEF_DEF_  "GenSigSendType" "NoSigSendType";
BA_DEF_DEF_  "GenSigILSupport" "Yes";
BA_DEF_DEF_  "GenSigEVName" "Env@Nodename_@Signame";
BA_DEF_DEF_  "SPN" 0;
BA_DEF_DEF_  "GenMsgILSupport" "Yes";
BA_DEF_DEF_  "GenMsgRequestable" 1;
BA_DEF_DEF_  "GenMsgSendType" "noMsgSendType";
BA_DEF_DEF_  "VFrameFormat" "J1939PG";
BA_DEF_DEF_  "GenMsgCycleTime" 0;
BA_DEF_DEF_  "SystemSignalLongSymbol" "";
