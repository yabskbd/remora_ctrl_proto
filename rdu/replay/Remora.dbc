VERSION ""

NS_ :

BS_:

BU_:

BO_ 2364539904 ElectronicEngineController1: 8 Vector__XXX
 SG_ EngineSpeed : 24|16@1+ (0.125,0) [0|8031.875] "RPM" Vector__XXX
 SG_ ActualEnginePercentTorque : 16|8@1+ (1,-125) [-125|125] "%" Vector__XXX

BO_ 2364539648 ElectronicEngineController2: 8 Vector__XXX
 SG_ EnginePercentLoadAtCurrentSpeed : 16|8@1+ (1,0) [0|250] "%" Vector__XXX

BO_ 2566749184 DieselParticulateFilterControl1: 8 Vector__XXX
 SG_ AftertrtmntDPFActiveRegenStatus : 10|2@1+ (1,0) [0|3] "" Vector__XXX
 SG_ AftertrtmntDPFPassiveRegenStatus : 8|2@1+ (1,0) [0|3] "" Vector__XXX

BO_ 256 TemperatureSensorBlackBoxHSGI12: 8 Vector__XXX
 SG_ Thermocouple1Temperature : 23|16@0+ (0.01,0) [0|0] "C" Vector__XXX
 SG_ Thermocouple2Temperature : 55|16@0+ (0.01,0) [0|0] "C" Vector__XXX

BA_DEF_ SG_  "SigType" ENUM  "Default","Range","RangeSigned","ASCII","Discrete","Control","ReferencePGN","DTC","StringDelimiter","StringLength","StringLengthControl","MessageCounter","MessageChecksum";
BA_DEF_ SG_  "GenSigEVName" STRING ;
BA_DEF_ SG_  "GenSigILSupport" ENUM  "No","Yes";
BA_DEF_ SG_  "GenSigSendType" ENUM  "Cyclic","OnWrite","OnWriteWithRepetition","OnChange","OnChangeWithRepetition","IfActive","IfActiveWithRepetition","NoSigSendType";
BA_DEF_ BO_  "GenMsgILSupport" ENUM  "No","Yes";
BA_DEF_ BU_  "NmStationAddress" INT 0 255;
BA_DEF_ BO_  "GenMsgSendType" ENUM  "cyclic","NotUsed","IfActive","NotUsed","NotUsed","NotUsed","NotUsed","NotUsed","noMsgSendType";
BA_DEF_ BO_  "GenMsgRequestable" INT 0 1;
BA_DEF_ SG_  "SPN" INT 0 524287;
BA_DEF_  "DBName" STRING ;
BA_DEF_  "BusType" STRING ;
BA_DEF_  "ProtocolType" STRING ;
BA_DEF_ BO_  "VFrameFormat" ENUM  "StandardCAN","ExtendedCAN","reserved","J1939PG";
BA_DEF_DEF_  "SigType" "Default";
BA_DEF_DEF_  "GenSigEVName" "Env@Nodename_@Signame";
BA_DEF_DEF_  "GenSigILSupport" "Yes";
BA_DEF_DEF_  "GenSigSendType" "NoSigSendType";
BA_DEF_DEF_  "GenMsgILSupport" "Yes";
BA_DEF_DEF_  "NmStationAddress" 254;
BA_DEF_DEF_  "GenMsgSendType" "noMsgSendType";
BA_DEF_DEF_  "GenMsgRequestable" 1;
BA_DEF_DEF_  "SPN" 0;
BA_DEF_DEF_  "DBName" "";
BA_DEF_DEF_  "BusType" "CAN";
BA_DEF_DEF_  "ProtocolType" "J1939";
BA_DEF_DEF_  "VFrameFormat" "J1939PG";
BA_ "DBName" "foo";
BA_ "SPN" SG_ 2364539904 EngineSpeed 190;
BA_ "SPN" SG_ 2364539904 ActualEnginePercentTorque 513;
BA_ "SPN" SG_ 2364539648 EnginePercentLoadAtCurrentSpeed 92;
BA_ "SPN" SG_ 2566749184 AftertrtmntDPFActiveRegenStatus 3700;
BA_ "SPN" SG_ 2566749184 AftertrtmntDPFPassiveRegenStatus 3699;
BA_ "VFrameFormat" BO_ 256 0;
VAL_ 2566749184 AftertrtmntDPFActiveRegenStatus 0 "NotActive" 1 "Active" 2 "RegenNeeded" 3 "NotAvailable" ;
VAL_ 2566749184 AftertrtmntDPFPassiveRegenStatus 0 "NotActive" 1 "Active" 2 "Reserved" 3 "NotAvailable" ;
